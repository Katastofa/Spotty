/*
 * Spotty — gait_test: походки в пространстве суставов для проверки карты
 * каналов, знаков и фазировки.
 * ESP32-S3 + PCA9685 + 12 × QY3240MG HV, платформа SpotMicro (KDY0523).
 *
 * ---------------------------------------------------------------------------
 * РЕВИЗИЯ 2026-08-28 (третья за день) — ШАГ С СОГНУТЫМ КОЛЕНОМ
 *
 *   - ПОЗА ПРИСЕДА. Задаётся одним числом — углом колена ('q', по умолчанию
 *     60°). Угол бедра выводится так, чтобы стопа встала строго под ось хипа.
 *     'q 0' возвращает прежнюю прямую ногу, поведение бит в бит старое;
 *   - ПЛОСКАЯ ТРАЕКТОРИЯ СТОПЫ ('f 1'): в опоре стопа идёт по горизонтали,
 *     а не по дуге. Бедро и колено работают согласованно;
 *   - ограничитель скорости РАЗДЕЛЁН на два: рампа в позу осталась 100°/с
 *     навсегда, скорость походки настраивается ('m'). Плоской траектории
 *     нужно до 145°/с, и со старым общим ограничителем она молча срезалась.
 *
 * ПОЧЕМУ ЭТО НЕ НАРУШАЕТ ЗАПРЕТ НА ВЫДУМАННЫЕ ДЛИНЫ ЗВЕНЬЕВ — см. большой
 * комментарий у linkRatio. Коротко: и присед, и плоская траектория выражаются
 * через ОТНОШЕНИЕ звеньев, абсолютный масштаб в них сокращается. Отношение
 * принято равным 1.0 и ПОМЕЧЕНО КАК ДОПУЩЕНИЕ; когда его измерят, правится
 * одно число ('L'). Декартова IK по-прежнему выключена: ей нужны абсолютные
 * длины, а их нет.
 *
 * ---------------------------------------------------------------------------
 * РЕВИЗИЯ 2026-08-28 (вторая за день) — ПЯТЬ ПОХОДОК И РАЗВОРОТ
 *
 *   - походка выбирается с клавиатуры: trot, pace, bound, walk, gallop.
 *     У каждой свои фазы, duty и пресет амплитуд;
 *   - duty (доля цикла в опоре) стал параметром. Раньше был зашит 0.5,
 *     из-за чего walk с его 0.75 не выражался вовсе;
 *   - разворот через хипы: отдельный переключатель 'u', знак по ноге
 *     диагональный (см. TURN_SIGN). Хипы участвуют ТОЛЬКО в развороте;
 *   - амплитуды и период правятся с клавиатуры, каждое изменение само
 *     прогоняет предполётную проверку;
 *   - предполётная проверка теперь считает ещё и ТРЕБУЕМУЮ СКОРОСТЬ сустава
 *     в градусах на тик и предупреждает, если ограничитель её срежет. Срезанная амплитуда — это уже не та походка, которую задали,
 *     и на весу это легко принять за ошибку карты каналов;
 *   - ввод стал построчным (у команд появились аргументы). 'x' и 'r'
 *     по-прежнему срабатывают с одной клавиши, без Enter.
 *
 * КАКОЙ ПОХОДКОЙ ЧТО ПРОВЕРЯЕТСЯ — см. комментарий к таблице GAITS ниже.
 * Коротко: walk читается глазом лучше всех, pace ловит ошибку знака по
 * борту, bound — по оси перёд-зад.
 *
 * ---------------------------------------------------------------------------
 * РЕВИЗИЯ 2026-08-26 — БОЕВОЙ ЗАПУСК НА ВЕСУ
 *
 * Что изменено против версии от 2026-08-23:
 *   - DRY_RUN снят. Скетч подаёт ШИМ на серво.
 *   - Походка конечна: WALK_CYCLES циклов, потом сама возвращается в позу.
 *     Бесконечного хода больше нет — «пара шагов» означает пару шагов.
 *   - Перед ПЕРВОЙ подачей ШИМ добавлен обратный отсчёт ARM_MS.
 *     Обесточенное серво мягкое, нога висит там, куда её увела гравитация;
 *     первый импульс — это рывок на полном моменте из неизвестной позы.
 *     Отсчёт отменяется любой клавишей.
 *   - Пока не прошёл взвод, applyJoint() физически ничего не пишет.
 *
 * Правка 2026-08-26, по итогам первого запуска на стенде:
 *   - Перевод строки от Serial Monitor больше не считается нажатием клавиши.
 *     До этой правки 'n' + Enter отменял собственный взвод следующим же
 *     символом.
 *   - Выходы PCA9685 гасятся широковещательно ДО pwm.begin(). До этой правки
 *     при перезаливке серво получали рывок от старых регистров драйвера,
 *     оживлённых внутри begin() и переосмысленных на 1000 Гц.
 *   - ДОБАВЛЕН setOscillatorFrequency(27 МГц). Его тут не было, а он есть во
 *     всех трёх скетчах, которыми снималась калибровка. Без него импульс
 *     выходил в 0.926 от заданного — все двенадцать суставов мимо нуля
 *     примерно на 20°. Это, а не только рывок, и есть причина вывернутых ног.
 *   - I2C переведён на 400 кГц, как в остальных скетчах. На 100 кГц двенадцать
 *     writeMicroseconds() (каждый ещё и читает делитель) не укладывались
 *     в тик 20 мс.
 *
 * УСЛОВИЯ ЗАПУСКА (без них не шить):
 *   робот ВЫВЕШЕН, ноги не касаются стола;
 *   питание серво — с ограничением тока;
 *   разрыв питания под рукой;
 *   в терминале открыт Serial 115200 ДО подачи питания на серво.
 *
 * ---------------------------------------------------------------------------
 * ЧТО ЭТО И ЧЕГО ЗДЕСЬ НЕТ
 *
 * Походка задана В ПРОСТРАНСТВЕ СУСТАВОВ, а не в декартовом. Это сделано
 * намеренно: межосевые расстояния бедра и голени НЕ ИЗМЕРЕНЫ
 * (PROJECT_STATUS.md, «Открытые вопросы»), а без них обратная кинематика
 * посчитана быть не может. Придумывать длины звеньев запрещено политикой
 * проекта (SAFETY.md).
 *
 * Суставные походки проверяют ровно то, что можно проверить сегодня:
 *   - карта канал → нога → сустав в движении, а не поканально;
 *   - соглашение о знаках (колено + = сгибание, бедро + = вперёд);
 *   - фазировку диагональных пар;
 *   - что программные пределы держат на всём цикле.
 *
 * Декартова IK на месте (legIK, ниже) и работает от STL-кандидатов длин
 * звеньев. Пуск на ней закрыт флагом SPOTTY_LINKS_MEASURED, пока M1/M2/M3
 * не подтверждены штангенциркулем: считать можно, двигать нельзя.
 *
 * ---------------------------------------------------------------------------
 * ЧТО ЭТОТ ЗАПУСК НЕ ПРОВЕРЯЕТ — читать до включения
 *
 * 1. M9 снят только для ch4, ch5, ch9. У остальных девяти суставов нуль
 *    «не отличается на глаз», что не равно «измерен». Остаточная ошибка до
 *    ±7.2° (зуб шлица 25T). На весу это безвредно — стопа просто идёт не
 *    по той дуге, — но ЛЮБОЙ вывод о качестве походки отсюда недействителен,
 *    пока M9_ПРОТОКОЛ.md не заполнен на все двенадцать строк.
 * 2. ch10 (FL бедро) — открытая аномалия: верхний предел в градусах выбивается
 *    примерно на 15° против трёх остальных бёдер. В позе 0/0/0 с размахом ±12°
 *    это не задействовано (запас до предела 70°), но помнить об этом.
 * 3. С 2026-08-28 поза стойки — ПРИСЕД, и считается она без абсолютных длин
 *    звеньев (см. linkRatio). Но отношение звеньев принято 1.0 БЕЗ ЗАМЕРА:
 *    если голень и бедро на деле разной длины, стопа при ψ=0 стоит не строго
 *    под осью хипа, а со сдвигом (Lголень − Lбедро)·sin(бедро). Сдвиг
 *    ПОСТОЯННЫЙ, он не копится и на весу безвреден, но на полу дал бы
 *    систематический увод. Померить отношение — и вопрос закрыт.
 *
 * ---------------------------------------------------------------------------
 * СТАТУС ПО SAFETY.md
 *
 * SAFETY.md п.8 и §4 запрещают походки до завершения фаз 2–4. Фаза 4
 * (движение одного сустава) формально не пройдена: оператор решил идти сразу
 * к trot на вывешенном роботе. Решение осознанное, зафиксировано 2026-08-26.
 *
 * Что из SAFETY.md выполняется здесь:
 *   п.1  в setup() нет ни одной позиционной команды, выход из setup — с
 *        заведомо снятым сигналом;
 *   п.7  каждый импульс клампится по измеренным пределам своего канала,
 *        затем ещё раз по абсолютному окну 520…2380;
 *   п.14 выход в позу — плавной рампой с ограничением 100°/с, не скачком;
 *   E-STOP: цикл неблокирующий, без delay(), Serial читается на каждом тике,
 *        'x' останавливает немедленно, 'r' снимает сигнал полностью.
 * ---------------------------------------------------------------------------
 *
 * УСТАНОВКА
 * Рядом с этим .ino лежит spotty_config.h — шим на одну строку, включающий
 * ../spotty_config.h. Источник правды один, копий таблиц здесь нет.
 */

#include <Wire.h>
#include <Adafruit_PWMServoDriver.h>

/*
 * ===========================================================================
 * ВЕБ-ПУЛЬТ — ревизия 2026-08-31. SPOTTY_WEB 0 возвращает прежнее поведение
 * БИТ В БИТ: LOG становится Serial, задача веб-сервера не создаётся, радио
 * не включается, ни одной новой строки в loop() не исполняется.
 *
 * Веб НЕ добавляет ни одного нового пути к серво: браузер только кладёт
 * строку в очередь, а разбирает её тот же handleLine() на том же ядре, что
 * и строку из USB. Предполётная проверка, paramGuard и жёсткий кламп
 * работают ровно так же. Подробности и разбор рисков — spotty_web.h.
 *
 * Учётные данные сети — spotty_wifi.h, ЗАПОЛНИТЬ ПЕРЕД СБОРКОЙ.
 * ===========================================================================
 */
#define SPOTTY_WEB 1

#if SPOTTY_WEB
  // LOG обязан существовать РАНЬШЕ конфига: самопроверка пределов печатает
  // из spotty_config.h, и её результат должен попадать в панель тоже.
  #include "spotty_log.h"
  #define SPOTTY_LOG LOG
#else
  #define LOG Serial
#endif

#include "spotty_config.h"
#include "spotty_osc.h"      // поправка на уход генератора PCA9685 (2026-09-26)
#include "spotty_imu.h"      // IMU на Wire1, только измерение (2026-09-26)
#include "oq_gait.h"      // безье-траектории и поза корпуса, порт OpenQuadruped
#include "spotty_tricks_types.h"   // типы трюков — до любой функции (2026-09-29)
#include "spotty_profiles.h"      // профили ходьбы, команда M (2026-09-30)

#if SPOTTY_WEB
  #include "spotty_web.h"      // требует типов из конфига, поэтому строго после
#endif

// ===========================================================================
// РЕЖИМ
// ===========================================================================
#define DRY_RUN false         // true = на серво не подаётся НИЧЕГО, только Serial

/* ---------------------------------------------------------------------------
 * ГЕОМЕТРИЯ ЗВЕНЬЕВ — КАНДИДАТЫ ПО STL, НЕ ЗАМЕРЫ.
 *
 * Числа взяты из KINEMATICS_AUDIT.md §4, где они получены подгонкой
 * окружностей по вершинам STL (невязка 0.000 мм, деталь смоделирована в CAD).
 * По политике проекта это КАНДИДАТЫ: значение из файла — не измерение.
 * У каждого свой пункт проверки штангенциркулем.
 *
 * SPOTTY_LINKS_MEASURED остаётся 0, пока M1/M2/M3 не подтверждены на железе.
 * При нуле декартов движок СЧИТАЕТ и печатает, но 'n' и 'w' отказывают:
 * считать можно, двигать нельзя. Это ворота, а не формальность.
 * ------------------------------------------------------------------------- */
#define SPOTTY_LINKS_MEASURED 0

static const float L_FEMUR_MM = 108.31f;  // ось бедра ↔ ось колена. STL `arm`,
                                          // ΔZ 107.425 / ΔX 13.819.      M2
static const float L_TIBIA_MM = 116.51f;  // ось колена ↔ ось стопы.
                                          // STL `wrist`, ΔX 116.51.      M3
static const float L_HIP_MM   =  10.75f;  // общий перпендикуляр ось хипа ↔
                                          // ось бедра. STL `arm_joint`,
                                          // 20.250 − 9.500.              M1
static const float R_FOOT_MM  =  19.41f;  // радиус протектора. STL `foot`. M3

/* ПРОДОЛЬНАЯ БАЗА — СНЯТА 2026-09-12. Рулетка, 186 мм.
 *
 * ИСТОРИЯ, и её стоит держать перед глазами. По STL база НЕ ОПРЕДЕЛЯЛАСЬ
 * (KINEMATICS_AUDIT.md §4): ни одна пара крепёжных отверстий плеча, боковины
 * и крышек не совпадает, поэтому по файлам нельзя было сказать, какая деталь
 * во что упирается. Детали допускали 135…232 мм — коридор шириной почти в
 * сотню миллиметров.
 *
 * ЧЕГО СТОИЛО БЫ ГАДАНИЕ. Тангаж 10° при базе 135 поднимает стопу на
 * 11.9 мм, при базе 232 — на 20.4 мм. Разница 8.5 мм БОЛЬШЕ остатка M9
 * (до 7 мм), который мы и ловим: выдуманная база испортила бы ровно тот
 * замер, ради которого всё делается. Поэтому тангаж и рыскание ОТКАЗЫВАЛИ,
 * а перенос корпуса по фазе не мог посчитать себе амплитуду.
 *
 * ТЕПЕРЬ 186 — это ЗАМЕР, а не середина коридора (ею было 180, и симулятор
 * считал на ней). Разблокировано: тангаж 'E', рыскание 'J', перенос корпуса
 * по фазе 'B'. Амплитуда переноса стала 12.47 мм вместо расчётных 12.84 на
 * принятой базе.
 *
 * СВЕРЕНО ПО ДВУМ БОРТАМ: 186 и 186. Рама не перекошена — а это отдельный
 * факт, и он тоже измерен, а не предположен. Симметрия рамы входит в каждую
 * формулу ниже: опорный прямоугольник считается прямоугольником именно
 * поэтому, и инцентр, и знак переноса корпуса опираются на это молча.
 */
static const float BASE_LAT_MM  = 78.00f; // левый ↔ правый хип. STL плеч,
                                          // 94.000 − 16.000, две детали.  M5
#define SPOTTY_BASE_LONG_MEASURED 1
static const float BASE_LONG_MM = 186.0f; // ИЗМЕРЕНО 2026-09-12, рулетка,
                                          // ось переднего хипа ↔ ось
                                          // заднего. Оба борта: 186/186. M4

// Тот же факт, но СИМВОЛОМ, а не макросом: стенд собирается отдельной
// единицей трансляции и препроцессорного флага не видит. Симулятор ставит
// статус числа по этому символу — иначе ему пришлось бы гадать по величине,
// а ненулевая база может быть и подставленной, и измеренной.
// ('extern const', а не просто 'const': const на уровне файла в C++ имеет
//  внутреннюю связь, и стенд такой символ не увидел бы.)
extern const bool BASE_LONG_IS_MEASURED;
const bool BASE_LONG_IS_MEASURED = SPOTTY_BASE_LONG_MEASURED;

// ===========================================================================
// ПОХОДКИ
// ---------------------------------------------------------------------------
// Всё в градусах суставов, ножная система отсчёта. 0 = измеренный нуль
// сустава из spotty_config.h. Поза 0/0/0 выбрана оператором 2026-08-26:
// нога прямая, вертикально вниз.
//
// Походка описывается четырьмя вещами:
//   phase[]  сдвиг фазы каждой ноги в долях цикла;
//   duty     доля цикла в ОПОРЕ (stance). Остальное — перенос (swing);
//   ampThigh размах бедра вперёд-назад, ±;
//   ampKnee  подъём: дополнительное сгибание колена в переносе.
//
// ЧТО ПРОВЕРЯЕТ КАЖДАЯ ПОХОДКА НА ВЫВЕШЕННОМ РОБОТЕ. Опоры нет, поэтому
// «походка» здесь — это узор фазировки, и ценность у каждой своя:
//
//   trot    диагонали синфазны. Базовая проверка, с неё начинали.
//   pace    борта синфазны. Прямая проверка ЗЕРКАЛЬНОСТИ БОРТОВ: если
//           JOINT_SIGN перепутан на одном борту, при иноходи это видно
//           мгновенно — борт пойдёт встречно.
//   bound   передние синфазны, задние синфазны. Проверка оси ПЕРЁД-ЗАД
//           в карте каналов: перепутанные перед и зад дают инверсию узора.
//   walk    duty 0.75, ноги через 0.25 цикла — в переносе ВСЕГДА РОВНО ОДНА
//           нога, и порядок подъёма строго известен: ЗЛ, ПЛ, ЗП, ПП.
//           Самая читаемая глазом: ошибку в карте канал→нога видно сразу,
//           достаточно посмотреть, какая нога поднялась не в свой черёд.
//   gallop  сдвиг внутри пар. На весу фазировку глазом не разобрать,
//           смысл только в проверке, что кламп держит на высоком темпе.
//
// ПОРЯДОК НОГ В phase[] СОВПАДАЕТ С enum Leg: FR, FL, BR, BL.
// ===========================================================================
static const float POSE_HIP_DEG   =  0.0f;

/* ===========================================================================
 * ПРИСЕД И МОДЕЛЬ ЗВЕНЬЕВ — добавлено 2026-08-28
 * ---------------------------------------------------------------------------
 * ПОЧЕМУ ЭТО НЕ НАРУШАЕТ ЗАПРЕТ НА ВЫДУМАННЫЕ ДЛИНЫ ЗВЕНЬЕВ.
 *
 * Политика проекта запрещает изобретать межосевые расстояния: их не измеряли.
 * Но для приседа и для шага по ровной траектории АБСОЛЮТНЫЕ ДЛИНЫ НЕ НУЖНЫ.
 * Нужно только их ОТНОШЕНИЕ, потому что все нужные величины — углы, а масштаб
 * в них сокращается. Ниже бедро принято за единицу, голень за LINK_RATIO.
 *
 * Обозначения (x вперёд, z вниз, всё в плоскости ноги):
 *   θ  угол бедра   от вертикали, + = вперёд   (соглашение проекта)
 *   φ  угол колена, 0 = голень продолжает бедро, + = сгибание, голень вперёд
 *   ψ  угол ВИРТУАЛЬНОЙ НОГИ — прямой от оси хипа к стопе, от вертикали
 *   ρ  длина виртуальной ноги в единицах бедра
 *
 * Стопа = бедро + голень как векторы:
 *   ρ(φ) = sqrt(1 + k² + 2k·cos φ)                         ... теорема косинусов
 *   α(φ) = atan2(k·sin φ, 1 + k·cos φ)                     ... отклонение стопы
 *                                                              от оси бедра
 *   ψ = θ + α(φ)   =>   θ = ψ − α(φ)
 *
 * ПОЗА ПРИСЕДА. Задаём φ0 (насколько согнуто колено) и требуем ψ = 0, то есть
 * стопа строго под осью хипа. Тогда θ0 = −α(φ0). Никаких длин.
 * При k = 1 это даёт красивое θ0 = −φ0/2: колено согнуто вдвое сильнее, чем
 * отведено назад бедро. Нога короче в cos(φ0/2) раз.
 *
 * ПЛОСКАЯ ТРАЕКТОРИЯ. Чтобы стопа шла по ГОРИЗОНТАЛИ на глубине ρ0, нужно
 *   ρ(ψ) = ρ0 / cos ψ,
 * то есть по краям хода нога должна вытягиваться. Обращаем ρ(φ) и получаем φ,
 * затем θ = ψ − α(φ). Снова никаких абсолютных длин.
 * Ход ограничен вытягиванием: ρ0/cos ψ ≤ 1 + k, откуда |ψ| ≤ acos(ρ0/(1+k)).
 * При k = 1 это ровно φ0/2 — то есть размах не может превысить отвод бедра.
 *
 * ЧТО ЗДЕСЬ ДОПУЩЕНО И ЧЕГО ЭТО СТОИТ.
 * LINK_RATIO = 1.0 — ЭТО ДОПУЩЕНИЕ, А НЕ ИЗМЕРЕНИЕ. Межосевые расстояния
 * бедра и голени не мерялись (PROJECT_STATUS.md, «Открытые вопросы»).
 * Цена ошибки ограничена и считается: при ψ = 0 стопа уходит вбок от оси
 * хипа на (Lголень − Lбедро)·sin(θ0) — то есть перекос ПОСТОЯННЫЙ, он не
 * копится и на вывешенном роботе безвреден. На плоской траектории ошибка
 * отношения даёт остаточную волну по высоте стопы, но не выход за пределы:
 * пределы стоят в углах и клампом защищены независимо от любой модели.
 *
 * Когда отношение измерят — правится ОДНО число, командой 'L' или здесь.
 * ===========================================================================
 */
// --------------------------- действующие параметры --------------------------
// Инициализируются пресетом выбранной походки, правятся с клавиатуры.
// Объявлены здесь, а не рядом с таблицей походок, потому что модель звеньев
// ниже читает pAmpKnee.
float pDuty, pAmpThigh, pAmpKnee, pCycleMs;
float pAmpHip = 5.0f;      // размах хипа в развороте, ±
int   pTurn   = 0;         // 0 нет разворота, +1 влево, -1 вправо

/* ---------------------------------------------------------------------------
 * ПАРАМЕТРЫ ДЕКАРТОВА ДВИЖКА (pEngine == 1). В угловом движке не участвуют.
 *
 * Здесь всё в МИЛЛИМЕТРАХ и градусах КОРПУСА, а не в градусах суставов.
 * Это и есть смысл порта: «шаг 40 мм» проверяется рулеткой, «размах бедра
 * ±12°» — нет.
 *
 * ЗАДАННОЕ РАВНО ФАКТИЧЕСКОМУ. В оригинале clearance и penetration задают
 * положение контрольных точек, через которые кривая безье не проходит:
 * 'clearance 0' при высоте 190 даёт 59 мм отрыва. Здесь pLiftMm и pPenetMm —
 * фактические миллиметры, пересчёт в контрольные точки делает oq_gait.h.
 * ------------------------------------------------------------------------- */
/* УМОЛЧАНИЯ ПОДОБРАНЫ ПОД ЭТО ЖЕЛЕЗО, А НЕ ВЗЯТЫ У АВТОРА.
 *
 * У OpenQuadruped пресеты вида T_swing = 0.2…0.4 с при L_span 40…70 мм. На
 * наших серво это требует 305…375 °/с по колену — вчетверо больше, чем
 * разрешено по умолчанию (100 °/с) и вчетверо больше, чем нужно угловому
 * движку на сопоставимой походке (79 °/с). Ограничитель срезал бы амплитуду,
 * фазировка поехала бы, и оператор увидел бы «не ту походку» на ровном месте.
 *
 * Пик держит КОЛЕНО, и он определяется отношением подъём/время переноса, а
 * не скоростью корпуса. Отсюда длинный перенос и умеренный подъём.
 * Набор ниже даёт период 1900 мс, duty 0.53 и пик 80 °/с — то есть тот же
 * режим, в котором угловой движок уже отработал прогон 29.08. */
int   pEngine    = 0;       // 0 угловой (как было), 1 декартов
float pHeightMm  = 190.0f;  // глубина стопы под осью хипа
float pSpanMm    =  30.0f;  // L_span: полуразмах шага (полный шаг = 2*L_span)
float pLiftMm    =  15.0f;  // ФАКТИЧЕСКИЙ подъём стопы в переносе
float pPenetMm   =   0.0f;  // ФАКТИЧЕСКИЙ продав опоры (0 = опора прямая)
float pVelMmS    =  60.0f;  // скорость корпуса -> T_stance = 2*L_span/V
float pSwingMs   = 900.0f;  // T_swing, время переноса
float pCrabDeg   =   0.0f;  // направление хода: 0 вперёд, +90 влево
float pShiftXMm  =   0.0f;  // сдвиг корпуса: + вперёд (стопы уезжают назад)
float pShiftYMm  =   0.0f;  // сдвиг корпуса: + влево
float pShiftGain =   0.0f;  // ПЕРЕНОС КОРПУСА ПО ФАЗЕ, доля расчётной
                            // амплитуды. 0 = ВЫКЛЮЧЕН, и это умолчание:
                            // пока оператор не подал 'B', поведение робота
                            // не отличается от прежнего ни на один микрон.
                            // Амплитуда руками НЕ задаётся — она считается
                            // из геометрии. См. bodyShiftAmpMm().
float pRollDeg   =   0.0f;  // крен:    + левый борт вверх
float pPitchDeg  =   0.0f;  // тангаж:  + нос вверх   — открыт с M4 2026-09-12
float pYawDeg    =   0.0f;  // рыскание:+ нос влево   — открыт с M4 2026-09-12

// Где какая нога стоит. Порядок совпадает с enum Leg: FR, FL, BR, BL.
static const float LEG_FWD [LEG_COUNT] = { +1.0f, +1.0f, -1.0f, -1.0f };
static const float LEG_LEFT[LEG_COUNT] = { -1.0f, +1.0f, -1.0f, +1.0f };

// Отказ IK: стопа вне досягаемости. Ставится в gaitPoseCartesian, читается
// предполётной и циклом хода. Обнуляется тем, кто начинает новый прогон.
bool     ikFail      = false;
uint8_t  ikFailLeg   = 0;
float    ikFailPhase = 0.0f;

float linkRatio  = 1.0f;    // ГОЛЕНЬ / БЕДРО. 1.0 = ДОПУЩЕНИЕ, не замер.
float pCrouchDeg = 60.0f;   // φ0: угол колена в опоре. 0 = прямая нога.
bool  pFlatPath  = false;   // false = дуга, true = плоская траектория стопы
bool  pSmoothSwing = false; // false = линейный перенос, true = сглаженный

/*
 * ПРОДОЛЬНЫЙ СДВИГ КОРПУСА (трим). Добавлено 2026-08-28.
 *
 * ЗАЧЕМ. Наша стойка ставит стопу СТРОГО под ось хипа, то есть опорный
 * четырёхугольник симметричен относительно геометрического центра корпуса.
 * Центр тяжести у SpotMicro там не находится: батарея и электроника смещают
 * его назад. Робот садится на корму.
 *
 * ВСЕ ТРИ СРАВНИМЫХ ПРОЕКТА ДЕРЖАТ ЗДЕСЬ НЕНУЛЕВУЮ КОНСТАНТУ, и все три —
 * в одну сторону, корпусом вперёд относительно стоп:
 *   mike4192/spotMicro   stand_front_x_offset = 0.015 м (передние стопы вперёд)
 *   OpenQuadruped        com_offset = 0.016 м, pos[0] += com_offset в IK()
 *   MangDang Mini Pupper x_shift = 0.007 м при delta_x = 0.059
 *   Boston Dynamics      body_translation_offset — штатный параметр Custom Gait
 * У mike4192 вдобавок сдвиг вперёд 35 мм против 5 мм назад — асимметрия сама
 * по себе говорит, что борются именно с задранным носом.
 *
 * НИ ОДНО ИЗ ЭТИХ ЧИСЕЛ НЕ ИЗМЕРЕНО ИЗ ГЕОМЕТРИИ. Это подобранные на стенде
 * константы; у mike4192 в конфиге лежит второй набор под trot с пометкой
 * «better tuned», то есть одно железо требует разной подгонки под походки.
 *
 * У НАС ЭТО ВЫРАЖАЕТСЯ БЕЗ МИЛЛИМЕТРОВ. Трим — это постоянная добавка к углу
 * ВИРТУАЛЬНОЙ НОГИ, одинаковая для всех четырёх ног. Знак: положительный
 * двигает КОРПУС ВПЕРЁД относительно стоп (стопы уезжают назад под корпусом).
 *
 * ВАЖНОЕ СВОЙСТВО: в ПЛОСКОМ режиме трим не меняет высоту вовсе. Глубина
 * стопы там равна ρ0 по построению при любом ψ, значит корпус едет строго
 * горизонтально и НЕ НАКЛОНЯЕТСЯ. Это ровно то, что делает mike4192, у
 * которого return_point.y при сдвиге не трогается. В режиме дуги высота
 * слегка меняется, но одинаково у всех четырёх ног, поэтому дифферента
 * тоже не возникает — только общая просадка.
 *
 * В миллиметрах величину назвать НЕЛЬЗЯ: для этого нужна продольная база,
 * а она в KINEMATICS_AUDIT.md честно помечена как неопределённая (135…232 мм).
 * Подбирается глазом или по фото строго сбоку.
 *
 * ЗНАЧЕНИЕ ПО УМОЛЧАНИЮ +17°, 2026-08-29. Источник — ОПЕРАТОР, подбор НА ГЛАЗ
 * на стенде: прогон trot с начальными настройками скетча (duty 0.50,
 * бедро ±12°, колено +15°, период 1200 мс, присед 60°, ДУГА, линейный
 * перенос), робот ВЫВЕШЕН. Это НЕ замер и НЕ вывод из геометрии, ровно как
 * у всех перечисленных выше проектов.
 *
 * ЧТО С ЭТИМ ЗНАЧЕНИЕМ НЕ ТАК И ПОЧЕМУ ОНО ВСЁ РАВНО СТОИТ ЗДЕСЬ.
 *   17° при ρ0 = 1.732 — это сдвиг стопы назад на 0.51 длины БЕДРА. Чтобы
 *   сойтись с чужими 15…16 мм, бедро должно быть около 30 мм, чего быть не
 *   может: наше заметно длиннее. Значит либо ЦТ действительно сильно дальше
 *   назад, либо трим подъедает ОБЩУЮ составляющую ошибки нулей бёдер —
 *   M9 не снят ни для одного канала, заявлено до ±7.2°. Трим одинаков для
 *   всех четырёх ног, поэтому компенсировать он может только общую часть
 *   ошибки, а не разброс между каналами.
 *   Разделить причины может только замер: M9_ПРОТОКОЛ.md либо фото сбоку.
 *   До этого 17° — рабочая подгонка, а не измеренная константа.
 *
 * ГДЕ ОНО УПИРАЕТСЯ. На ДУГЕ ни во что: бедро идёт −59°…−35°, ближайший
 * жёсткий предел BR(ch4) на −86.7°, запас 27.7°. (В первой редакции этого
 * блока стояло «FL(ch10) на −79.5°» — ошибка: знак ch10 и ch2 равен −1,
 * а не +1. Исправлено 2026-08-29, вывод не изменился.) На ПЛОСКОЙ траектории предполётная
 * считает ход = t + |b| против вылета ноги (±30° при приседе 60° и k = 1):
 * при t 12 это 29.0 из 29.5, запас полградуса. Любое t выше 12 или
 * сглаженный перенос 'S 1' проверку на 'f 1' уже не пройдут — это не
 * поломка, а честный отказ модели, лечится 't' меньше или приседом глубже.
 *
 * Вернуть прежнее поведение: 'b 0'. Прогон 2026-08-28 и вся арифметика
 * дифферента в PROJECT_STATUS считались при триме 0.
 */
float pTrimDeg = 17.0f;     // + = корпус вперёд. ПОДБОР ОПЕРАТОРА 2026-08-29,
                            // не замер. Прежнее умолчание было 0.0f.
float liftRho    = 0.0f;    // подъём стопы в переносе, в единицах бедра

/* ===========================================================================
 * ДЕКАРТОВА IK ОДНОЙ НОГИ.
 * ---------------------------------------------------------------------------
 * Система координат в оси хипа: x вперёд, y НАРУЖУ, z ВНИЗ (положительный).
 * «Наружу» — у левых ног влево, у правых вправо; зеркальность бортов дальше
 * учитывает JOINT_SIGN.
 *
 * ЧУЖУЮ IK ИЗ OpenQuadruped СЮДА НЕ СТАВИТЬ. Её формула делится на ноль
 * ровно на нашей геометрии: она предполагает вынос оси бедра с двумя
 * ненулевыми составляющими, а по STL у нас общий перпендикуляр 10.75 мм
 * идёт чисто по Z, вторая составляющая нулевая. Разбор — в шапке oq_gait.h.
 *
 * ИСПРАВЛЕН ЗНАК БЕДРА, 2026-08-31. Было `atan2(x,r) + acos(cg)`, стало
 * `− acos(cg)`. Заготовка была закрыта флагом SPOTTY_LINKS_MEASURED и ни
 * разу не компилировалась, поэтому расхождение не всплывало: она давала
 * +15.560° там, где угловой движок даёт −15.560°. После правки совпадение
 * с −alphaOf() точное на всех приседах.
 *
 * Возвращает false, если точка недостижима — вызывающий ОБЯЗАН это проверить
 * и остановиться, а не подставлять последнее удачное значение.
 * =========================================================================== */
bool legIK(float x, float y, float z, float &hip, float &thigh, float &knee) {
  const float d2 = y * y + z * z;
  if (d2 < L_HIP_MM * L_HIP_MM) return false;
  const float r = sqrtf(d2 - L_HIP_MM * L_HIP_MM);
  hip = degrees(atan2f(z, y) - atan2f(r, L_HIP_MM));

  const float L = sqrtf(x * x + r * r);
  if (L > L_FEMUR_MM + L_TIBIA_MM - 0.001f) return false;
  if (L < fabsf(L_FEMUR_MM - L_TIBIA_MM) + 0.001f) return false;

  const float ci = (L_FEMUR_MM * L_FEMUR_MM + L_TIBIA_MM * L_TIBIA_MM - L * L)
                   / (2.0f * L_FEMUR_MM * L_TIBIA_MM);
  knee = degrees(PI - acosf(constrain(ci, -1.0f, 1.0f)));   // + = сгибание

  const float cg = (L * L + L_FEMUR_MM * L_FEMUR_MM - L_TIBIA_MM * L_TIBIA_MM)
                   / (2.0f * L * L_FEMUR_MM);
  thigh = degrees(atan2f(x, r) - acosf(constrain(cg, -1.0f, 1.0f)));  // + = вперёд
  return true;
}

// ρ(φ) — длина виртуальной ноги в единицах бедра.
float reachOf(float kneeDeg) {
  const float k = linkRatio, c = cosf(radians(kneeDeg));
  return sqrtf(1.0f + k * k + 2.0f * k * c);
}

// α(φ) — на сколько градусов стопа отклонена от оси бедра.
float alphaOf(float kneeDeg) {
  const float k = linkRatio, r = radians(kneeDeg);
  return degrees(atan2f(k * sinf(r), 1.0f + k * cosf(r)));
}

// Обратная задача: какой угол колена даёт заданную длину. Всегда определена —
// требуемая длина зажимается в физически достижимый диапазон звеньев.
// Это НЕ защита сустава (её делает кламп), а защита от NaN в acos.
float kneeForReach(float rho) {
  const float k = linkRatio;
  const float lo = fabsf(1.0f - k) + 1e-4f, hi = 1.0f + k - 1e-4f;
  rho = constrain(rho, lo, hi);
  float c = constrain((rho * rho - 1.0f - k * k) / (2.0f * k), -1.0f, 1.0f);
  return degrees(acosf(c));
}

// Поза приседа: стопа под осью хипа.
float stanceThighDeg() { return -alphaOf(pCrouchDeg); }
float stanceReach()    { return reachOf(pCrouchDeg); }

// Предельный размах виртуальной ноги: дальше нога просто не дотягивается.
float sweepLimitDeg() {
  float c = stanceReach() / (1.0f + linkRatio);
  if (c >= 1.0f) return 0.0f;               // нога уже вытянута полностью
  return degrees(acosf(constrain(c, -1.0f, 1.0f)));
}

// Подъём стопы в переносе выражен через ТОТ ЖЕ параметр ampKnee, что и в
// режиме дуги: берём, насколько укоротилась бы нога, догни мы колено на
// ampKnee градусов от приседа. Так два режима сравнимы по одному числу —
// а сравнить их глазом на стенде и есть смысл переключателя.
void recalcLift() {
  float kneeMax = pCrouchDeg + pAmpKnee;
  if (kneeMax > 175.0f) kneeMax = 175.0f;
  liftRho = reachOf(pCrouchDeg) - reachOf(kneeMax);
  if (liftRho < 0.0f) liftRho = 0.0f;
}

struct GaitDef {
  const char *name;
  const char *note;
  float phase[LEG_COUNT];   // FR, FL, BR, BL
  float duty;               // доля цикла в опоре
  float ampThigh, ampKnee;  // градусы
  float cycleMs;
};

// ПОРЯДОК ПОДЪЁМА НОГ У WALK. Нога уходит в перенос, когда её собственная
// фаза переваливает duty, то есть в глобальной фазе (duty - phase[нога]).
// При duty 0.75 это даёт:
//     BL 0.00 -> FL 0.25 -> BR 0.50 -> FR 0.75
// то есть ЗЛ, ПЛ, ЗП, ПП — боковая последовательность (lateral sequence),
// которой ходит шагом собака: за задней ногой идёт передняя ТОГО ЖЕ борта.
//
// Первая редакция этой таблицы давала BL, FR, BR, FL — диагональную
// последовательность (за задней идёт передняя ПРОТИВОПОЛОЖНОГО борта).
// Она тоже устойчива, но это походка приматов, а не собаки, и как эталонный
// узор для проверки карты каналов она хуже: диагональный порядок легко
// спутать с перепутанной парой каналов. Исправлено 2026-08-28.
static const GaitDef GAITS[] = {
  { "trot",   "диагонали синфазны",
    { 0.00f, 0.50f, 0.50f, 0.00f }, 0.50f, 12.0f, 15.0f, 1200.0f },
  { "pace",   "борта синфазны, проверка зеркальности бортов",
    { 0.00f, 0.50f, 0.00f, 0.50f }, 0.50f, 12.0f, 15.0f, 1200.0f },
  { "bound",  "перед синфазно, зад синфазно, проверка оси перёд-зад",
    { 0.00f, 0.00f, 0.50f, 0.50f }, 0.50f, 10.0f, 15.0f, 1000.0f },
  { "walk",   "4 такта, duty 0.75, подъём BL-FL-BR-FR",
    { 0.00f, 0.50f, 0.25f, 0.75f }, 0.75f, 12.0f, 18.0f, 2400.0f },
  { "gallop", "rotary, сдвиг внутри пар",
    { 0.00f, 0.10f, 0.60f, 0.50f }, 0.40f,  8.0f, 12.0f,  900.0f },
};
static const uint8_t GAIT_COUNT = sizeof(GAITS) / sizeof(GAITS[0]);
uint8_t gaitIdx = 0;

/*
 * РАЗВОРОТ ЧЕРЕЗ ХИПЫ.
 *
 * Разворот влево (против часовой, вид сверху) означает, что относительно
 * корпуса стопы в опоре идут ПО часовой: передние вправо, задние влево.
 * По соглашению «хип + = наружу от корпуса» это даёт диагональный узор:
 *
 *     FR наружу (+)   FL внутрь (-)
 *     BR внутрь (-)   BL наружу (+)
 *
 * Проверка вывода. Корпус поворачивается CCW, значит опорные стопы идут
 * относительно корпуса ПО часовой: скорость точки (x,y) равна (y, -x).
 *   FR (x>0,y<0): вбок -y = вправо = НАРУЖУ для правой ноги  -> хип растёт
 *   FL (x>0,y>0): вбок -y = вправо = ВНУТРЬ  для левой ноги  -> хип падает
 *   BR (x<0,y<0): вбок +y = влево  = ВНУТРЬ  для правой ноги -> хип падает
 *   BL (x<0,y>0): вбок +y = влево  = НАРУЖУ  для левой ноги  -> хип растёт
 * Узор диагональный — и это совпадает с диагональностью самих знаков хипов
 * (CALIBRATION.md §2.1.7). Ошибка в знаке хипа вылезет здесь сразу.
 *
 * ЧТО БУДЕТ ВИДНО НА СТЕНДЕ И НЕ ЯВЛЯЕТСЯ ОШИБКОЙ. При duty 0.5 (trot, pace,
 * bound) опора и перенос — зеркальные половины, поэтому у ног в противофазе
 * знак ноги и знак фазы взаимно сокращаются, и ВСЕ ЧЕТЫРЕ ХИПА ПОКАЗЫВАЮТ
 * ОДНО И ТО ЖЕ ЧИСЛО. Со стороны это выглядит как боковое качание корпуса,
 * а не как разворот. Так и должно быть: момент создают только две опорные
 * ноги, а их стопы в этот миг идут в разные стороны. Чтобы разворот было
 * ВИДНО, смотреть его на walk (duty 0.75), где все четыре ноги в разных
 * фазах.
 *
 * ОСТОРОЖНО С АМПЛИТУДОЙ. Ход хипов НЕСИММЕТРИЧЕН: наружу 49…54°, а внутрь
 * всего 17…21° (ch9 -16.7° — самый тесный). Симметричный размах вокруг нуля
 * ограничен именно внутренней стороной. Предполётная проверка это ловит,
 * но держать AMP_HIP выше 8° смысла нет.
 *
 * НА ВЫВЕШЕННОМ РОБОТЕ РАЗВОРОТ НИЧЕГО НЕ РАЗВОРАЧИВАЕТ. Проверяется ровно
 * одно: что хипы ходят в нужную сторону и не выходят за предел.
 */
static const float TURN_SIGN[LEG_COUNT] = {
  /* FR */ +1.0f, /* FL */ -1.0f, /* BR */ -1.0f, /* BL */ +1.0f
};

/*
 * ДВА ОГРАНИЧИТЕЛЯ СКОРОСТИ, И ЭТО НАМЕРЕННО.
 *
 * RAMP_RATE_DPS — выход в позу. Движение начинается из НЕИЗВЕСТНОГО положения
 *   (обесточенное серво повисло там, куда его увела гравитация), поэтому оно
 *   обязано быть медленным всегда. Не настраивается.
 *
 * pMaxRateDps — походка. Здесь положение известно и траектория непрерывна,
 *   так что медленно двигаться незачем, а вот НЕ УСПЕТЬ за траекторией —
 *   вредно: ограничитель срежет амплитуду, фазы поедут, и узор станет не тем,
 *   который задали. На весу это легко принять за ошибку карты каналов.
 *
 * По умолчанию оба 100°/с — ровно то, что давали прежние 2°/тик при тике 20 мс.
 * Единица теперь ГРАДУС В СЕКУНДУ, а не градус за тик: тик менялся уже дважды,
 * и при старой единице каждое такое изменение молча меняло бы и скорость. Для QY3240MG это очень скромно, но поднимать его вслепую
 * нельзя: паспорта на серво нет, скорость не измерялась. Предполётная проверка
 * печатает, сколько на самом деле требуется; поднимает это оператор командой 'm'
 * либо ищет предел железа режимом разгона 'z'.
 */
static const float RAMP_RATE_DPS = 100.0f;  // выход в позу, НЕ настраивается
float pMaxRateDps                = 100.0f;  // походка, команда 'm'
static const float RATE_CEILING_DPS = 600.0f;  // потолок разгона, см. 'z' 
static const float RAMP_MS        = 2000.0f;// время выхода в стартовую позу
/*
 * ПЛАВНЫЙ ВЫХОД В ПОЗУ — ревизия 2026-09-27 («собака подпрыгивает при подъёме»).
 *
 * БЫЛО. Каждый сустав шёл к цели САМ ПО СЕБЕ с постоянной скоростью
 * RAMP_RATE_DPS: разгон мгновенный, остановка мгновенная, и суставы с малым
 * ходом приезжали раньше остальных. Бедро успевало встать, колено ещё
 * разгибалось в одиночку, и в конце весь корпус тормозил ударом — на
 * опоре это и выглядит как подскок.
 *
 * СТАЛО. Все двенадцать суставов идут ОДНОВРЕМЕННО по одному профилю
 * минимального рывка s(t) = 10t^3 - 15t^4 + 6t^5: старт и финиш с нулевой
 * скоростью И нулевым ускорением, все суставы начинают и заканчивают вместе.
 * Длительность считается так, чтобы ПИКОВАЯ скорость самого дальнего сустава
 * не превысила RAMP_RATE_DPS (у профиля пик = 1.875 x средней). То есть
 * ограничение по скорости прежнее, меняется только форма движения.
 * Ограничитель slewToTargets остаётся как страховка поверх профиля.
 *
 * ЧЕГО ЭТО НЕ ЛЕЧИТ. Самый первый импульс после взвода: серво не сообщают
 * своё положение, curAngle при старте — нули, и первый кадр ШИМ всё равно
 * дёрнет суставы из того места, куда их уронила гравитация. Это физика
 * ШИМ-серво без обратной связи, программно не снимается.
 */
static const float RAMP_PROFILE_PEAK = 1.875f;   // max ds/dt профиля 10-15-6
static const float RAMP_MIN_MS       = 800.0f;   // даже короткий ход — не быстрее

/*
 * ПОЗА «ЛЁЖА» — ревизия 2026-09-27. Робот лежит на брюхе, ноги сложены:
 * бедро отведено назад, колено сложено почти до упора, голень лежит на полу
 * стопой вперёд.
 *
 * ЗАЧЕМ. ШИМ-серво не сообщают своё положение. Прошивка считала, что при
 * взводе суставы стоят в НУЛЯХ (нога прямая вниз), и первый кадр ШИМ отправлял
 * туда всё сразу, на полном моменте: колено из ~140° в 0° за один кадр.
 * У лежащего робота это толчок всеми четырьмя ногами в пол — подскок.
 * Теперь стартовое допущение — эта поза, и первый кадр почти не двигает ноги.
 *
 * ИСТОЧНИК ЧИСЕЛ: оценка по фотографиям оператора 2026-09-27 (сбоку, сверху,
 * спереди). Это КАНДИДАТ, НЕ ЗАМЕР. Разрешение фото около ±5..10°.
 * По фото колено сложено ДАЛЬШЕ программного предела (144..151° против окна
 * 138.8..144.2°), поэтому цель клампится в окно канала — на первом кадре
 * колено чуть разогнётся, это ожидаемо и безопасно.
 * ПРОВЕРКА: см. «ПОЗА ЛЁЖА — ПРОВЕРКА» в CALIBRATION.md.
 *
 * START_LYING = false — старое поведение (стартовое допущение — нули). Нужно,
 * если робот при взводе ВЫВЕШЕН: висящие ноги ближе к нулям, чем к позе лёжа.
 */
static const bool  START_LYING     = true;
static const float REST_HIP_DEG    =    0.0f;   // КАНДИДАТ, фото спереди
static const float REST_THIGH_DEG  =  -40.0f;   // КАНДИДАТ, фото сбоку
static const float REST_KNEE_DEG   =  140.0f;   // КАНДИДАТ, клампится в окно
// Подъём с пола идёт в два этапа, см. rampPlanVia().
static const float VIA_MIN_DZ_MM   =   25.0f;   // меньше — промежуточной точки нет
static const float VIA_MIN_DX_MM   =   10.0f;
static const uint32_t ARM_MS      = 5000;   // обратный отсчёт до первого ШИМ
/*
 * ТИК. Был 20 мс (50 Гц), стал 3 мс (333 Гц) — ревизия 2026-08-28.
 *
 * Потолок осмысленного здесь задаёт не процессор и не шина, а ЧАСТОТА ШИМ.
 * При 330 Гц кадр длится 3.03 мкс… точнее 3.03 МС, и серво физически не может
 * увидеть больше одного нового положения за кадр. Обновляться быстрее — значит
 * писать в регистры, которые перезапишутся, не успев отработать.
 *
 * Тик 3 мс и кадр 3.03 мс не кратны, и это НОРМАЛЬНО: они медленно расходятся
 * по фазе, изредка два обновления попадают в один кадр (одно теряется), изредка
 * кадр остаётся без обновления. Средняя частота выдачи от этого не страдает.
 * Подгонять тик под кадр бессмысленно — генератор PCA9685 не синхронизирован
 * с кварцем ESP32 и всё равно уплывёт.
 *
 * Бюджет тика проверяется НА ЖЕЛЕЗЕ, а не на глаз: pcaFlush() замеряет время
 * посылки, а loop() считает пропущенные тики. И то и другое печатается в 's'.
 */
static const uint16_t TICK_MS     = 3;

// Сколько полных циклов делает 'w'. Меняется с клавиатуры: '1'…'9' или 'c N'.
static const uint8_t WALK_CYCLES_DEFAULT = 2;
uint8_t walkCycles = WALK_CYCLES_DEFAULT;

static const char* LEG_NAME[LEG_COUNT] = { "FR", "FL", "BR", "BL" };
static const char* JOINT_NAME[JOINT_PER_LEG] = { "HIP", "THIGH", "KNEE" };

// Взять пресет выбранной походки в действующие параметры.
void loadGaitPreset() {
  pDuty     = GAITS[gaitIdx].duty;
  pAmpThigh = GAITS[gaitIdx].ampThigh;
  pAmpKnee  = GAITS[gaitIdx].ampKnee;
  pCycleMs  = GAITS[gaitIdx].cycleMs;
  // В декартовом режиме duty и период — ВЫВОДИМЫЕ величины: их задают
  // скорость 'V' и время переноса 'W'. Пресет их бы перетёр, и оператор
  // получил бы период, которого не заказывал. Из походки берём только фазы.
  extern void recalcCartesianTiming();
  recalcCartesianTiming();
}

// ===========================================================================
Adafruit_PWMServoDriver pwm = Adafruit_PWMServoDriver(SPOTTY_PCA_ADDR);

// ---------------------------------------------------------------------------
// СЫРЫЕ РЕГИСТРЫ PCA9685 — гашение выходов помимо библиотеки.
//
// ЗАЧЕМ. Перезаливка сбрасывает ESP32, но НЕ сбрасывает PCA9685: он остаётся
// под питанием со СТАРЫМ содержимым регистров ШИМ от предыдущего скетча.
// Adafruit_PWMServoDriver::begin() внутри себя делает reset (бит RESTART
// восстанавливает прежние скважности) и ставит 1000 Гц. Старые счётчики,
// снятые на 330 Гц, при 1000 Гц дают импульс втрое короче: 1500 мкс
// превращаются примерно в 495 мкс — серво срывает к краю хода, каждое в свою
// сторону. Это и есть «извернулся в разные стороны» на старте.
//
// ЛЕКАРСТВО. Погасить ВСЕ выходы битом full-off ДО pwm.begin(), тогда RESTART
// восстанавливать нечего, и окно 1000 Гц проходит вхолостую. Повторить после
// begin() и после setPWMFreq() — дёшево и снимает вопрос совсем.
//
// ALL_LED_* — широковещательные регистры, пишут разом во все 16 каналов,
// включая неиспользуемые 3, 7, 11, 15.
// ---------------------------------------------------------------------------
// ===========================================================================
// БЫСТРЫЙ ПУТЬ ЗАПИСИ В PCA9685 — добавлено 2026-08-28
// ---------------------------------------------------------------------------
// ЗАЧЕМ. Adafruit_PWMServoDriver::writeMicroseconds() перед КАЖДОЙ записью
// делает readPrescale() — то есть чтение по I2C. На двенадцать суставов это
// двенадцать чтений плюс двенадцать записей на каждый тик, да ещё арифметика
// в double. При тике 20 мс это терпимо, при тике 3 мс — нет.
//
// ЧТО ДЕЛАЕМ. Делитель читается ОДИН РАЗ при старте, из него считается длина
// такта в микросекундах, а дальше только записи. Каналы лежат подряд, и
// PCA9685 умеет автоинкремент регистров, поэтому все двенадцать уходят
// четырьмя посылками: 0..2, 4..6, 8..10, 12..14. Свободные каналы 3, 7, 11, 15
// в эти посылки не попадают и остаются погашенными.
//
// ЧЕМ ЭТО ОПАСНО И КАК ЗАКРЫТО. Вся калибровка снята через формулу библиотеки.
// Своя формула обязана давать ПОБИТОВО ТО ЖЕ ЧИСЛО ТАКТОВ, иначе поедут все
// двенадцать нулей разом. Поэтому:
//   - арифметика повторена буквально, включая double и усечение при
//     присвоении (библиотека передаёт double в uint16_t параметр setPWM);
//   - при старте выполняется сверка по всему рабочему окну 520…2380 мкс:
//     для каждого целого значения микросекунд наша формула сравнивается с
//     формулой библиотеки. Расхождение хотя бы в одном такте запрещает взвод.
// ===========================================================================
static const uint8_t PCAREG_LED0_ON_L = 0x06;   // дальше по 4 регистра на канал

double   pcaUsPerTick = 0.0;    // длина одного такта ШИМ, мкс
uint8_t  pcaPrescale  = 0;      // прочитан из драйвера один раз
bool     pcaFastReady = false;  // сверка с библиотекой пройдена
bool     pcaAlive     = false;  // PCA9685 ответил на шине (setup)

// Микросекунды -> такты. Повторяет Adafruit_PWMServoDriver::writeMicroseconds
// буква в букву, но без обращения к шине.
static inline uint16_t usToTicksBase(uint16_t us) {
  double pulse = us;
  pulse /= pcaUsPerTick;
  return (uint16_t)pulse;        // усечение — ровно как при передаче в setPWM
}

// Рабочий путь: то же плюс поправка на генератор (spotty_osc.h), 2026-09-26.
// Умножение стоит ДО усечения. При K = 1.0 результат побитово равен
// usToTicksBase — сверка с библиотекой ниже идёт именно по нему.
static inline uint16_t usToTicks(uint16_t us) {
  double pulse = us;
  pulse /= pcaUsPerTick;
  pulse *= spottyOscK;
  return (uint16_t)pulse;
}

// Непрерывный участок каналов одной посылкой.
static void pcaWriteRun(uint8_t firstCh, uint8_t count, const uint16_t *ticks) {
  Wire.beginTransmission(SPOTTY_PCA_ADDR);
  Wire.write(PCAREG_LED0_ON_L + 4 * firstCh);
  for (uint8_t i = 0; i < count; i++) {
    Wire.write(0x00);                       // ON_L
    Wire.write(0x00);                       // ON_H
    Wire.write(ticks[i] & 0xFF);            // OFF_L
    Wire.write(ticks[i] >> 8);              // OFF_H
  }
  Wire.endTransmission();
}

static const uint8_t PCAREG_ALL_LED_ON_L  = 0xFA;
static const uint8_t PCAREG_ALL_LED_ON_H  = 0xFB;
static const uint8_t PCAREG_ALL_LED_OFF_L = 0xFC;
static const uint8_t PCAREG_ALL_LED_OFF_H = 0xFD;
static const uint8_t PCABIT_FULL_OFF      = 0x10;   // бит 4 регистра OFF_H

static void pcaWrite8(uint8_t reg, uint8_t val) {
  Wire.beginTransmission(SPOTTY_PCA_ADDR);
  Wire.write(reg);
  Wire.write(val);
  Wire.endTransmission();
}

static void pcaAllOutputsOff() {
  pcaWrite8(PCAREG_ALL_LED_ON_L,  0x00);
  pcaWrite8(PCAREG_ALL_LED_ON_H,  0x00);
  pcaWrite8(PCAREG_ALL_LED_OFF_L, 0x00);
  pcaWrite8(PCAREG_ALL_LED_OFF_H, PCABIT_FULL_OFF);
}

enum Mode { MODE_IDLE, MODE_ARM, MODE_RAMP, MODE_WALK, MODE_HOLD };
Mode mode = MODE_IDLE;

float curAngle[LEG_COUNT][JOINT_PER_LEG];   // текущий выданный угол
float tgtAngle[LEG_COUNT][JOINT_PER_LEG];   // цель на этом тике
bool  havePose = false;                     // выходили ли уже в позу
bool  engaged  = false;                     // прошёл ли взвод; до него ШИМ нет
unsigned long tickAt = 0, walkT0 = 0, rampT0 = 0, armT0 = 0;
float rampFrom[LEG_COUNT][JOINT_PER_LEG];      // откуда начался выход в позу
float rampDurMs = RAMP_MIN_MS;                  // сколько он длится
float rampGoal[LEG_COUNT][JOINT_PER_LEG];      // конечная цель, если идём через точку
bool  rampViaActive = false;                    // сейчас идёт первый этап из двух
bool  rampToRest    = false;                    // 'l': укладка, по окончании havePose=false
void  trickAbort();                             // трюки, см. ТРЮКИ ниже
bool  trickNext(unsigned long now);
int   armLeftPrinted = -1;
Mode  afterRamp = MODE_HOLD;
bool  tablesOk = false;                     // результат самопроверки в setup()
uint16_t pendingTicks[16];                  // кадр, накопленный за тик
float    gaitDone = 0.0f;                   // накопленные циклы походки
float    walkStopAt = 1e9f;                 // досрочный конец прогона (потеря пульта), в циклах
float    peakRateDps(float cycleMs);        // объявление: нужно в status()
bool     speedRamping = false;              // идёт поиск предела скорости, 'z'
uint32_t rampLastCycle = 0;
static const uint8_t SPEEDRAMP_EVERY = 2;   // ускоряться раз в столько циклов
static const float   SPEEDRAMP_FACTOR = 0.88f;   // во столько раз короче период
static const float   SPEEDRAMP_MIN_MS = 250.0f;

// ---------------------------------------------------------------------------
// Пределы сустава в градусах берутся из spotty_config.h (spottyAngleLimits) и
// УЖЕ включают запас SPOTTY_LIMIT_MARGIN_DEG. Локальной копии расчёта здесь
// больше нет: два независимых расчёта предела — это два разных предела.
// ---------------------------------------------------------------------------

// ===========================================================================
// ГЕНЕРАТОР ТРАЕКТОРИИ
// ---------------------------------------------------------------------------
// Возвращает ВСЕ ТРИ угла ноги разом. Раздельно нельзя: в плоском режиме
// бедро и колено связаны через одно и то же решение обратной задачи, и считать
// его дважды — значит однажды посчитать по-разному.
//
//   опора  0 .. duty   — виртуальная нога уходит назад (корпус едет вперёд);
//   перенос duty .. 1  — возвращается вперёд, стопа поднята.
//
// ДВА РЕЖИМА, переключатель 'f':
//   ДУГА (pFlatPath = false). Бедро качается вокруг позы приседа, колено
//     держит присед и доп. сгибается в переносе. Никакой модели звеньев,
//     ничего не допускается. Стопа ходит по дуге радиуса ρ0 вокруг оси хипа,
//     то есть по краям хода поднимается. Опустив робота на пол, получили бы
//     вертикальную раскачку корпуса.
//   ПЛОСКАЯ (pFlatPath = true). Ведётся угол ВИРТУАЛЬНОЙ ноги ψ, а длина
//     подбирается так, чтобы стопа шла по горизонтали: ρ = ρ0/cos ψ.
//     Колено при этом слегка разгибается к краям хода. Требует ОТНОШЕНИЯ
//     звеньев, см. большой комментарий выше.
//
// Разница между режимами растёт как (1 − cos ψ): при размахе ±12° это около
// 2% длины ноги и глазом почти не видна, при ±25° уже около 9% и видна ясно.
// Смотреть сравнение имеет смысл на БОЛЬШОМ размахе.
// ===========================================================================
// Форма хода в долях размаха: +1 в начале опоры, -1 в конце. Вынесена
// отдельно, потому что нужна ещё и предполётной проверке — сглаженный профиль
// ВЫХОДИТ за ±1, и предельный размах приходится искать численно.
float sweepAt(bool stance, float t, float d) {
  if (stance) return 1.0f - 2.0f * t;
  if (!pSmoothSwing) return 2.0f * t - 1.0f;
  const float m = -(1.0f - d) / d;
  const float h = (m - 1.0f) * (2.0f * t * t * t - 3.0f * t * t) + m * t;
  return 2.0f * h - 1.0f;
}

// Наибольший модуль хода за цикл. У линейного профиля ровно 1.0, у сглаженного
// больше: при duty 0.40 на 16%, при 0.50 на 8.9%, при 0.75 на 1.4%.
float maxSweepFactor() {
  float mx = 0.0f;
  for (int k = 0; k <= 400; k++) {
    float ph = (float)k / 400.0f;
    bool  st = (ph < pDuty);
    float t  = st ? (ph / pDuty) : ((ph - pDuty) / (1.0f - pDuty));
    mx = fmaxf(mx, fabsf(sweepAt(st, t, pDuty)));
  }
  return mx;
}

void gaitPoseAngular(uint8_t leg, float phase, float out[JOINT_PER_LEG]) {
  phase -= floorf(phase);
  const float d = pDuty;
  const bool  stance = (phase < d);
  const float t = stance ? (phase / d) : ((phase - d) / (1.0f - d));

  /*
   * ХОД ВИРТУАЛЬНОЙ НОГИ, от +1 в начале опоры к -1 в конце.
   *
   * ОПОРА ВСЕГДА ЛИНЕЙНА, и это не лень. Стопа стоит на земле, значит её
   * скорость относительно корпуса — это и есть скорость корпуса над землёй.
   * Сгладить опору = заставить корпус разгоняться и тормозить на каждом шаге.
   *
   * ПЕРЕНОС, профиль 0 (линейный). Скорость меняет знак мгновенно: в конце
   * опоры стопа идёт назад, в начале переноса сразу вперёд. Ускорение в этой
   * точке бесконечно, редуктор получает удар. На слух это щелчок.
   *
   * ПЕРЕНОС, профиль 1 (сглаженный). Кубика Эрмита со СТЫКОВКОЙ ПО СКОРОСТИ:
   *   h(0)=0, h(1)=1, h'(0)=h'(1)=m,  m = -(1-d)/d
   * где m — скорость опоры, пересчитанная в единицы переноса. Тогда на обоих
   * стыках скорость непрерывна, разрыва нет вовсе.
   *   h(s) = (m-1)(2s³ - 3s²) + m·s
   *
   * Цена: стопа в начале переноса ещё немного едет НАЗАД (догоняет скорость
   * опоры), а в конце немного назад же перед касанием. Выглядит как лёгкий
   * замах и это физически правильно — так гасят проскальзывание при касании.
   * Ход при этом выходит за ±1 процентов на пять, поэтому предельный размах
   * предполётная проверка ищет численно, а не по формуле.
   *
   * ЦЕНА ПО СКОРОСТИ — ИЗМЕРЕНА, И ОНА ЗАВИСИТ ОТ ТРАЕКТОРИИ.
   * Ожидание было «пик вдвое выше, ведь тот же ход надо пройти за то же время
   * с нулевой скоростью по краям». Замер (присед 60°, пик по суставу, °/с):
   *
   *              размах ±8    ±12          ±20
   *   ДУГА       0%          +2%          +70%   (duty 0.50)
   *              0%           0%          +18%   (duty 0.75)
   *   ПЛОСКАЯ  -10%         -10%          -17%   (duty 0.50)
   *            -14%         -17%          -28%   (duty 0.75)
   *
   * Правило: на ПЛОСКОЙ траектории сглаженный профиль всегда ДЕШЕВЛЕ, на дуге
   * дорожает по мере роста размаха.
   *
   * Почему так. Пик держит не ход бедра, а КОЛЕНО. На плоской траектории колено
   * несёт сразу и подъём, и поправку на вытягивание; у линейного профиля оба
   * максимума приходятся на момент отрыва и складываются, у сглаженного оба
   * там равны нулю по построению и разъезжаются по фазе. На дуге колено занято
   * только подъёмом, складывать нечего, и при большом размахе остаётся голая
   * прибавка к пику самого хода.
   */
  const float sweep = sweepAt(stance, t, d);

  /*
   * ПОДЪЁМ СТОПЫ, только в переносе.
   * Профиль 0: sin(pi·t) — ноль по краям, но производная на отрыве равна pi,
   *            то есть стопа стартует вверх рывком.
   * Профиль 1: (1-cos(2pi·t))/2 — ноль И по значению, И по производной на
   *            обоих краях. Пик тот же, максимальная скорость та же pi.
   *            Чистое улучшение, платить нечем.
   */
  const float lift = stance ? 0.0f
                   : (pSmoothSwing ? (1.0f - cosf(2.0f * PI * t)) * 0.5f
                                   : sinf(PI * t));

  // ---- ХИП -----------------------------------------------------------------
  // ВНИМАНИЕ НА ЗНАК. Форма ОБРАТНА бедру: в ОПОРЕ хип идёт от -1 к +1.
  // Так и должно быть — толкает корпус именно опорная фаза, и она обязана
  // идти в сторону TURN_SIGN. Первая редакция копировала форму бедра и потому
  // разворачивала робота В ПРОТИВОПОЛОЖНУЮ сторону от заказанной.
  out[JOINT_HIP] = (pTurn == 0)
      ? POSE_HIP_DEG
      : POSE_HIP_DEG + pAmpHip * (-sweep) * TURN_SIGN[leg] * (float)pTurn;

  // ---- БЕДРО И КОЛЕНО ------------------------------------------------------
  // Трим вычитается из угла виртуальной ноги: стопа уезжает НАЗАД под корпус,
  // то есть корпус едет ВПЕРЁД. Одинаково у всех четырёх ног, поэтому даёт
  // сдвиг, а не наклон.
  if (pFlatPath) {
    const float psi = pAmpThigh * sweep - pTrimDeg;      // угол виртуальной ноги
    float rho = stanceReach() / cosf(radians(psi));      // вытянуться до прямой
    rho -= liftRho * lift;                               // и подобрать в переносе
    const float knee = kneeForReach(rho);
    out[JOINT_KNEE]  = knee;
    out[JOINT_THIGH] = psi - alphaOf(knee);
  } else {
    out[JOINT_THIGH] = stanceThighDeg() + pAmpThigh * sweep - pTrimDeg;
    out[JOINT_KNEE]  = pCrouchDeg       + pAmpKnee  * lift;
  }
}

/* ===========================================================================
 * ДЕКАРТОВ ДВИЖОК. Порт OpenQuadruped, разбор происхождения — oq_gait.h.
 * ---------------------------------------------------------------------------
 * Путь величин, слева направо:
 *
 *   фаза [0,1) --> Planner --> (опора?, t) --> безье --> (x вдоль хода, z вниз)
 *        --> поворот на pCrabDeg --> (вперёд, влево)
 *        --> поза корпуса (сдвиг, крен, [тангаж, рыскание]) --> вектор хип→стопа
 *        --> legIK --> три угла --> наверх, в тот же кламп, что и у углового
 *
 * ЧТО ЗДЕСЬ ЛУЧШЕ УГЛОВОГО ДВИЖКА, честно и по пунктам:
 *
 *   1. Шаг, подъём и высота заданы в миллиметрах. Их можно проверить
 *      рулеткой, а «размах бедра ±12°» проверить нечем.
 *   2. Перенос идёт по двенадцатиточечному безье с кратными узлами: скорость
 *      стопы на отрыве и на касании равна нулю ПО ПОСТРОЕНИЮ. У углового
 *      движка sin(pi*t) даёт на отрыве производную pi — тот самый щелчок.
 *   3. Скорость корпуса — параметр (pVelMmS), а не следствие периода.
 *   4. Поза корпуса вместо трима в градусах виртуальной ноги.
 *
 * ЧЕГО ЭТО НЕ ДАЁТ. Нули суставов (M9) сюда входят снаружи и выходят наружу
 * нетронутыми. Разворот робота и упор на ch13 — разностные ошибки нулей;
 * миллиметры делают их ЧИТАЕМЫМИ, но не убирают. Порядок работ не меняется:
 * сначала M9, потом всё остальное.
 *
 * ТАЙМИНГ. pCycleMs и pDuty остаются главными часами — их читают и цикл
 * хода, и предполётная. В декартовом режиме они не задаются напрямую, а
 * ВЫВОДЯТСЯ из скорости и времени переноса (recalcCartesianTiming), чтобы
 * не было двух источников правды.
 * =========================================================================== */

// T_stance = 2*L_span/V. Отсюда период и duty — тем же двум переменным,
// которые уже читает весь остальной скетч.
void recalcCartesianTiming() {
  if (pEngine != 1) return;
  float tStance = (pVelMmS > 1e-3f) ? (2000.0f * pSpanMm / pVelMmS) : 1000.0f;
  if (tStance <  50.0f) tStance =  50.0f;
  if (tStance > 8000.0f) tStance = 8000.0f;
  float tSwing = pSwingMs;
  if (tSwing < 50.0f) tSwing = 50.0f;
  pCycleMs = tStance + tSwing;
  pDuty    = tStance / pCycleMs;
}

// Кривые перестраиваются только когда изменилась их форма: на каждом тике
// это 200 вычислений безье в clearanceForLift, и в цикле хода им не место.
static oq::SwingCurve  cartSwing;
static oq::StanceCurve cartStance;
static float cartCacheSpan = -1.0f, cartCacheH = -1.0f;
static float cartCacheLift = -1.0f, cartCachePen = -1.0f;

void recalcCartesianCurves() {
  if (pSpanMm == cartCacheSpan && pHeightMm == cartCacheH &&
      pLiftMm == cartCacheLift && pPenetMm == cartCachePen) return;
  const float cl = oq::clearanceForLift(pLiftMm, pSpanMm, pHeightMm);
  oq::swingFromParam(cartSwing, pSpanMm, pHeightMm, cl);
  // Квадратичный безье в середине даёт ПОЛОВИНУ смещения средней точки,
  // поэтому чтобы продав был pPenetMm, точку надо опустить вдвое ниже.
  oq::stanceFromParam(cartStance, pSpanMm, pHeightMm, 2.0f * pPenetMm);
  cartCacheSpan = pSpanMm; cartCacheH    = pHeightMm;
  cartCacheLift = pLiftMm; cartCachePen  = pPenetMm;
}

/* ===========================================================================
 * ПЕРЕНОС КОРПУСА ПО ФАЗЕ — добавлено 2026-09-12
 * ---------------------------------------------------------------------------
 * ЗАЧЕМ. В шаге (duty 0.75) в переносе ровно одна нога, три оставшиеся держат
 * треугольник. Стопы стоят по углам ПРЯМОУГОЛЬНИКА, поэтому его диагональ
 * проходит ТОЧНО через центр — то есть через проекцию корпуса, если корпус не
 * двигать. Запас устойчивости при этом равен нулю не приближённо, а
 * тождественно: центр лежит НА стороне опорного треугольника. Это арифметика
 * прямоугольника, а не результат опыта, и никакой настройкой походки —
 * высотой, шагом, темпом, подъёмом — она не лечится.
 *
 * КУДА И НАСКОЛЬКО — тоже арифметика. Самая удалённая от всех трёх сторон
 * точка треугольника есть ИНЦЕНТР (центр вписанной окружности). Для
 * прямоугольного треугольника со сторонами 2a и 2b он отстоит от центра
 * прямоугольника на
 *      |dy| = sqrt(a*a + b*b) - a,   a = полупродольная база стоп,
 *                                    b = полупоперечная база стоп.
 * Подобранных коэффициентов здесь нет и быть не должно: как только измерят
 * базу, число получится само.
 *
 * ЗНАК берётся не из таблицы, а из САМОЙ ПОХОДКИ: на каждом узле смотрим,
 * какие ноги в переносе, и уезжаем в противоположную сторону. Для 'walk' это
 * даёт трапецию (-A -A -A -A +A +A +A +A): первую половину цикла переносятся
 * левые (BL, затем FL), вторую — правые. Для 'trot' — тождественный ноль:
 * переносятся обе стороны сразу, сдвигать некуда. Таблица физически не может
 * разойтись с фазировкой, потому что она из неё и получена.
 *
 * ПЕРЕХОДЫ. Узлов восемь, между ними линейная интерполяция, поэтому
 * перекладка занимает 1/8 цикла и приходится ровно на конец переноса
 * предыдущей пары: корпус успевает приехать к моменту, когда поднимается
 * следующая нога. Ступеньки нет — ступеньку срезал бы ограничитель скорости,
 * и фазировка поехала бы.
 *
 * ПРОДОЛЬНОГО сдвига по фазе здесь НЕТ, и это не забывчивость. В симуляторе
 * (8 прогонов, разброс нулей +-3 градуса): без сдвига 7/8 дожили, путь -21 мм;
 * боковой +-12.8 мм — 7/8 и +81 мм; полная геометрия инцентра, то есть ВМЕСТЕ
 * с продольным сдвигом — 0/8. Продольная составляющая переносит корпус на
 * ногу, которая вот-вот поднимется.
 *
 * ПО УМОЛЧАНИЮ ВЫКЛЮЧЕНО. pShiftGain = 0, и пока оператор не подал 'B',
 * bodyShiftYAt возвращает ноль на первой же строке.
 *
 * ТРЕБУЕТ M4 — так же, как тангаж и рыскание. Формула опирается на
 * ПРОДОЛЬНУЮ базу, а она не измерена (BASE_LONG_MM = 0). При a = 0 она
 * вырождается в |dy| = b, то есть предложила бы увезти корпус на всю
 * полуширину — 49.75 мм. Поэтому без базы функция отказывает, а не
 * подставляет правдоподобное число.
 * ========================================================================= */
#define SHIFT_NODES 8

// Амплитуда бокового переноса, мм. 0 = посчитать не из чего (нет M4).
float bodyShiftAmpMm() {
  if (BASE_LONG_MM < 1.0f) return 0.0f;
  const float a = 0.5f * BASE_LONG_MM;
  const float b = 0.5f * BASE_LAT_MM + L_HIP_MM;   // стопа вынесена на L_HIP
  return sqrtf(a * a + b * b) - a;
}

// Сторона, в которую надо уехать в данной ГЛОБАЛЬНОЙ фазе: -1 вправо,
// +1 влево, 0 некуда. Ничего не запомнено: считается по фазам походки и duty.
float bodyShiftSide(float gphase) {
  const GaitDef &g = GAITS[gaitIdx];
  float swingLeft = 0.0f;
  for (uint8_t leg = 0; leg < LEG_COUNT; leg++) {
    float ph = gphase + g.phase[leg]; ph -= floorf(ph);
    if (ph >= pDuty) swingLeft += LEG_LEFT[leg];   // эта нога в переносе
  }
  return constrain(-swingLeft, -1.0f, 1.0f);       // уезжаем ОТ переносимых
}

// Боковой сдвиг корпуса в данной ГЛОБАЛЬНОЙ фазе, мм. Складывается со
// статическим pShiftYMm, а не заменяет его.
float bodyShiftYAt(float gphase) {
  if (pShiftGain <= 0.0f) return 0.0f;
  const float amp = bodyShiftAmpMm();
  if (amp <= 0.0f) return 0.0f;
  const float u = gphase - floorf(gphase);
  float fidx = u * (float)SHIFT_NODES;
  int   i0   = (int)fidx;
  if (i0 >= SHIFT_NODES) i0 = SHIFT_NODES - 1;     // страховка от u == 1-eps
  const int   i1   = (i0 + 1) % SHIFT_NODES;
  const float frac = fidx - (float)i0;
  const float s0 = bodyShiftSide((float)i0 / (float)SHIFT_NODES);
  const float s1 = bodyShiftSide((float)i1 / (float)SHIFT_NODES);
  return pShiftGain * amp * (s0 + (s1 - s0) * frac);
}

// Таблица так, как её видит цикл хода. Печатается по 'B', по 's' и в
// предполётной: оператор обязан видеть, куда именно поедет корпус, ДО того
// как это произойдёт.
void printShiftTable() {
  LOG.print("   узлы по фазе: ");
  for (int i = 0; i < SHIFT_NODES; i++)
    LOG.printf("%.2f:%+.1f ", (float)i / (float)SHIFT_NODES,
                  bodyShiftYAt((float)i / (float)SHIFT_NODES));
  LOG.println("мм  (+ влево)");
}

// Последние удачные углы: если IK откажет, выдаём их и поднимаем ikFail.
// Вызывающий обязан остановиться по флагу; подставленное значение нужно лишь
// затем, чтобы между отказом и остановом на серво не ушёл мусор.
static float cartLastGood[LEG_COUNT][JOINT_PER_LEG];
static bool  cartHaveGood[LEG_COUNT] = { false, false, false, false };

void gaitPoseCartesian(uint8_t leg, float phase, float out[JOINT_PER_LEG]) {
  recalcCartesianCurves();

  oq::Planner pl;
  pl.tStance = pDuty * pCycleMs;
  pl.tSwing  = (1.0f - pDuty) * pCycleMs;

  float t;
  const bool stance = pl.signal(phase, t);
  const oq::Pt fp = stance ? cartStance.sample(t) : cartSwing.sample(t);

  // Направление хода. ВНИМАНИЕ: это КРАБ, а не разворот — все четыре стопы
  // чертят путь в одну сторону света, корпус едет боком, сохраняя курс.
  // Настоящий разворот — ниже, через хипы, и он от этого независим.
  float fx, fyLeft;
  oq::rotateStep(fp.x, pCrabDeg, fx, fyLeft);

  oq::BodyPose bp;
  bp.baseLong = BASE_LONG_MM;
  bp.baseLat  = BASE_LAT_MM;
  bp.rollDeg  = pRollDeg;
  bp.pitchDeg = pPitchDeg;
  bp.yawDeg   = pYawDeg;
  /* ГЛОБАЛЬНАЯ фаза восстанавливается вычитанием фазы ноги, и это точно, а
     не приближённо: сюда всегда приходит (GAITS[gaitIdx].phase[leg] + фаза
     цикла) — так зовёт и цикл хода, и предполётная. Заводить отдельный
     параметр не стали намеренно: лишний аргумент пришлось бы протаскивать
     через диспетчер gaitPose, а с ним через угловой движок, которому сдвиг
     корпуса не нужен вовсе. Побочный эффект полезен: предполётная сканирует
     фазу ноги от 0 до 1, и каждая нога видит сдвиг в ПРАВИЛЬНОЙ привязке к
     собственному переносу, а не смещённый на её же фазу. */
  const float gphase = phase - GAITS[gaitIdx].phase[leg];
  bp.tx = pShiftXMm; bp.ty = pShiftYMm + bodyShiftYAt(gphase); bp.tz = 0.0f;

  float x, y, z;
  oq::hipToFoot(bp, LEG_FWD[leg], LEG_LEFT[leg],
                fx, fyLeft, L_HIP_MM, fp.z, x, y, z);

  float hip, thigh, knee;
  if (!legIK(x, y, z, hip, thigh, knee)) {
    if (!ikFail) { ikFail = true; ikFailLeg = leg; ikFailPhase = phase; }
    if (cartHaveGood[leg]) {
      for (uint8_t j = 0; j < JOINT_PER_LEG; j++) out[j] = cartLastGood[leg][j];
    } else {
      out[JOINT_HIP] = POSE_HIP_DEG; out[JOINT_THIGH] = 0.0f; out[JOINT_KNEE] = 0.0f;
    }
    return;
  }

  // Разворот через хипы — ровно как в угловом движке, включая знак: в ОПОРЕ
  // ход идёт от -1 к +1, потому что толкает корпус именно опорная фаза.
  // Аналог sweep здесь — положение стопы вдоль хода, нормированное на размах.
  const float sweepEq = (pSpanMm > 0.01f) ? (fp.x / pSpanMm) : 0.0f;
  out[JOINT_HIP]   = hip + ((pTurn == 0) ? 0.0f
                     : pAmpHip * (-sweepEq) * TURN_SIGN[leg] * (float)pTurn);
  out[JOINT_THIGH] = thigh;
  out[JOINT_KNEE]  = knee;

  for (uint8_t j = 0; j < JOINT_PER_LEG; j++) cartLastGood[leg][j] = out[j];
  cartHaveGood[leg] = true;
}

// ---------------------------------------------------------------------------
// ДИСПЕТЧЕР. Сигнатура прежняя, поэтому предполётная, цикл хода и выход в
// позу не знают, какой движок работает, и защитный слой не менялся вовсе.
// ---------------------------------------------------------------------------
void gaitPose(uint8_t leg, float phase, float out[JOINT_PER_LEG]) {
  if (pEngine == 1) gaitPoseCartesian(leg, phase, out);
  else              gaitPoseAngular  (leg, phase, out);
}

// ---------------------------------------------------------------------------
// Предполётная проверка: весь цикл целиком против измеренных пределов.
// Ни один канал не двигается, пока это не пройдено.
// ---------------------------------------------------------------------------
bool preflight(bool verbose) {
  int bad = 0, slow = 0;
  const GaitDef &g = GAITS[gaitIdx];
  recalcLift();                       // подъём зависит от приседа и от ampKnee
  if (pEngine == 1) { recalcCartesianTiming(); recalcCartesianCurves(); }
  ikFail = false;                     // взводим ловушку отказа IK на этот прогон

  // Шаг дискретизации равен тику: так проверяется ровно то, что будет выдано,
  // и заодно честно считается требуемая скорость сустава в градусах на тик.
  int steps = (int)(pCycleMs / TICK_MS);
  if (steps < 60)   steps = 60;
  if (steps > 1200) steps = 1200;   // дальше сетка уже гуще, чем нужно
                                    // производной; скорость всё равно в °/с

  if (verbose && pEngine == 1) {
    LOG.printf("\nПоходка '%s' — %s | ДВИЖОК ДЕКАРТОВ\n", g.name, g.note);
    LOG.printf("  фазы FR %.2f FL %.2f BR %.2f BL %.2f | duty %.2f | период %.0f мс%s\n",
                  g.phase[LEG_FR], g.phase[LEG_FL], g.phase[LEG_BR], g.phase[LEG_BL],
                  pDuty, pCycleMs,
                  pTurn ? (pTurn > 0 ? " | РАЗВОРОТ ВЛЕВО" : " | РАЗВОРОТ ВПРАВО") : "");
    // Печатаются ФАКТИЧЕСКИЕ миллиметры, снятые с построенной кривой, а не
    // заказанные: разойтись они не должны, и если разошлись — это видно тут.
    LOG.printf("  шаг ±%.1f мм | подъём %.1f мм | продав %.1f мм | высота %.1f мм | скорость %.0f мм/с\n",
                  pSpanMm, oq::swingPeakLift(cartSwing, pHeightMm),
                  oq::stancePeakDrop(cartStance, pHeightMm), pHeightMm, pVelMmS);
    LOG.printf("  корпус: сдвиг %+.1f/%+.1f мм, крен %+.1f°%s | ход %+.0f°%s\n",
                  pShiftXMm, pShiftYMm, pRollDeg,
                  (pPitchDeg != 0.0f || pYawDeg != 0.0f)
                    ? (SPOTTY_BASE_LONG_MEASURED ? ", тангаж/рыскание в работе"
                                                 : ", тангаж/рыскание ЗАПЕРТЫ (M4)") : "",
                  pCrabDeg, fabsf(pCrabDeg) > 1.0f ? " КРАБОМ" : "");
    LOG.printf("  звенья: бедро %.2f, голень %.2f, хип %.2f мм%s\n",
                  L_FEMUR_MM, L_TIBIA_MM, L_HIP_MM,
#if SPOTTY_LINKS_MEASURED
                  "  (подтверждены замером)");
#else
                  "  <- STL-КАНДИДАТЫ, движение заблокировано (M1/M2/M3)");
#endif
  } else if (verbose) {
    LOG.printf("\nПоходка '%s' — %s\n", g.name, g.note);
    LOG.printf("  фазы FR %.2f FL %.2f BR %.2f BL %.2f | duty %.2f | размах ±%.0f° | подъём %.0f° | период %.0f мс%s\n",
                  g.phase[LEG_FR], g.phase[LEG_FL], g.phase[LEG_BR], g.phase[LEG_BL],
                  pDuty, pAmpThigh, pAmpKnee, pCycleMs,
                  pTurn ? (pTurn > 0 ? " | РАЗВОРОТ ВЛЕВО" : " | РАЗВОРОТ ВПРАВО") : "");
    LOG.printf("  присед: колено %.0f°, бедро %.1f°, нога короче на %.0f%%; траектория %s; звенья k=%.2f%s\n",
                  pCrouchDeg, stanceThighDeg(),
                  100.0f * (1.0f - stanceReach() / (1.0f + linkRatio)),
                  pFlatPath ? "ПЛОСКАЯ" : "дуга", linkRatio,
                  fabsf(linkRatio - 1.0f) < 1e-3f ? " (ДОПУЩЕНИЕ, не замер)" : "");
  }

  // --- достижимость: хватает ли ноги на заданный размах ---------------------
  // Проверка осмысленна только в плоском режиме: в режиме дуги длина ноги
  // постоянна и вытягиваться ей не нужно.
  const float swLim  = sweepLimitDeg();
  const float swFact = maxSweepFactor();
  const float swReal = pAmpThigh * swFact + fabsf(pTrimDeg);  // ход + перелёт + трим
  if (pEngine == 1) {
    // В декартовом режиме досягаемость проверяет сама IK, точкой за точкой, и
    // проверяет строже: она видит и боковой вынос, и позу корпуса, чего
    // угловая прикидка по размаху не умеет в принципе.
  } else if (pFlatPath) {
    if (pCrouchDeg < 1.0f) {
      LOG.println("[!] Плоская траектория при ПРЯМОЙ ноге бессмысленна: вытягиваться");
      LOG.println("    некуда, режим вырождается в дугу. Задай присед: 'q 60'.");
    } else if (swReal > swLim - 0.5f) {
      LOG.printf("[!] Ход ±%.1f° больше, чем нога может дотянуться (±%.1f°).\n",
                    swReal, swLim);
      if (swFact > 1.01f)
        LOG.printf("    Задано ±%.0f°, но сглаженный профиль перелетает на %.0f%%.\n",
                      pAmpThigh, 100.0f * (swFact - 1.0f));
      LOG.println("    Стопа пойдёт не по прямой, а по дуге у краёв хода.");
      LOG.printf("    Лечится: 't' меньше, присед глубже ('q'), либо 'S 0'.\n");
    } else if (verbose) {
      LOG.printf("  запас по вытягиванию: ход ±%.1f° (задано ±%.0f°, перелёт %+.0f%%) из предельных ±%.1f°\n",
                    swReal, pAmpThigh, 100.0f * (swFact - 1.0f), swLim);
    }
  } else if (verbose && swFact > 1.01f) {
    LOG.printf("  сглаженный профиль: фактический ход ±%.1f° при заданных ±%.0f° (перелёт %.0f%%)\n",
                  swReal, pAmpThigh, 100.0f * (swFact - 1.0f));
  }

  // --- ОПОРНОСТЬ ------------------------------------------------------------
  // Считается по фазам, а не по железу: нога «в опоре», если её собственная
  // фаза не перевалила duty. На ВЫВЕШЕННОМ роботе это чистая арифметика и
  // ни на что не влияет. На ПОЛУ это решает всё.
  //
  // Два разных вопроса, и путать их нельзя:
  //   сколько ног на земле  — статическая устойчивость требует трёх;
  //   есть ли среди них И ПЕРЕДНЯЯ, И ЗАДНЯЯ — если нет, корпусу не на чем
  //     держать дифферент, и он валится носом вверх или вниз независимо
  //     ни от каких настроек.
  {
    const int NS = 720;
    int minLegs = 5, noFrontRear = 0, histLegs[5] = {0,0,0,0,0};
    for (int i = 0; i < NS; i++) {
      const float gph = (float)i / (float)NS;
      int n = 0; bool haveF = false, haveR = false;
      for (uint8_t leg = 0; leg < LEG_COUNT; leg++) {
        float ph = gph + g.phase[leg]; ph -= floorf(ph);
        if (ph >= pDuty) continue;                  // перенос
        n++;
        if (leg == LEG_FR || leg == LEG_FL) haveF = true; else haveR = true;
      }
      histLegs[n]++;
      if (n < minLegs) minLegs = n;
      if (!(haveF && haveR)) noFrontRear++;
    }
    const int pctNoFR = noFrontRear * 100 / NS;
    if (verbose)
      LOG.printf("  опора: минимум %d ног(и); доля цикла 1/2/3/4 ноги = %d/%d/%d/%d%%\n",
                    minLegs, histLegs[1]*100/NS, histLegs[2]*100/NS,
                    histLegs[3]*100/NS, histLegs[4]*100/NS);
    if (pctNoFR) {
      LOG.printf("[!!] %d%% цикла НЕТ ОДНОВРЕМЕННОЙ ОПОРЫ НА ПЕРЕДНЮЮ И ЗАДНЮЮ ногу.\n", pctNoFR);
      LOG.println("     На полу корпус в эти моменты держать дифферент нечем: он");
      LOG.println("     проваливается носом или кормой. Именно так выглядит");
      LOG.println("     «встаёт на задние лапы». Настройками это НЕ лечится —");
      LOG.println("     свойство самой фазировки. Только на весу.");
    } else if (minLegs < 3) {
      LOG.printf("[!] Минимум %d ноги на земле: статической устойчивости НЕТ,\n", minLegs);
      LOG.println("    нужна динамическая балансировка, а IMU в проекте отсутствует.");
      LOG.println("    Передняя и задняя опора есть всегда, так что дифферент держится.");
    } else if (verbose) {
      LOG.println("  статически устойчива: три ноги на земле, перед и зад всегда опёрты.");
    }

    /* ТРИ НОГИ — ЕЩЁ НЕ ЗАПАС. Стопы стоят по углам прямоугольника, поэтому
       диагональ опорного треугольника проходит РОВНО через центр: запас
       устойчивости тождественно нулевой, пока корпус не перенесён. Молчать
       об этом нельзя — «три ноги на земле» читается как «всё хорошо». */
    if (verbose && pEngine == 1 && minLegs == 3) {
      if (pShiftGain > 0.0f) {
        LOG.printf("  перенос корпуса по фазе включён: %+.1f мм от центра к инцентру\n",
                      pShiftGain * bodyShiftAmpMm());
        printShiftTable();
      } else {
        LOG.println("  [i] Запас устойчивости при неподвижном корпусе ТОЖДЕСТВЕННО НОЛЬ:");
        LOG.println("      диагональ опорного треугольника проходит через центр стоп.");
        LOG.printf("      Лечится переносом корпуса по фазе: 'B 1'%s\n",
                      bodyShiftAmpMm() > 0.0f ? "." : " — но сначала замер M4.");
      }
    }
  }

  // --- пределы и скорость по каждому суставу --------------------------------
  // Считаем ВСЕ ТРИ угла ноги одним вызовом: в плоском режиме бедро и колено
  // связаны, и раздельный расчёт дал бы несогласованную пару.
  //
  // Сканируем ВЕСЬ цикл от нуля фазы, а не от фазы ноги: множество значений
  // за полный цикл одно и то же, а сетка от нуля попадает точно в экстремумы
  // (фаза 0 и фаза duty) и не занижает размах. Точки стыка опоры и переноса
  // добавлены явно: при steps, не кратном 1/duty, сетка мимо них проходит.
  float worstLo[LEG_COUNT][JOINT_PER_LEG], worstHi[LEG_COUNT][JOINT_PER_LEG];
  float maxRate[LEG_COUNT][JOINT_PER_LEG], prev[LEG_COUNT][JOINT_PER_LEG];
  float a[JOINT_PER_LEG];

  for (uint8_t leg = 0; leg < LEG_COUNT; leg++) {
    gaitPose(leg, 0.0f, a);
    for (uint8_t j = 0; j < JOINT_PER_LEG; j++) {
      worstLo[leg][j] =  1e9f; worstHi[leg][j] = -1e9f;
      maxRate[leg][j] =  0.0f; prev[leg][j]    = a[j];
    }
  }

  const float edge[4] = { 0.0f, pDuty - 1e-4f, pDuty, 1.0f - 1e-4f };
  for (uint8_t leg = 0; leg < LEG_COUNT; leg++) {
    for (int k = 0; k <= steps; k++) {
      gaitPose(leg, (float)k / (float)steps, a);
      for (uint8_t j = 0; j < JOINT_PER_LEG; j++) {
        worstLo[leg][j] = fminf(worstLo[leg][j], a[j]);
        worstHi[leg][j] = fmaxf(worstHi[leg][j], a[j]);
        maxRate[leg][j] = fmaxf(maxRate[leg][j], fabsf(a[j] - prev[leg][j]));
        prev[leg][j] = a[j];
      }
    }
    for (int e = 0; e < 4; e++) {
      gaitPose(leg, edge[e], a);
      for (uint8_t j = 0; j < JOINT_PER_LEG; j++) {
        worstLo[leg][j] = fminf(worstLo[leg][j], a[j]);
        worstHi[leg][j] = fmaxf(worstHi[leg][j], a[j]);
      }
    }
  }

  // Перевод «градусов между соседними отсчётами» в ГРАДУСЫ В СЕКУНДУ.
  // Так величина не зависит ни от шага дискретизации, ни от длительности тика.
  const float sampleHz = (float)steps * 1000.0f / pCycleMs;
  for (uint8_t leg = 0; leg < LEG_COUNT; leg++)
    for (uint8_t j = 0; j < JOINT_PER_LEG; j++)
      maxRate[leg][j] *= sampleHz;

  for (uint8_t leg = 0; leg < LEG_COUNT; leg++) {
    for (uint8_t j = 0; j < JOINT_PER_LEG; j++) {
      uint8_t ch = SPOTTY_CH[leg][j];
      if (!spottyChUsed(ch)) continue;
      float lo, hi;
      spottyAngleLimits(ch, lo, hi);   // уже с запасом SPOTTY_LIMIT_MARGIN_DEG
      bool ok     = (worstLo[leg][j] >= lo) && (worstHi[leg][j] <= hi);
      bool rateOk = (maxRate[leg][j] <= pMaxRateDps);
      if (!ok)     bad++;
      if (!rateOk) slow++;
      if (verbose || !ok || !rateOk) {
        LOG.printf("%s %-5s ch%-2u  предел %7.1f..%7.1f  цикл %7.1f..%7.1f  запас %5.1f/%5.1f  %5.0f°/с  %s%s\n",
                      LEG_NAME[leg], JOINT_NAME[j], ch, lo, hi,
                      worstLo[leg][j], worstHi[leg][j],
                      worstLo[leg][j] - lo, hi - worstHi[leg][j], maxRate[leg][j],
                      ok ? "ok" : "ВЫХОД ЗА ПРЕДЕЛ",
                      rateOk ? "" : "  <- НЕ УСПЕВАЕТ, ограничитель срежет");
      }
    }
  }

  if (slow) {
    float need = 0.0f;
    for (uint8_t leg = 0; leg < LEG_COUNT; leg++)
      for (uint8_t j = 0; j < JOINT_PER_LEG; j++)
        if (spottyChUsed(SPOTTY_CH[leg][j])) need = fmaxf(need, maxRate[leg][j]);
    LOG.printf("[!] %d сустав(ов) требуют больше %.0f°/с. Ограничитель скорости\n", slow, pMaxRateDps);
    LOG.println("    срежет амплитуду, и фазировка поедет — узор будет НЕ ТОТ.");
    LOG.printf("    Нужно не менее %.0f°/с, сейчас разрешено %.0f°/с.\n", need, pMaxRateDps);
    if (pEngine == 1)
      LOG.printf("    Лечится: 'm %.0f', либо 'V' меньше (скорость), 'W' больше, 'C' меньше.\n", need * 1.1f);
    else
      LOG.printf("    Лечится: 'm %.0f', либо 'T' больше (период), 't'/'k' меньше.\n", need * 1.1f);
  }
  /* ОТКАЗ IK — отдельная и более ранняя беда, чем выход за предел. Значит
     заказанная точка стопы физически недостижима при этих звеньях: нога
     либо не дотягивается, либо складывается сама в себя. Углы в этот момент
     не определены вовсе, поэтому таблица выше про такой цикл ничего не
     говорит, и пропускать прогон нельзя ни при каких запасах. */
  if (ikFail) {
    LOG.println();
    LOG.printf("ОТКАЗ IK: стопа недостижима. Нога %s, фаза %.3f.\n",
                  LEG_NAME[ikFailLeg], ikFailPhase);
    LOG.printf("   Нога тянется от %.1f до %.1f мм (звенья %.2f и %.2f).\n",
                  fabsf(L_FEMUR_MM - L_TIBIA_MM), L_FEMUR_MM + L_TIBIA_MM,
                  L_FEMUR_MM, L_TIBIA_MM);
    LOG.printf("   Сейчас заказано: высота %.1f, шаг ±%.1f, подъём %.1f,\n",
                  pHeightMm, pSpanMm, pLiftMm);
    LOG.printf("   сдвиг корпуса %+.1f/%+.1f, крен %+.1f°.\n",
                  pShiftXMm, pShiftYMm, pRollDeg);
    LOG.println("   Лечится: 'H' ближе к середине хода, 'P' меньше, 'C' меньше,");
    LOG.println("   либо сдвиг корпуса меньше. ДВИЖЕНИЕ ЗАПРЕЩЕНО.");
    return false;
  }

  if (bad) LOG.printf("ПРЕДПОЛЁТНАЯ ПРОВЕРКА НЕ ПРОЙДЕНА: %d сустав(ов) за пределом. Движение запрещено.\n", bad);
  else     LOG.println("Предполётная проверка пройдена (пределы).");
  return bad == 0;
}

// ===========================================================================
// ЖЁСТКИЙ ПРЕДЕЛ — РЕАКЦИЯ
// ---------------------------------------------------------------------------
// Обрезка команды по пределу НЕ является штатным режимом. Предполётная
// проверка гарантирует, что весь цикл лежит внутри окна; значит обрезка
// означает, что траекторию посчитали неправильно. Продолжать походку после
// этого нельзя: сустав уже упёрся, а генератор считает, что всё идёт по плану.
//
// Поэтому: обрезали -> напечатали канал и величину выхода -> ЗАМОРОЗИЛИ цели
// на текущем (уже разрешённом) положении -> HOLD. Серво остаются под током и
// держат раму; 'r' снимает сигнал, если оператор решит, что так безопаснее.
// ===========================================================================
uint32_t limitHits = 0;

void freezeAndHold(const char *why) {
  speedRamping = false;
  for (uint8_t leg = 0; leg < LEG_COUNT; leg++)
    for (uint8_t j = 0; j < JOINT_PER_LEG; j++)
      tgtAngle[leg][j] = curAngle[leg][j];   // цель = то, что реально выдано
  rampViaActive = false; rampToRest = false;
  trickAbort();
  mode = MODE_HOLD;
  LOG.printf(">> АВАРИЙНЫЙ СТОП: %s. Удержание текущего положения.\n", why);
  LOG.println("   'p' — предполётная проверка, 'n' — вернуться в позу, 'r' — снять ШИМ.");
}

void limitFault(uint8_t ch, const char *what, float want, float got) {
  limitHits++;
  LOG.printf("[ПРЕДЕЛ] ch%-2u %s: запрошено %.1f, разрешено %.1f, выход %.1f\n",
                ch, what, want, got, want - got);
  if (mode == MODE_WALK || mode == MODE_RAMP) freezeAndHold("команда вышла за жёсткий предел");
}

// ---------------------------------------------------------------------------
// ЕДИНСТВЕННОЕ МЕСТО ВО ВСЁМ СКЕТЧЕ, ОТКУДА ИМПУЛЬС ПОПАДАЕТ В ДРАЙВЕР.
// Ни одна другая строка не имеет права звать pwm.writeMicroseconds.
// Кламп здесь безусловен и не зависит от того, что делал вызывающий:
// даже если выше по стеку кто-то забудет проверить угол, за границу канала
// не уйдёт ничего.
// ---------------------------------------------------------------------------
void writeUsHard(uint8_t ch, long us) {
  if (!spottyChUsed(ch)) return;                  // на свободные каналы — ничего
  bool hit = false;
  uint16_t out = spottyClampUs(ch, us, &hit);     // рубежи 2 и 3
  if (hit) limitFault(ch, "импульс", (float)us, (float)out);
  pendingTicks[ch] = usToTicks(out);              // на шину уходит в pcaFlush()
}

// ---------------------------------------------------------------------------
// Выдача накопленного на шину. Ровно один раз за тик, четырьмя посылками.
// Разделение «посчитать» и «выдать» нужно не ради красоты: пока считаем, любой
// сустав может объявить аварийный стоп, и выдавать половину кадра при этом
// нельзя. Либо весь кадр, либо ничего.
// ---------------------------------------------------------------------------
uint32_t busUsLast = 0, busUsMax = 0;
uint32_t tickOverruns = 0;

void pcaFlush() {
  if (DRY_RUN || !engaged) return;                // до взвода ШИМ не подаётся
  uint32_t t0 = micros();
  // Непрерывные участки: 0..2, 4..6, 8..10, 12..14. Свободные 3/7/11/15
  // не трогаем — они погашены битом full-off и должны такими остаться.
  for (uint8_t base = 0; base < 16; base += 4)
    pcaWriteRun(base, 3, &pendingTicks[base]);
  busUsLast = micros() - t0;
  if (busUsLast > busUsMax) busUsMax = busUsLast;
}

// ---------------------------------------------------------------------------
// Единственное место, где угол превращается в импульс.
// ---------------------------------------------------------------------------
void applyJoint(uint8_t leg, uint8_t j, float angleDeg) {
  uint8_t ch = SPOTTY_CH[leg][j];
  if (!spottyChUsed(ch)) return;

  // РУБЕЖ 1 — кламп В ГРАДУСАХ, до расчёта импульса.
  // Без него curAngle запоминал бы ЗАКАЗАННЫЙ угол, а серво стояло бы на
  // границе: генератор накапливает угол за пределом, и обратный ход
  // начинается с запозданием ровно на величину накопленного (windup).
  bool hit = false;
  float safeDeg = spottyClampAngle(ch, angleDeg, &hit);
  if (hit) limitFault(ch, "угол", angleDeg, safeDeg);

  curAngle[leg][j] = safeDeg;      // запоминаем РАЗРЕШЁННЫЙ угол, не заказанный

  writeUsHard(ch, (long)(spottyAngleToUsRaw(ch, safeDeg) + 0.5f));
}

// Постановка цели. Цель тоже клампится: иначе atTargets() никогда не сойдётся,
// потому что curAngle физически не может дойти до недостижимой цели.
void setTarget(uint8_t leg, uint8_t j, float deg) {
  uint8_t ch = SPOTTY_CH[leg][j];
  if (!spottyChUsed(ch)) { tgtAngle[leg][j] = 0.0f; return; }
  bool hit = false;
  tgtAngle[leg][j] = spottyClampAngle(ch, deg, &hit);
  if (hit) limitFault(ch, "цель", deg, tgtAngle[leg][j]);
}

// Шаг к цели с ограничением скорости. Скорость передаётся, а не берётся из
// глобальной: у рампы и у походки она разная, см. комментарий у RAMP_RATE_DPS.
void slewToTargets(float rateDps) {
  const float maxStep = rateDps * (float)TICK_MS / 1000.0f;
  for (uint8_t leg = 0; leg < LEG_COUNT; leg++)
    for (uint8_t j = 0; j < JOINT_PER_LEG; j++) {
      float d = tgtAngle[leg][j] - curAngle[leg][j];
      d = constrain(d, -maxStep, maxStep);
      applyJoint(leg, j, curAngle[leg][j] + d);
    }
}

bool atTargets() {
  for (uint8_t leg = 0; leg < LEG_COUNT; leg++)
    for (uint8_t j = 0; j < JOINT_PER_LEG; j++)
      if (fabsf(tgtAngle[leg][j] - curAngle[leg][j]) > 0.05f) return false;
  return true;
}

// Плоская прямая задача ноги: углы бедра/колена -> стопа в плоскости ноги
// (x вперёд, r вниз от оси бедра). Та же геометрия, что в legIK, без хипа.
void footInPlane(float thigh, float knee, float &x, float &r) {
  const float F = L_FEMUR_MM, T = L_TIBIA_MM;
  const float L = sqrtf(F * F + T * T + 2.0f * F * T * cosf(radians(knee)));
  const float g = acosf(constrain((L * L + F * F - T * T) / (2.0f * L * F), -1.0f, 1.0f));
  const float a = radians(thigh) + g;
  x = L * sinf(a);  r = L * cosf(a);
}
// Обратная к ней. false — точка вне досягаемости звеньев.
bool anglesInPlane(float x, float r, float &thigh, float &knee) {
  const float F = L_FEMUR_MM, T = L_TIBIA_MM;
  const float L = sqrtf(x * x + r * r);
  if (L > F + T - 0.001f || L < fabsf(F - T) + 0.001f) return false;
  const float ci = (F * F + T * T - L * L) / (2.0f * F * T);
  knee = degrees(PI - acosf(constrain(ci, -1.0f, 1.0f)));
  const float cg = (L * L + F * F - T * T) / (2.0f * L * F);
  thigh = degrees(atan2f(x, r) - acosf(constrain(cg, -1.0f, 1.0f)));
  return true;
}
static bool inWindow(uint8_t leg, uint8_t j, float deg) {
  bool hit = false;
  spottyClampAngle(SPOTTY_CH[leg][j], deg, &hit);
  return !hit;
}

/*
 * ПРОМЕЖУТОЧНАЯ ТОЧКА ПОДЪЁМА/УКЛАДКИ. Прямой путь в суставах из позы лёжа
 * в стойку тащит стопы по полу под нагрузкой, пока корпус уже поднимается:
 * робот подъезжает и клюёт. Поэтому:
 *   подъём:  1) стопы переезжают под стойку на ВЫСОТЕ ЛЁЖА (корпус ещё
 *               на брюхе, стопы почти не нагружены);
 *            2) корпус поднимается, стопы стоят на месте.
 *   укладка: зеркально — сначала опуститься, потом сложить ноги.
 * Точка ищется для каждой ноги отдельно: x берётся у верхней позы, высота —
 * у нижней; если там сустав выходит из окна, высота сдвигается к верхней
 * позе шагами по 2 мм. Не нашлось — этапа нет, идём напрямую, как раньше.
 * Хип в точке — как у верхней позы.
 */
bool rampPlanVia(float via[LEG_COUNT][JOINT_PER_LEG]) {
  bool any = false;
  for (uint8_t leg = 0; leg < LEG_COUNT; leg++) {
    float xs, rs, xg, rg;
    footInPlane(curAngle[leg][JOINT_THIGH], curAngle[leg][JOINT_KNEE], xs, rs);
    footInPlane(tgtAngle[leg][JOINT_THIGH], tgtAngle[leg][JOINT_KNEE], xg, rg);
    for (uint8_t j = 0; j < JOINT_PER_LEG; j++) via[leg][j] = tgtAngle[leg][j];
    if (fabsf(rg - rs) < VIA_MIN_DZ_MM || fabsf(xg - xs) < VIA_MIN_DX_MM) continue;
    const bool rising = rg > rs;                 // r растёт вниз: стопа ниже = корпус выше
    const float xv  = rising ? xg : xs;          // x — у верхней позы
    const float r0  = rising ? rs : rg;          // высота — у нижней
    const float r1  = rising ? rg : rs;
    const float hip = rising ? tgtAngle[leg][JOINT_HIP] : curAngle[leg][JOINT_HIP];
    bool found = false;
    for (float rv = r0; (r1 > r0) ? rv <= r1 : rv >= r1; rv += (r1 > r0 ? 2.0f : -2.0f)) {
      float th, kn;
      if (!anglesInPlane(xv, rv, th, kn)) continue;
      if (!inWindow(leg, JOINT_THIGH, th) || !inWindow(leg, JOINT_KNEE, kn)) continue;
      if (fabsf(rv - r1) < VIA_MIN_DZ_MM) break; // точка слилась с верхней позой
      via[leg][JOINT_HIP] = hip; via[leg][JOINT_THIGH] = th; via[leg][JOINT_KNEE] = kn;
      found = true; break;
    }
    any |= found;
  }
  return any;
}

// Стартовое допущение о положении суставов до первого кадра ШИМ.
void assumeStartPose() {
  for (uint8_t leg = 0; leg < LEG_COUNT; leg++) {
    const float a[JOINT_PER_LEG] = { REST_HIP_DEG, REST_THIGH_DEG, REST_KNEE_DEG };
    for (uint8_t j = 0; j < JOINT_PER_LEG; j++) {
      uint8_t ch = SPOTTY_CH[leg][j];
      curAngle[leg][j] = (START_LYING && spottyChUsed(ch)) ? spottyClampAngle(ch, a[j]) : 0.0f;
    }
  }
}

// Цели = поза лёжа, зажатая в окно каналов МОЛЧА: поза заведомо у упора
// (см. REST_*_DEG), и кламп здесь — не авария, а часть определения позы.
// Через setTarget нельзя: он объявил бы [ПРЕДЕЛ], а в RAMP — аварийный стоп.
void setTargetsToRest() {
  const float a[JOINT_PER_LEG] = { REST_HIP_DEG, REST_THIGH_DEG, REST_KNEE_DEG };
  for (uint8_t leg = 0; leg < LEG_COUNT; leg++)
    for (uint8_t j = 0; j < JOINT_PER_LEG; j++) {
      uint8_t ch = SPOTTY_CH[leg][j];
      tgtAngle[leg][j] = spottyChUsed(ch) ? spottyClampAngle(ch, a[j]) : 0.0f;
    }
}

// Начать плавный выход в текущие цели (см. RAMP_PROFILE_PEAK). Цели к этому
// моменту уже поставлены; старт — то, что реально выдано на серво.
void beginRampSegment(unsigned long now);
void beginRamp(unsigned long now) {
  rampToRest = false;
  trickAbort();                     // обычная рампа (n, l, конец хода) снимает трюк
  float via[LEG_COUNT][JOINT_PER_LEG];
  rampViaActive = rampPlanVia(via);
  if (rampViaActive) {
    memcpy(rampGoal, tgtAngle, sizeof(rampGoal));
    memcpy(tgtAngle, via, sizeof(via));
    LOG.println("   через промежуточную точку: сначала стопы, потом корпус");
  }
  beginRampSegment(now);
}

void beginRampSegment(unsigned long now) {
  float maxD = 0.0f;
  for (uint8_t leg = 0; leg < LEG_COUNT; leg++)
    for (uint8_t j = 0; j < JOINT_PER_LEG; j++) {
      rampFrom[leg][j] = curAngle[leg][j];
      float d = fabsf(tgtAngle[leg][j] - curAngle[leg][j]);
      if (d > maxD) maxD = d;
    }
  rampDurMs = RAMP_PROFILE_PEAK * maxD / RAMP_RATE_DPS * 1000.0f;
  if (rampDurMs < RAMP_MIN_MS) rampDurMs = RAMP_MIN_MS;
  rampT0 = now; afterRamp = MODE_HOLD; mode = MODE_RAMP;
  LOG.printf("   плавный выход: ход до %.1f°, %.0f мс\n", maxD, rampDurMs);
}

// Один тик выхода: точка профиля минимального рывка, общая для всех суставов.
void rampTick(unsigned long now) {
  float t = (float)(now - rampT0) / rampDurMs;
  if (t > 1.0f) t = 1.0f;
  const float k = t * t * t * (10.0f + t * (-15.0f + 6.0f * t));
  float keep[LEG_COUNT][JOINT_PER_LEG];
  for (uint8_t leg = 0; leg < LEG_COUNT; leg++)
    for (uint8_t j = 0; j < JOINT_PER_LEG; j++) {
      keep[leg][j] = tgtAngle[leg][j];
      tgtAngle[leg][j] = rampFrom[leg][j] + (keep[leg][j] - rampFrom[leg][j]) * k;
    }
  slewToTargets(RAMP_RATE_DPS);      // страховка: профиль и так в пределе
  // Вернуть конечные цели, если ограничитель не объявил аварийный стоп
  // (freezeAndHold сам переписал цели на текущее положение).
  if (mode == MODE_RAMP)
    for (uint8_t leg = 0; leg < LEG_COUNT; leg++)
      for (uint8_t j = 0; j < JOINT_PER_LEG; j++) tgtAngle[leg][j] = keep[leg][j];
}

/*
 * ПОЗА. У каждого движка она СВОЯ, и это не мелочь: если выйти по 'n' в
 * угловую позу, а потом пустить 'w' по декартовой траектории, робот прыгнет
 * из одной в другую на первом же тике. На стенде это выглядит как рывок из
 * ниоткуда, и его легко принять за ошибку карты каналов или за неисправность.
 *
 * Декартова поза — это стопа под номиналью: продольного хода нет (fx = 0),
 * бокового нет, глубина ровно pHeightMm без продава. Сдвиг корпуса и крен
 * при этом УЧИТЫВАЮТСЯ: они часть позы, а не часть походки.
 */
void setTargetsToPose() {
  if (pEngine == 1) {
    oq::BodyPose bp;
    bp.baseLong = BASE_LONG_MM;  bp.baseLat = BASE_LAT_MM;
    bp.rollDeg  = pRollDeg;      bp.pitchDeg = pPitchDeg;  bp.yawDeg = pYawDeg;
    /* Поза берёт сдвиг в фазе НОЛЬ, а не ноль сдвига. Цикл хода начинается с
       фазы 0, и если бы поза стояла по центру, первый же тик потребовал бы
       уехать вбок на всю амплитуду разом. Ограничитель скорости это,
       разумеется, размажет — но фаза тем временем уходит вперёд, и походка
       стартует с перекосом, которого в ней нет. Поэтому робот встаёт ровно
       там, где походка начинается. При выключенном сдвиге здесь ноль, и
       поведение прежнее до последнего бита. */
    bp.tx = pShiftXMm;           bp.ty = pShiftYMm + bodyShiftYAt(0.0f);
    bp.tz = 0.0f;
    for (uint8_t leg = 0; leg < LEG_COUNT; leg++) {
      float x, y, z, hip, thigh, knee;
      oq::hipToFoot(bp, LEG_FWD[leg], LEG_LEFT[leg],
                    0.0f, 0.0f, L_HIP_MM, pHeightMm, x, y, z);
      if (!legIK(x, y, z, hip, thigh, knee)) {
        // Досюда дойти нельзя: 'n' пускает preflight, а тот сканирует весь
        // цикл, включая эту точку. Если всё же дошли — молчать нельзя.
        if (!ikFail) { ikFail = true; ikFailLeg = leg; ikFailPhase = 0.0f; }
        LOG.printf("[!!] Поза недостижима для ноги %s. Выход в позу отменён.\n",
                      LEG_NAME[leg]);
        freezeAndHold("поза вне досягаемости");
        return;
      }
      setTarget(leg, JOINT_HIP,   hip);
      setTarget(leg, JOINT_THIGH, thigh);
      setTarget(leg, JOINT_KNEE,  knee);
    }
    return;
  }
  for (uint8_t leg = 0; leg < LEG_COUNT; leg++) {
    setTarget(leg, JOINT_HIP,   POSE_HIP_DEG);
    setTarget(leg, JOINT_THIGH, stanceThighDeg() - pTrimDeg);  // стопа под осью
    setTarget(leg, JOINT_KNEE,  pCrouchDeg);                   // хипа плюс трим
  }
}

/* ===========================================================================
 * ТРЮКИ — добавлено 2026-09-28
 * ---------------------------------------------------------------------------
 * Что это. Короткие показательные движения по КЛЮЧЕВЫМ КАДРАМ: сесть, дать
 * лапу, помахать, поклон, потянуться, отжимания, танец, вилять, оглядеться.
 * Идеи — из открытых роботов: Petoi Bittle (hi, sit, str, pu, ck), Unitree
 * Go2 (Hello, Sit, Stretch, Dance, WiggleHips), SpotMicro (sit, give paw).
 * Их таблицы углов сюда НЕ переносятся: у Bittle 8 суставов и другая
 * геометрия. Кадры посчитаны заново для этой рамы.
 *
 * НОВЫХ ПУТЕЙ К СЕРВО НЕТ. Трюк — это цепочка обычных сегментов рампы
 * (MODE_RAMP, профиль 10-15-6, страховочный ограничитель 100 °/с, кламп
 * setTarget -> аварийный стоп). 'x' замораживает, как в любой рампе.
 *
 * КАДР — смещения стоп в осях корпуса, десятые доли мм: вперёд, влево, вверх.
 * Отсчёт — от «канона»: стопа под осью бедра (x = 0, без бокового выноса) на
 * высоте текущей позы. Поэтому трюк одинаков в угловом и декартовом движке.
 * Пролог — медленный выход в канон, эпилог — возврат в позу. Боковое смещение
 * делают хипы: угол = atan(вынос / высота), знак — TRICK_HIP_OUT.
 *
 * ПРОВЕРЕНО В PyBullet (code/sim/трюки/): все трюки, оба движка, четыре
 * разных успокоения — без падений. НО только при хипе «+ = наружу» (замер).
 * С обратным знаком лапа, танец, вилять и оглядеться ВАЛЯТ робота. Поэтому
 * трюки с хипами заперты, пока оператор не проверил знак: 'e hiptest' на
 * подвесе, затем 'e hip 1' (или 'e hip -1', если стопы уехали влево).
 *
 * Физика в PyBullet — с ПРИНЯТЫМИ массами и моментом серво. Первый прогон
 * каждого трюка на железе — на подвесе, второй — на полу с рукой рядом.
 * ========================================================================== */
// Типы TrickKey/TrickDef — в spotty_tricks_types.h, подключён в самом верху:
// Arduino IDE вставляет прототипы функций ПЕРЕД первой функцией скетча, и
// тип, объявленный здесь, для прототипа был бы ещё неизвестен.
#include "spotty_tricks.h"
static const uint8_t TRICK_COUNT = sizeof(TRICKS) / sizeof(TRICKS[0]);

float   TRICK_HIP_OUT = +1.0f;      // + = наружу (замер). 'e hip <1|-1>'
bool    trickHipOk = false;         // знак проверен оператором в этом сеансе
static const float TRICK_EDGE_MS = 2000.0f;   // пролог (в канон) и эпилог (в позу)
static const float TRICK_MIN_MS  = 150.0f;
int8_t  trickIdx = -1;              // для телеметрии: какой трюк идёт
uint8_t trickKey = 0;               // 0 — пролог, 1..n — кадры, n+1 — эпилог
float   trickBase[LEG_COUNT][2];    // канон: высота D0 и хип позы
float   trickPose[LEG_COUNT][JOINT_PER_LEG];
char    trickErr[112] = "";

// Кадр -> углы. false и текст в trickErr, если нога не дотягивается или
// сустав выходит из окна. Ничего не двигает.
bool trickKeyAngles(const TrickKey &k, float out[LEG_COUNT][JOINT_PER_LEG]) {
  for (uint8_t leg = 0; leg < LEG_COUNT; leg++) {
    const float dx = k.d[leg][0] * 0.1f, dy = k.d[leg][1] * 0.1f, dz = k.d[leg][2] * 0.1f;
    const float D   = trickBase[leg][0] - dz;
    const float lat = dy * LEG_LEFT[leg] * TRICK_HIP_OUT;   // вынос НАРУЖУ
    const float r   = sqrtf(D * D + lat * lat);
    float th, kn;
    if (D < 20.0f || !anglesInPlane(dx, r, th, kn)) {
      snprintf(trickErr, sizeof(trickErr), "нога %s не дотягивается", LEG_NAME[leg]);
      return false;
    }
    out[leg][JOINT_HIP]   = trickBase[leg][1] + degrees(atan2f(lat, D));
    out[leg][JOINT_THIGH] = th;
    out[leg][JOINT_KNEE]  = kn;
    for (uint8_t j = 0; j < JOINT_PER_LEG; j++)
      if (!inWindow(leg, j, out[leg][j])) {
        snprintf(trickErr, sizeof(trickErr), "%s %s %.1f° вне окна", LEG_NAME[leg], JOINT_NAME[j], out[leg][j]);
        return false;
      }
  }
  return true;
}

// Сегмент трюка: как beginRampSegment, но своя длительность и без точки «через».
void trickSegment(unsigned long now, float ms) {
  float maxD = 0.0f;
  for (uint8_t leg = 0; leg < LEG_COUNT; leg++)
    for (uint8_t j = 0; j < JOINT_PER_LEG; j++) {
      rampFrom[leg][j] = curAngle[leg][j];
      const float d = fabsf(tgtAngle[leg][j] - curAngle[leg][j]);
      if (d > maxD) maxD = d;
    }
  const float byRate = RAMP_PROFILE_PEAK * maxD / RAMP_RATE_DPS * 1000.0f;
  rampDurMs = ms > byRate ? ms : byRate;           // быстрее 100 °/с не бывает
  if (rampDurMs < TRICK_MIN_MS) rampDurMs = TRICK_MIN_MS;
  rampViaActive = false; rampToRest = false;
  rampT0 = now; afterRamp = MODE_HOLD; mode = MODE_RAMP;
}

// Поставить цели кадра number (0 — канон, 1..n — кадры, n+1 — поза).
static void trickLoad(uint8_t number) {
  const TrickDef &T = TRICKS[trickIdx];
  float a[LEG_COUNT][JOINT_PER_LEG];
  if (number == 0) {
    static const TrickKey zero = { 0, {{0,0,0},{0,0,0},{0,0,0},{0,0,0}} };
    trickKeyAngles(zero, a);                       // проверено в trickStart
  } else if (number <= T.n) {
    trickKeyAngles(T.k[number - 1], a);
  } else {
    memcpy(a, trickPose, sizeof(a));
  }
  for (uint8_t leg = 0; leg < LEG_COUNT; leg++)
    for (uint8_t j = 0; j < JOINT_PER_LEG; j++) setTarget(leg, j, a[leg][j]);
}

// Проверить трюк целиком и начать. Ничего не двигает, если хоть один кадр плох.
bool trickStart(uint8_t idx, unsigned long now) {
  trickErr[0] = 0;
  if (idx >= TRICK_COUNT) { snprintf(trickErr, sizeof(trickErr), "нет такого трюка"); return false; }
  const TrickDef &T = TRICKS[idx];
  if (T.hip && !trickHipOk) {
    snprintf(trickErr, sizeof(trickErr), "трюк двигает хипами: сначала 'e hiptest' на подвесе, затем 'e hip 1'");
    return false;
  }
  if (!T.endSit) {       // трюк обязан кончаться каноном, иначе эпилог прыгнет
    for (uint8_t leg = 0; leg < LEG_COUNT; leg++)
      for (uint8_t c = 0; c < 3; c++)
        if (T.k[T.n - 1].d[leg][c]) { snprintf(trickErr, sizeof(trickErr), "таблица: последний кадр не ноль"); return false; }
  }
  // Поза — та, куда вернёмся. Её же высота — высота канона.
  ikFail = false;
  setTargetsToPose();
  if (ikFail || mode != MODE_HOLD) { snprintf(trickErr, sizeof(trickErr), "поза недостижима"); return false; }
  memcpy(trickPose, tgtAngle, sizeof(trickPose));
  for (uint8_t leg = 0; leg < LEG_COUNT; leg++) {
    float x0, r0;
    footInPlane(trickPose[leg][JOINT_THIGH], trickPose[leg][JOINT_KNEE], x0, r0);
    const float h = trickPose[leg][JOINT_HIP];
    trickBase[leg][0] = r0 * cosf(radians(h));
    trickBase[leg][1] = 0.0f;                     // канон: хип ровно
  }
  memcpy(tgtAngle, curAngle, sizeof(tgtAngle));   // пока ничего не меняем
  float a[LEG_COUNT][JOINT_PER_LEG];
  static const TrickKey zero = { 0, {{0,0,0},{0,0,0},{0,0,0},{0,0,0}} };
  if (!trickKeyAngles(zero, a)) return false;
  for (uint8_t i = 0; i < T.n; i++)
    if (!trickKeyAngles(T.k[i], a)) {
      char tmp[112]; snprintf(tmp, sizeof(tmp), "кадр %u: %s", i + 1, trickErr);
      strncpy(trickErr, tmp, sizeof(trickErr) - 1);
      return false;
    }
  trickIdx = (int8_t)idx; trickKey = 0;
  havePose = false;                                // на трюке 'w' запрещён
  trickLoad(0);
  trickSegment(now, TRICK_EDGE_MS);
  return true;
}

// Вызывается, когда очередной сегмент доехал. true — трюк продолжается.
bool trickNext(unsigned long now) {
  if (trickIdx < 0) return false;
  const TrickDef &T = TRICKS[trickIdx];
  trickKey++;
  const uint8_t last = T.endSit ? T.n : (uint8_t)(T.n + 1);
  if (trickKey > last) {
    LOG.printf(">> трюк '%s' окончен%s\n", T.name, T.endSit ? ": сидит. 'n' — встать, 'l' — лечь" : ", поза");
    havePose = !T.endSit;
    trickIdx = -1; mode = MODE_HOLD;
    return false;
  }
  const uint32_t hits0 = limitHits;
  trickLoad(trickKey);
  if (limitHits != hits0) { trickIdx = -1; return false; }   // кламп уже объявил стоп и HOLD
  const float ms = (trickKey <= T.n) ? (float)T.k[trickKey - 1].ms : TRICK_EDGE_MS;
  trickSegment(now, ms);
  return true;
}

void trickAbort() { trickIdx = -1; }

void trickList() {
  LOG.println("Трюки ('e <имя|номер>'), только из позы после 'n':");
  for (uint8_t i = 0; i < TRICK_COUNT; i++)
    LOG.printf("  %u %-8s %s — %s%s\n", i, TRICKS[i].name, TRICKS[i].ru, TRICKS[i].note,
               TRICKS[i].hip && !trickHipOk ? "  [нужен 'e hip 1']" : "");
  LOG.printf("Знак хипа для трюков: %+.0f (%s)\n", TRICK_HIP_OUT, trickHipOk ? "проверен" : "НЕ проверен");
}

// Для стенда (trace): таблица static, наружу — только через эти две.
uint8_t trickCount() { return TRICK_COUNT; }
const TrickDef *trickDef(uint8_t i) { return i < TRICK_COUNT ? &TRICKS[i] : nullptr; }

void releaseAll() {
  if (!DRY_RUN) {
    for (uint8_t leg = 0; leg < LEG_COUNT; leg++)
      for (uint8_t j = 0; j < JOINT_PER_LEG; j++) {
        uint8_t ch = SPOTTY_CH[leg][j];
        if (ch != 0xFF) pwm.setPWM(ch, 0, 4096);   // полное снятие сигнала
      }
    pcaAllOutputsOff();            // и разом по всем 16, включая 3/7/11/15
    if (spOscIsrOn) spottyOscProbeArm(pwm);   // вернуть меандр зонда генератора
  }
  mode = MODE_IDLE;
  havePose = false;
  engaged  = false;
  LOG.println(">> RELEASE: сигнал снят со всех каналов, серво мягкие");
}

void status() {
  const GaitDef &g = GAITS[gaitIdx];
  LOG.printf("движок: %s\n", pEngine == 1 ? "ДЕКАРТОВ (мм)" : "угловой (градусы суставов)");
  spottyOscStatus(LOG);
  spottyImuStatus(LOG);
  LOG.printf("походка %u '%s' (%s)\n", gaitIdx, g.name, g.note);
  LOG.printf("  фазы FR %.2f  FL %.2f  BR %.2f  BL %.2f\n",
                g.phase[LEG_FR], g.phase[LEG_FL], g.phase[LEG_BR], g.phase[LEG_BL]);
  LOG.printf("  duty %.2f (опора %.0f%% цикла)   период %.0f мс   циклов N=%u%s\n",
                pDuty, pDuty * 100.0f, pCycleMs, walkCycles,
                pEngine == 1 ? "   <- выведены из V и W" : "");

  if (pEngine == 1) {
    recalcCartesianCurves();
    LOG.printf("  ШАГ ±%.1f мм (полный %.1f)   подъём %.1f мм   продав %.1f мм\n",
                  pSpanMm, 2.0f * pSpanMm,
                  oq::swingPeakLift(cartSwing, pHeightMm),
                  oq::stancePeakDrop(cartStance, pHeightMm));
    LOG.printf("  ВЫСОТА %.1f мм под осью хипа; нога вытянута на %.0f%% из %.1f мм\n",
                  pHeightMm, 100.0f * pHeightMm / (L_FEMUR_MM + L_TIBIA_MM),
                  L_FEMUR_MM + L_TIBIA_MM);
    LOG.printf("  скорость %.0f мм/с   опора %.0f мс   перенос %.0f мс   ход %+.0f°%s\n",
                  pVelMmS, pDuty * pCycleMs, pSwingMs, pCrabDeg,
                  fabsf(pCrabDeg) > 1.0f ? " КРАБОМ" : "");
    if (pShiftGain > 0.0f) {
      LOG.printf("  ПЕРЕНОС КОРПУСА ПО ФАЗЕ: доля %.2f x %.1f мм = %+.1f мм\n",
                    pShiftGain, bodyShiftAmpMm(), pShiftGain * bodyShiftAmpMm());
      printShiftTable();
    } else {
      LOG.printf("  перенос корпуса по фазе: ВЫКЛЮЧЕН ('B 1' — включить, расчёт %s)\n",
                    bodyShiftAmpMm() > 0.0f ? "есть" : "НЕВОЗМОЖЕН до M4");
    }
    LOG.printf("  корпус: сдвиг %+.1f/%+.1f мм   крен %+.1f°   тангаж %+.1f°%s  рыскание %+.1f°%s\n",
                  pShiftXMm, pShiftYMm, pRollDeg,
                  pPitchDeg, SPOTTY_BASE_LONG_MEASURED ? "" : " (заперт M4)",
                  pYawDeg,   SPOTTY_BASE_LONG_MEASURED ? "" : " (заперт M4)");
    LOG.printf("  звенья: бедро %.2f  голень %.2f  хип %.2f  база попер. %.2f  продольн. %s\n",
                  L_FEMUR_MM, L_TIBIA_MM, L_HIP_MM, BASE_LAT_MM,
                  SPOTTY_BASE_LONG_MEASURED ? "измерена" : "НЕ ИЗМЕРЕНА (M4)");
#if SPOTTY_LINKS_MEASURED
    LOG.println("  длины ПОДТВЕРЖДЕНЫ замером.");
#else
    LOG.println("  [!] длины — STL-КАНДИДАТЫ, не замеры: 'n'/'w'/'z' отказывают (M1/M2/M3).");
#endif
  }
  LOG.printf("  размах ±%.1f°   подъём %.1f°   хип ±%.1f°   разворот %s\n",
                pAmpThigh, pAmpKnee, pAmpHip,
                pTurn == 0 ? "выключен" : (pTurn > 0 ? "ВЛЕВО" : "ВПРАВО"));
  LOG.printf("  ПРИСЕД: колено %.0f°, бедро %.1f°, нога короче на %.0f%%\n",
                pCrouchDeg, stanceThighDeg(),
                100.0f * (1.0f - stanceReach() / (1.0f + linkRatio)));
  LOG.printf("  траектория стопы: %s   предельный размах ±%.1f°\n",
                pFlatPath ? "ПЛОСКАЯ (нужна модель звеньев)" : "дуга (без модели)",
                sweepLimitDeg());
  LOG.printf("  профиль переноса: %s   пик требуемой скорости %.0f°/с\n",
                pSmoothSwing ? "сглаженный" : "линейный", peakRateDps(pCycleMs));
  LOG.printf("  трим корпуса: %+.1f°%s\n", pTrimDeg,
                pTrimDeg == 0.0f ? "  (у всех сравнимых проектов он НЕнулевой)"
                                 : "   <- ПОДБОР НА ГЛАЗ, не замер");
  LOG.printf("  отношение звеньев голень/бедро k = %.2f%s\n", linkRatio,
                fabsf(linkRatio - 1.0f) < 1e-3f ? "   <- ДОПУЩЕНИЕ, не измерено" : "");
  LOG.printf("  ограничитель: походка %.0f°/с, рампа %.0f°/с   тик %u мс (%.0f Гц)\n",
                pMaxRateDps, RAMP_RATE_DPS, TICK_MS, 1000.0f / TICK_MS);
  LOG.printf("  шина: посылка кадра %lu мкс (макс %lu), бюджет тика %u мкс, пропущено тиков %lu\n",
                (unsigned long)busUsLast, (unsigned long)busUsMax,
                (unsigned)TICK_MS * 1000u, (unsigned long)tickOverruns);
  LOG.printf("  PCA9685: делитель %u, такт %.4f мкс, 1500 мкс = %u тактов%s\n",
                pcaPrescale, pcaUsPerTick, usToTicks(1500),
                pcaFastReady ? "" : "   <- СВЕРКА ФОРМУЛЫ НЕ ПРОЙДЕНА");
  LOG.printf("  режим %d   поза %s   ШИМ %s   срабатываний предела %lu\n",
                (int)mode, havePose ? "есть" : "нет", engaged ? "подан" : "снят",
                (unsigned long)limitHits);
}

// Пиковая требуемая скорость сустава при заданном периоде, градусы в секунду.
// Форма траектории у всех четырёх ног одна, отличаются только сдвиг фазы и
// (в развороте) знак хипа. Максимум модуля производной от этого не зависит,
// поэтому достаточно одной ноги и одного прохода.
float peakRateDps(float cycleMs) {
  const int N = 400;
  float ang[JOINT_PER_LEG], prev[JOINT_PER_LEG], peak = 0.0f;
  /* ОДНОЙ НОГИ ХВАТАЕТ НЕ ВСЕГДА. Пока сдвиг корпуса по фазе выключен,
     траектории ног отличаются только сдвигом фазы, и максимум модуля
     производной у них общий. Со включённым сдвигом это неверно: сдвиг —
     функция ГЛОБАЛЬНОЙ фазы, и у каждой ноги он ложится на её собственный
     перенос по-своему. Тогда считаем все четыре — вчетверо дороже, но
     заниженный пик означал бы заниженный ограничитель скорости, то есть
     срезанную амплитуду и поехавшую фазировку. */
  const uint8_t nLeg = (pShiftGain > 0.0f && pEngine == 1) ? LEG_COUNT : 1;
  for (uint8_t leg = 0; leg < nLeg; leg++) {
    gaitPose(leg, 0.0f, prev);
    for (int k = 1; k <= N; k++) {
      gaitPose(leg, (float)k / (float)N, ang);
      for (uint8_t j = 0; j < JOINT_PER_LEG; j++) {
        peak = fmaxf(peak, fabsf(ang[j] - prev[j]));
        prev[j] = ang[j];
      }
    }
  }
  return peak * (float)N * 1000.0f / cycleMs;
}

/*
 * ШАГ РАЗГОНА. Укорачивает период и ПОДНИМАЕТ ВМЕСТЕ С НИМ ограничитель.
 *
 * Поднимать ограничитель обязательно: иначе разгон упрётся в наш же софтовый
 * предел и измерит его, а не серво. Задача обратная — найти, где начинает
 * отставать ЖЕЛЕЗО. Предел сустава при этом остаётся жёстким и неприкосновенным:
 * скорость и пределы — разные вещи, кламп работает как работал.
 *
 * Останов: 'x' оператором, либо потолок RATE_CEILING_DPS, либо SPEEDRAMP_MIN_MS.
 */
void speedRampStep() {
  float next = pCycleMs * SPEEDRAMP_FACTOR;
  if (next < SPEEDRAMP_MIN_MS) {
    LOG.printf(">> РАЗГОН: достигнут минимальный период %.0f мс. Останов.\n", pCycleMs);
    speedRamping = false; setTargetsToPose();
    beginRamp(millis());
    return;
  }
  // Ограничитель ведём с запасом 20% над требуемым, иначе мерили бы себя.
  float needed = peakRateDps(next);
  float lim    = needed * 1.2f;
  if (lim > RATE_CEILING_DPS) {
    LOG.printf(">> РАЗГОН: на периоде %.0f мс потребовалось бы %.0f°/с — выше потолка %.0f. Останов.\n",
                  next, needed, RATE_CEILING_DPS);
    speedRamping = false; setTargetsToPose();
    beginRamp(millis());
    return;
  }
  pCycleMs    = next;
  pMaxRateDps = lim;
  LOG.printf(">> РАЗГОН: период %.0f мс, требуется %.0f°/с, лимит поднят до %.0f°/с\n",
                pCycleMs, needed, pMaxRateDps);
  LOG.println("   Смотри на ноги. Как только начнут отставать или загудят — 'x'.");
}

void help() {
  LOG.println();
  LOG.println("Команды вводятся строкой; Enter не обязателен — строка");
  LOG.println("исполняется и по паузе. 'x' и 'r' срабатывают сразу с клавиши.");
  LOG.println();
  LOG.println("  p          предполётная проверка (ничего не двигает)");
  LOG.println("  n          ВЗВОД и выход в позу: отсчёт, затем плавная рампа");
  LOG.println("  l          лечь: плавно в позу лёжа (потом 'r' — снять ШИМ)");
  LOG.println("  w          пуск: ровно N циклов, потом сам вернётся в позу");
  LOG.println("  z          РАЗГОН: искать предел скорости железа, стоп по 'x'");
  LOG.println("  x          СТОП, удерживать текущее положение");
  LOG.println("  r          снять сигнал со всех каналов (серво мягкие)");
  LOG.println("  s          показать текущие параметры");
  LOG.println("  h          эта справка");
  LOG.println("  e [трюк]   ТРЮКИ: сесть, лапа, помахать, поклон… 'e' — список");
  LOG.println("  M [профиль] ПРОФИЛИ ХОДЬБЫ: низко-быстро, парадный шаг… 'M' — список");
  spottyOscHelp(LOG);
  spottyImuHelp(LOG);
  LOG.println();
  LOG.println("  g <n|имя>  выбрать походку и взять её пресет:");
  for (uint8_t i = 0; i < GAIT_COUNT; i++)
    LOG.printf("               %u %-7s %s\n", i, GAITS[i].name, GAITS[i].note);
  LOG.println("  c <1..99>  число циклов для 'w'   (или просто цифра 1..9)");
  LOG.println("  t <град>   размах бедра, ±");
  LOG.println("  k <град>   подъём колена в переносе");
  LOG.println("  d <0.1..0.9> duty — доля цикла в опоре");
  LOG.println("  T <мс>     период цикла");
  LOG.println("  m <°/с>    ограничитель скорости В ПОХОДКЕ (рампа всегда 100°/с)");
  LOG.println("  u <-1|0|1> разворот: -1 вправо, 0 выключен, +1 влево");
  LOG.println("  a <град>   размах хипа в развороте, ± (ход хипов внутрь мал!)");
  LOG.println();
  LOG.println("  q <град>   ПРИСЕД: угол колена в опоре. 0 = прямая нога");
  LOG.println("               бедро выводится само, стопа встаёт под ось хипа");
  LOG.println("  f <0|1>    траектория стопы: 0 дуга, 1 плоская");
  LOG.println("  b <град>   ТРИМ: сдвиг корпуса вперёд/назад относительно стоп");
  LOG.println("               лечит постоянный дифферент, высоту не меняет");
  LOG.println("  S <0|1>    профиль переноса: 0 линейный, 1 сглаженный");
  LOG.println("  L <k>      отношение звеньев голень/бедро (по умолчанию 1.0,");
  LOG.println("               это ДОПУЩЕНИЕ; влияет только на плоскую траекторию)");
  LOG.println();
  LOG.println("ДЕКАРТОВ ДВИЖОК — всё в МИЛЛИМЕТРАХ. Порт OpenQuadruped, MIT.");
  LOG.println("  G <0|1>    движок: 0 угловой (выше), 1 декартов");
  LOG.println("  H <мм>     ВЫСОТА: стопа под осью хипа        (вместо 'q')");
  LOG.println("  P <мм>     ШАГ: полуразмах, полный вдвое      (вместо 't')");
  LOG.println("  C <мм>     подъём стопы в переносе            (вместо 'k')");
  LOG.println("               фактические мм, не «добавка к встроенному»");
  LOG.println("  A <мм>     продав опоры, 0 = опора прямая     (аналога нет)");
  LOG.println("  V <мм/с>   СКОРОСТЬ корпуса -> опора = 2*P/V  (вместо 'T')");
  LOG.println("  W <мс>     время переноса                     (вместе с V даёт duty)");
  LOG.println("  D <град>   направление хода: 0 вперёд, +90 влево");
  LOG.println("               это КРАБ, курс не меняется; разворот — по-прежнему 'u'");
  LOG.println("  X <мм>     сдвиг корпуса вперёд(+)/назад      (вместо 'b')");
  LOG.println("  Y <мм>     сдвиг корпуса влево(+)/вправо      (аналога нет)");
  LOG.println("  R <град>   крен, + левый борт вверх           (аналога нет)");
  LOG.println("  B <0..1.5> ПЕРЕНОС КОРПУСА ПО ФАЗЕ, доля расчётной амплитуды");
  LOG.println("               0 = выключен (умолчание). Амплитуда НЕ задаётся руками:");
#if SPOTTY_BASE_LONG_MEASURED
  LOG.printf("               это инцентр опорного треугольника, сейчас %.1f мм\n",
                bodyShiftAmpMm());
  LOG.println("  E <град>   тангаж, + нос вверх    (открыт: M4 снят)");
  LOG.println("  J <град>   рыскание, + нос влево  (открыт: M4 снят)");
#else
  LOG.println("               это инцентр опорного треугольника. ТРЕБУЕТ M4.");
  LOG.println("  E <град>   тангаж, + нос вверх    — ЗАПЕРТ до замера M4");
  LOG.println("  J <град>   рыскание, + нос влево  — ЗАПЕРТ до замера M4");
#endif
  LOG.println();
  LOG.printf("  звенья: бедро %.2f, голень %.2f, хип %.2f мм — %s\n",
                L_FEMUR_MM, L_TIBIA_MM, L_HIP_MM,
#if SPOTTY_LINKS_MEASURED
                "ПОДТВЕРЖДЕНЫ замером");
#else
                "STL-КАНДИДАТЫ; 'p' считает, 'n'/'w'/'z' отказывают");
#endif
  LOG.println();
  LOG.printf("Жёсткий предел: измеренное окно минус %.1f° с каждой стороны, кламп\n",
                SPOTTY_LIMIT_MARGIN_DEG);
  LOG.println("    в градусах И в мкс на каждом тике. Обрезка = аварийный стоп.");
  LOG.println("Параметры меняются только на СТОЯЩЕМ роботе: во время 'w' — отказ.");
  LOG.println("Любое изменение параметра само прогоняет предполётную проверку.");
  LOG.println();
  status();
}

// ===========================================================================
void setup() {
  Serial.begin(115200);
  delay(300);

  // SAFETY.md п.1: ни одной позиционной команды в setup().
  if (!DRY_RUN) {
    Wire.begin(SPOTTY_I2C_SDA, SPOTTY_I2C_SCL, SPOTTY_I2C_HZ);
    // Порядок важен, см. комментарий у pcaAllOutputsOff(). Гасим выходы
    // ДО begin(), иначе RESTART внутри begin() оживит старые скважности
    // предыдущего скетча, да ещё на 1000 Гц.
    pcaAllOutputsOff();
    pwm.begin();
    Wire.setClock(SPOTTY_I2C_HZ);   // страховка: Adafruit_I2CDevice::begin()
                                    // внутри дёргает Wire.begin() без аргументов
    pcaAllOutputsOff();
    // ОБЯЗАТЕЛЬНО и ОБЯЗАТЕЛЬНО ДО setPWMFreq. Без этой строки библиотека
    // берёт своё умолчание 25 МГц, и каждый импульс выходит в 25/27 = 0.926
    // от заданного: нуль 1500 мкс превращается в 1389, это −20° по суставу.
    // Вся калибровка снята с 27 МГц (servo_hold, servo_calib, servo_test).
    pwm.setOscillatorFrequency(SPOTTY_OSC_HZ);
    pwm.setPWMFreq(SPOTTY_PWM_HZ);
    // Делитель читается с ЧИПА, один раз. Если setPWMFreq по любой причине
    // поставил не то, что мы думаем, сверка ниже это поймает.
    pcaPrescale  = pwm.readPrescale();
    /* ЖИВ ЛИ ДРАЙВЕР — добавлено 2026-09-27 после отказа на стенде.
       Без ответа PCA9685 скетч раньше работал молча: делитель читался как
       254 = 0xFE — это АДРЕС регистра делителя, который ESP32 оставляет в
       буфере, когда устройство не ответило. Сверка быстрого пути при этом
       «проходила» (обе стороны считали от одного мусора), ШИМ уходил в
       пустоту, серво стояли. Теперь: нет ACK на адресе, либо делитель
       равен 0xFE/0xFF — взвод запрещён, причина печатается. */
    Wire.beginTransmission(SPOTTY_PCA_ADDR);
    pcaAlive = (Wire.endTransmission() == 0) && pcaPrescale != 0xFE && pcaPrescale != 0xFF;
    {
      const int expect = (int)((float)SPOTTY_OSC_HZ / (SPOTTY_PWM_HZ * 4096.0f) + 0.5f) - 1;
      if (!pcaAlive) {
        LOG.println();
        LOG.printf("[!!] PCA9685 НЕ ОТВЕЧАЕТ на 0x%02X (SDA %u, SCL %u). Делитель прочитан как %u.\n",
                      SPOTTY_PCA_ADDR, SPOTTY_I2C_SDA, SPOTTY_I2C_SCL, pcaPrescale);
        LOG.println("     Взвод запрещён. Проверить: питание VCC драйвера (логика), GND,");
        LOG.println("     провода SDA/SCL и разъём на плате, перемычки адреса A0..A5.");
      } else if (abs((int)pcaPrescale - expect) > 1) {
        LOG.printf("[!] делитель %u, для %.0f Гц ожидался %d. Частота ШИМ не та, что задана.\n",
                      pcaPrescale, SPOTTY_PWM_HZ, expect);
      }
    }
    pcaUsPerTick = 1000000.0;
    pcaUsPerTick *= (uint16_t)(pcaPrescale + 1);
    pcaUsPerTick /= (double)SPOTTY_OSC_HZ;
    pcaAllOutputsOff();
    delay(50);
    releaseAll();                 // выход из setup с заведомо снятым сигналом
  }

  assumeStartPose();        // лёжа (START_LYING) либо нули — см. REST_*_DEG

  loadGaitPreset();        // действующие параметры = пресет походки по умолчанию

  LOG.println();
  LOG.println("Spotty gait_test — походки в пространстве суставов, поза приседа");
  LOG.printf("DRY_RUN=%s  PCA=0x%02X  SDA=%u SCL=%u  %.0f Гц  %.2f мкс/град\n",
                DRY_RUN ? "true" : "false", SPOTTY_PCA_ADDR,
                SPOTTY_I2C_SDA, SPOTTY_I2C_SCL, SPOTTY_PWM_HZ, SPOTTY_US_PER_DEG);
  if (!DRY_RUN) {
    LOG.println("ВНИМАНИЕ: DRY_RUN СНЯТ — скетч подаёт ШИМ на серво.");
    LOG.println("Робот должен быть ВЫВЕШЕН, питание с ограничением тока,");
    LOG.println("разрыв питания под рукой. Сигнал сейчас снят, серво мягкие.");
  }
  // ---- сверка быстрого пути записи с формулой библиотеки -------------------
  // Вся калибровка снята через Adafruit_PWMServoDriver::writeMicroseconds.
  // Быстрый путь обязан давать ТО ЖЕ число тактов на всём рабочем окне.
  // Проверка ловит опечатку в формуле и неверный делитель; она НЕ доказывает,
  // что я верно помню исходник библиотеки — это оператор видит глазом по тому,
  // что поза после перезаливки осталась прежней.
  if (!DRY_RUN) {
    int mism = 0;
    for (uint16_t us = SPOTTY_ABS_MIN_US; us <= SPOTTY_ABS_MAX_US; us++) {
      double pl = 1000000;
      uint16_t pre = pcaPrescale; pre += 1;
      pl *= pre;
      pl /= (double)SPOTTY_OSC_HZ;
      double pulse = us;
      pulse /= pl;
      uint16_t libTicks = (uint16_t)pulse;
      if (libTicks != usToTicksBase(us)) {
        if (mism < 3) LOG.printf("[!] расхождение при %u мкс: библиотека %u, быстрый путь %u\n",
                                    us, libTicks, usToTicksBase(us));
        mism++;
      }
    }
    pcaFastReady = (mism == 0);
    LOG.printf("PCA9685: делитель %u, такт %.4f мкс, 1500 мкс = %u тактов\n",
                  pcaPrescale, pcaUsPerTick, usToTicks(1500));
    if (pcaFastReady)
      LOG.printf("Сверка быстрого пути пройдена на всём окне %u..%u мкс.\n",
                    SPOTTY_ABS_MIN_US, SPOTTY_ABS_MAX_US);
    else
      LOG.printf("СВЕРКА НЕ ПРОЙДЕНА: %d расхождений. ШИМ запрещён.\n", mism);

    // Генератор PCA9685: замер по зонду и поправка. Суставы не трогает —
    // пишется только свободный канал зонда, и тот гасится после замера.
    spottyOscBoot(pwm, LOG);
  } else {
    pcaFastReady = true;
  }

  // IMU: своя шина, серво при этом мягкие — самое время калибровать гиро.
  spottyImuBegin(LOG);

  // Самопроверка таблиц пределов. Пока она не пройдена, взвод запрещён:
  // ошибка в таблице опаснее любой ошибки в траектории, потому что кламп
  // сам построен на этих таблицах.
  LOG.println();
  LOG.println("--- жёсткие пределы каналов ---");
  tablesOk = spottyLimitsSelfCheck(true) && pcaFastReady && (DRY_RUN || pcaAlive);
  LOG.println();
  if (!tablesOk)
    LOG.println("ТАБЛИЦЫ НЕСОГЛАСОВАНЫ. Команды 'n' и 'w' заблокированы.");
  preflight(true);
  help();

#if SPOTTY_WEB
  // Не блокирует: сеть поднимается отдельной задачей на ядре 0. Если сети
  // нет — скетч работает как раньше, через USB, и скажет об этом в логе.
  spottyWebBegin();
#endif
}

// ===========================================================================
// РАЗБОР КОМАНД
// ---------------------------------------------------------------------------
// Ввод построчный: у команд появились аргументы, одной клавишей их не задать.
// Две уступки практике:
//   - строка исполняется и по ПАУЗЕ, а не только по Enter: Serial Monitor
//     с настройкой «No line ending» иначе не работает вовсе;
//   - 'x' и 'r' срабатывают немедленно с одной клавиши, если строка пуста.
//     Аварийный останов не должен ждать ни Enter, ни таймаута.
// ===========================================================================
char cmdLine[40];
uint8_t cmdLen = 0;
unsigned long lastRxMs = 0;
static const unsigned long LINE_IDLE_MS = 120;

void doStop() {
  if (speedRamping) {
    speedRamping = false;
    LOG.printf(">> РАЗГОН ОСТАНОВЛЕН. Последний период %.0f мс, требовалось %.0f°/с.\n",
                  pCycleMs, peakRateDps(pCycleMs));
    LOG.println("   Это и есть замер: запиши период, при котором ноги начали отставать.");
  }
  // Во время выхода в позу цели — это КОНЕЧНАЯ поза, и HOLD без заморозки
  // довёл бы движение до конца. 'x' обязан остановить там, где стоим.
  if (mode == MODE_RAMP)
    for (uint8_t leg = 0; leg < LEG_COUNT; leg++)
      for (uint8_t j = 0; j < JOINT_PER_LEG; j++)
        tgtAngle[leg][j] = curAngle[leg][j];
  rampViaActive = false; rampToRest = false;
  trickAbort();                     // трюк замирает там, где стоит; 'n' — в позу
  mode = MODE_HOLD;
  LOG.println(">> HOLD (удержание текущего положения)");
}

// Изменение параметра запрещено на ходу: пересчёт траектории под ногами
// оператора — это ровно тот класс ошибок, от которого стоит кламп.
bool paramGuard() {
  if (mode == MODE_WALK) { LOG.println("Идёт походка. Сначала 'x'."); return false; }
  return true;
}

void afterParamChange() {
  extern int8_t profIdx;
  profIdx = -1;                             // ручная правка: это уже не профиль
  preflight(true);
}

// Присед и отношение звеньев меняют САМУ ПОЗУ, а не только траекторию.
// Робот в неё не поедет сам: смена позы под током — это движение, а движение
// начинается только по явной команде оператора.
void poseChanged() {
  if (havePose)
    LOG.println("[i] Поза изменилась. Робот стоит в прежней — 'n' переведёт в новую.");
}

/* ---------------------------------------------------------------------------
 * ОХРАНА ПАРАМЕТРОВ ПО ДВИЖКУ.
 *
 * Параметр не своего движка НЕ ИГНОРИРУЕТСЯ МОЛЧА. Молчаливое игнорирование
 * — это ровно тот случай, когда оператор крутит ручку, ничего не происходит,
 * и он делает вывод о железе. Отказ обязан назвать замену.
 * ------------------------------------------------------------------------- */
bool angularOnly(const char *what, const char *instead) {
  if (pEngine != 1) return true;
  LOG.printf("'%s' — параметр УГЛОВОГО движка, сейчас работает декартов.\n", what);
  LOG.printf("    В декартовом это: %s. Вернуть угловой: 'G 0'.\n", instead);
  return false;
}

bool cartesianOnly(const char *what, const char *instead) {
  if (pEngine == 1) return true;
  LOG.printf("'%s' — параметр ДЕКАРТОВА движка, сейчас работает угловой.\n", what);
  LOG.printf("    В угловом это: %s. Включить декартов: 'G 1'.\n", instead);
  return false;
}

/*
 * ВОРОТА ПО ЗАМЕРУ ЗВЕНЬЕВ. Декартов движок считает от STL-КАНДИДАТОВ, а не
 * от замеров. Считать по кандидатам можно и нужно — это и есть подготовка.
 * Двигать по ним железо нельзя, пока их не подтвердили штангенциркулем.
 *
 * Поэтому 'p' работает всегда, а 'n', 'w' и 'z' в декартовом режиме
 * отказывают, пока SPOTTY_LINKS_MEASURED == 0.
 */
bool linksGate() {
  if (pEngine != 1) return true;
#if SPOTTY_LINKS_MEASURED
  return true;
#else
  LOG.println();
  LOG.println("ОТКАЗ: декартов движок считает по STL-КАНДИДАТАМ, не по замерам.");
  LOG.printf("   бедро %.2f (M2), голень %.2f (M3), хип %.2f (M1) — из STL,\n",
                L_FEMUR_MM, L_TIBIA_MM, L_HIP_MM);
  LOG.println("   подгонкой окружностей по вершинам. Это кандидаты, не измерения.");
  LOG.println("   Считать по ним можно: 'p' работает и печатает все числа.");
  LOG.println("   Двигать железо — нет.");
  LOG.println();
  LOG.println("   Снять M1/M2/M3 штангенциркулем (межосевые расстояния, не габарит),");
  LOG.println("   вписать в gait_test.ino и поставить SPOTTY_LINKS_MEASURED 1.");
  LOG.println("   Пока не снято — 'G 0' и угловой движок работают как работали.");
  return false;
#endif
}

// ===========================================================================
// ПРОФИЛИ ХОДЬБЫ — команда 'M' (2026-09-30). Таблица — spotty_profiles.h.
// Профиль — это ТОЛЬКО параметры, ровно те же, что ставят g t k d T q b m f S
// (или G H P C V W B). Движения профиль не начинает: если поза изменилась,
// робот стоит в прежней, и 'n' переводит в новую — как у 'q' и 'H'.
// ===========================================================================
int8_t profIdx = -1;          // последний применённый профиль; ручная правка -> -1

void applyProfile(uint8_t i) {
  const GaitProfile &P = PROFILES[i];
  gaitIdx = P.gait;
  loadGaitPreset();
  pEngine = P.engine;
  pTrimDeg = P.b;  pMaxRateDps = P.m;
  pCrouchDeg = P.q;
  if (P.engine == 0) {
    pAmpThigh = P.t;  pAmpKnee = P.k;  pDuty = P.d;  pCycleMs = P.T;
    pFlatPath = P.f != 0;  pSmoothSwing = P.S != 0;
  } else {
    pHeightMm = P.H;  pSpanMm = P.P;  pLiftMm = P.C;  pVelMmS = P.V;  pSwingMs = P.W;
    pShiftGain = P.B;
    recalcCartesianTiming();
  }
}

void profileList() {
  LOG.println("Профили ходьбы ('M <имя|номер>'), параметры меняются, движения нет:");
  for (uint8_t i = 0; i < PROFILE_COUNT; i++)
    LOG.printf("  %2u %-8s %-20s %s%s\n", i, PROFILES[i].name, PROFILES[i].ru, PROFILES[i].note,
               (int8_t)i == profIdx ? "   <- сейчас" : "");
}

// Для стенда (trace) и пульта: таблица static, наружу — только через эти.
uint8_t profileCount() { return PROFILE_COUNT; }
const GaitProfile *profileDef(uint8_t i) { return i < PROFILE_COUNT ? &PROFILES[i] : nullptr; }

void handleLine(char *ln) {
  while (*ln == ' ' || *ln == '\t') ln++;
  if (!*ln) return;
  char cmd = *ln;
  char *rest = ln + 1;
  while (*rest == ' ' || *rest == '\t') rest++;

  // Голая цифра — число циклов, как было до появления аргументов.
  if (cmd >= '1' && cmd <= '9' && !*rest) {
    walkCycles = (uint8_t)(cmd - '0');
    LOG.printf("N = %u циклов\n", walkCycles);
    return;
  }

  switch (cmd) {
    case 'i': {                             // imu ... — IMU, только измерение
      if (strncmp(ln, "imu", 3)) { LOG.println("неизвестная команда, 'h' — справка"); return; }
      const char *ia = ln + 3; while (*ia == ' ') ia++;
      bool blocking = !strncmp(ia, "cal", 3);          // калибровка держит цикл ~1 с
      if (blocking && (mode == MODE_WALK || mode == MODE_RAMP || mode == MODE_ARM)) {
        LOG.println("Идёт движение или взвод. Сначала 'x'."); return;
      }
      spottyImuCommand(ia, LOG);
      return;
    }
    case 'o': {                             // osc ... — генератор PCA9685
      if (strncmp(ln, "osc", 3)) { LOG.println("неизвестная команда, 'h' — справка"); return; }
      if (DRY_RUN) { LOG.println("DRY_RUN: драйвера нет, мерить нечего."); return; }
      if (mode == MODE_WALK || mode == MODE_RAMP || mode == MODE_ARM) {
        LOG.println("Идёт движение или взвод. Сначала 'x'."); return;
      }
      spottyOscCommand(ln + 3, pwm, engaged, LOG);
      // В HOLD углы пересчитываются в такты каждый тик — новая K уйдёт
      // на шину сама на следующем кадре.
      return;
    }
    case 'M': {                             // профиль ходьбы, см. ПРОФИЛИ
      if (!*rest) { profileList(); return; }
      if (!paramGuard()) return;
      int found = -1;
      if (*rest >= '0' && *rest <= '9') {
        int v = atoi(rest);
        if (v >= 0 && v < (int)PROFILE_COUNT) found = v;
      } else {
        for (uint8_t i = 0; i < PROFILE_COUNT; i++)
          if (!strcmp(rest, PROFILES[i].name)) { found = i; break; }
      }
      if (found < 0) { LOG.println("нет такого профиля, 'M' — список"); return; }
      const GaitProfile &P = PROFILES[found];
      applyProfile((uint8_t)found);
      LOG.printf(">> профиль '%s' — %s\n", P.name, P.ru);
      if (P.engine == 0)
        LOG.printf("   g %u · t %.0f · k %.0f · d %.2f · T %.0f · q %.0f · b %.0f · m %.0f · f %u · S %u\n",
                   P.gait, P.t, P.k, P.d, P.T, P.q, P.b, P.m, P.f, P.S);
      else
        LOG.printf("   G 1 · g %u · H %.0f · P %.0f · C %.0f · V %.0f · W %.0f · B %.2f · m %.0f\n",
                   P.gait, P.H, P.P, P.C, P.V, P.W, P.B, P.m);
      if (P.air) LOG.println("[!!] Профиль ТОЛЬКО НА ВЕСУ: на полу он уронит робота.");
      if (P.m > 100.0f) LOG.printf("[!] Быстрый профиль (m %.0f): предел скорости серво не измерен ('z'). Сначала на подвесе.\n", P.m);
      poseChanged(); afterParamChange();
      profIdx = (int8_t)found;               // afterParamChange сбросил — ставим после
      return;
    }
    case 'e': {                             // трюки, см. ТРЮКИ
      if (!*rest) { trickList(); return; }
      if (!strncmp(rest, "hip", 3) && (rest[3] == ' ' || rest[3] == 0)) {
        const float v = atof(rest + 3);
        if (v != 1.0f && v != -1.0f) { LOG.println("e hip <1|-1>: знак хипа, проверенный 'e hiptest'"); return; }
        TRICK_HIP_OUT = v; trickHipOk = true;
        LOG.printf(">> знак хипа для трюков %+.0f, трюки с хипами открыты до перезагрузки\n", v);
        return;
      }
      int found = -1;
      if (*rest >= '0' && *rest <= '9') {
        int v = atoi(rest);
        if (v >= 0 && v < (int)TRICK_COUNT) found = v;
      } else {
        for (uint8_t i = 0; i < TRICK_COUNT; i++)
          if (!strcmp(rest, TRICKS[i].name)) { found = i; break; }
      }
      if (found < 0) { LOG.println("нет такого трюка, 'e' — список"); return; }
      if (!tablesOk) { LOG.println("Заблокировано: самопроверка пределов не пройдена."); return; }
      if (mode == MODE_WALK) { LOG.println("Идёт походка. Сначала 'x'."); return; }
      if (!engaged || !havePose || mode != MODE_HOLD) {
        LOG.println("Сначала 'n' — трюк начинается из позы."); return;
      }
      if (!trickStart((uint8_t)found, millis())) {
        LOG.printf("ОТКАЗ: трюк '%s': %s\n", TRICKS[found].name, trickErr); return;
      }
      LOG.printf(">> ТРЮК '%s' — %s. 'x' — замереть, 'n' — в позу.\n", TRICKS[found].name, TRICKS[found].ru);
      return;
    }
    case 'p': preflight(true); return;
    case 'h': help();          return;
    case 's': status();        return;
    case 'r': releaseAll();    return;
    case 'x': doStop();        return;

    case 'n':
      if (!DRY_RUN && !pcaAlive) { LOG.println("Заблокировано: PCA9685 не отвечает на шине I2C, см. лог загрузки."); return; }
      if (!tablesOk) { LOG.println("Заблокировано: самопроверка пределов не пройдена."); return; }
      if (!linksGate()) return;
      if (!preflight(false)) return;
      setTargetsToPose();
      if (engaged) {                       // уже под током — сразу рампа
        beginRamp(millis());
        LOG.println(">> RAMP -> поза");
      } else {
        armT0 = millis(); armLeftPrinted = -1; mode = MODE_ARM;
        LOG.println();
        LOG.println(">> ВЗВОД. Сейчас будет ПЕРВАЯ подача ШИМ.");
        if (START_LYING) {
          LOG.println("   Допущение: робот ЛЕЖИТ, ноги сложены (REST_*_DEG). Первый кадр");
          LOG.println("   ставит суставы туда, дальше — плавный подъём. Если робот");
          LOG.println("   висит или ноги не сложены — серво дёрнутся. Руки убрать.");
        } else {
          LOG.println("   Серво рванут из того положения, куда их увела гравитация,");
          LOG.println("   в свои нули. Ноги должны быть свободны, руки убрать.");
        }
        LOG.println("   Любая клавиша — отмена.");
      }
      return;

    case 'l':                               // лечь: плавно в позу лёжа
      if (!engaged || mode == MODE_ARM) { LOG.println("ШИМ не подан — робот и так мягкий."); return; }
      if (mode == MODE_WALK) { LOG.println("Идёт походка. Сначала 'x'."); return; }
      setTargetsToRest();
      beginRamp(millis());
      rampToRest = true;
      LOG.println(">> УКЛАДКА -> лёжа");
      return;

    case 'w':
      if (!tablesOk)  { LOG.println("Заблокировано: самопроверка пределов не пройдена."); return; }
      if (!havePose)  { LOG.println("Сначала 'n' — взвод и выход в позу."); return; }
      if (!linksGate()) return;
      if (!preflight(false)) return;
      gaitDone = 0.0f; rampLastCycle = 0; speedRamping = false; walkStopAt = 1e9f;
      walkT0 = millis(); mode = MODE_WALK;
      LOG.printf(">> WALK '%s': %u цикл(ов) по %.0f мс%s\n",
                    GAITS[gaitIdx].name, walkCycles, pCycleMs,
                    pTurn ? (pTurn > 0 ? ", разворот ВЛЕВО" : ", разворот ВПРАВО") : "");
      return;

    case 'g': {
      if (!*rest) { LOG.println("g <0..4> либо g <имя>"); return; }
      if (!paramGuard()) return;
      int found = -1;
      if (*rest >= '0' && *rest <= '9') {
        int v = atoi(rest);
        if (v >= 0 && v < (int)GAIT_COUNT) found = v;
      } else {
        for (uint8_t i = 0; i < GAIT_COUNT; i++)
          if (!strncmp(rest, GAITS[i].name, strlen(GAITS[i].name))) { found = i; break; }
      }
      if (found < 0) { LOG.println("нет такой походки, 'h' — список"); return; }
      gaitIdx = (uint8_t)found;
      loadGaitPreset();          // смена походки ВСЕГДА возвращает её пресет
      LOG.printf(">> походка '%s', параметры взяты из пресета\n", GAITS[gaitIdx].name);
      afterParamChange();
      return;
    }

    case 'c': {
      if (!paramGuard()) return;
      int v = atoi(rest);
      if (v < 1 || v > 99) { LOG.println("c <1..99>"); return; }
      walkCycles = (uint8_t)v;
      LOG.printf("N = %u циклов\n", walkCycles);
      return;
    }

    case 't': {
      if (!paramGuard()) return;
      if (!angularOnly("t", "длина шага в мм, 'P'")) return;
      float v = atof(rest);
      if (v < 0.0f || v > 60.0f) { LOG.println("t <0..60> градусов"); return; }
      pAmpThigh = v; LOG.printf("бедро ±%.1f°\n", pAmpThigh); afterParamChange(); return;
    }
    case 'k': {
      if (!paramGuard()) return;
      if (!angularOnly("k", "подъём стопы в мм, 'C'")) return;
      float v = atof(rest);
      if (v < 0.0f || v > 90.0f) { LOG.println("k <0..90> градусов"); return; }
      pAmpKnee = v; LOG.printf("колено +%.1f°\n", pAmpKnee); afterParamChange(); return;
    }
    case 'a': {
      if (!paramGuard()) return;
      float v = atof(rest);
      if (v < 0.0f || v > 20.0f) { LOG.println("a <0..20> градусов"); return; }
      pAmpHip = v; LOG.printf("хип ±%.1f°\n", pAmpHip); afterParamChange(); return;
    }
    case 'd': {
      if (!paramGuard()) return;
      if (!angularOnly("d", "duty выводится из 'V' и 'W'")) return;
      float v = atof(rest);
      if (v < 0.10f || v > 0.90f) { LOG.println("d <0.10..0.90>"); return; }
      pDuty = v; LOG.printf("duty %.2f (опора %.0f%% цикла)\n", pDuty, pDuty * 100.0f);
      afterParamChange(); return;
    }
    case 'T': {
      if (!paramGuard()) return;
      if (!angularOnly("T", "период выводится из 'V' и 'W'")) return;
      float v = atof(rest);
      if (v < 300.0f || v > 10000.0f) { LOG.println("T <300..10000> мс"); return; }
      pCycleMs = v; LOG.printf("период %.0f мс\n", pCycleMs); afterParamChange(); return;
    }
    case 'u': {
      if (!paramGuard()) return;
      int v = atoi(rest);
      if (v < -1 || v > 1) { LOG.println("u <-1|0|1>"); return; }
      pTurn = v;
      LOG.printf("разворот %s\n", v == 0 ? "выключен" : (v > 0 ? "ВЛЕВО" : "ВПРАВО"));
      afterParamChange(); return;
    }

    case 'z': {
      if (!tablesOk) { LOG.println("Заблокировано: самопроверка не пройдена."); return; }
      if (!havePose) { LOG.println("Сначала 'n' — взвод и выход в позу."); return; }
      if (!linksGate()) return;
      if (!preflight(false)) return;
      gaitDone = 0.0f; rampLastCycle = 0; speedRamping = true; walkStopAt = 1e9f;
      walkT0 = millis(); mode = MODE_WALK;
      LOG.println();
      LOG.printf(">> РАЗГОН. Период будет укорачиваться в %.2f раза каждые %u цикла,\n",
                    1.0f / SPEEDRAMP_FACTOR, SPEEDRAMP_EVERY);
      LOG.printf("   ограничитель поднимается следом (потолок %.0f°/с).\n", RATE_CEILING_DPS);
      LOG.println("   ПРЕДЕЛЫ СУСТАВОВ ПРИ ЭТОМ НЕ ТРОГАЮТСЯ — кламп работает как обычно.");
      LOG.println("   Робот вывешен, ток ограничен, разрыв под рукой.");
      LOG.println("   Жми 'x', как только ноги начнут отставать от печатаемой фазы");
      LOG.println("   либо серво загудят на упоре. Период в этот момент и есть замер.");
      return;
    }

    case 'S': {
      if (!paramGuard()) return;
      if (!angularOnly("S", "профиль переноса задан безье")) return;
      int v = atoi(rest);
      if (v < 0 || v > 1) { LOG.println("S <0|1>: 0 линейный перенос, 1 сглаженный"); return; }
      pSmoothSwing = (v != 0);
      LOG.printf("профиль переноса: %s\n", pSmoothSwing ? "СГЛАЖЕННЫЙ (стыковка по скорости)" : "линейный");
      afterParamChange(); return;
    }

    case 'm': {
      if (!paramGuard()) return;
      float v = atof(rest);
      if (v < 20.0f || v > RATE_CEILING_DPS) { LOG.printf("m <20..%.0f> градусов в секунду\n", RATE_CEILING_DPS); return; }
      pMaxRateDps = v;
      LOG.printf("ограничитель походки %.0f°/с (рампа остаётся %.0f°/с)\n",
                    pMaxRateDps, RAMP_RATE_DPS);
      afterParamChange(); return;
    }

    case 'q': {
      if (!paramGuard()) return;
      if (!angularOnly("q", "высота корпуса в мм, 'H'")) return;
      float v = atof(rest);
      if (v < 0.0f || v > 120.0f) { LOG.println("q <0..120> градусов"); return; }
      pCrouchDeg = v;
      LOG.printf("присед: колено %.0f°, бедро %.1f°, нога короче на %.0f%%\n",
                    pCrouchDeg, stanceThighDeg(),
                    100.0f * (1.0f - stanceReach() / (1.0f + linkRatio)));
      poseChanged(); afterParamChange(); return;
    }
    case 'b': {
      if (!paramGuard()) return;
      if (!angularOnly("b", "сдвиг корпуса в мм, 'X'")) return;
      float v = atof(rest);
      if (v < -20.0f || v > 20.0f) { LOG.println("b <-20..20> градусов, + = корпус вперёд"); return; }
      pTrimDeg = v;
      LOG.printf("трим корпуса %+.1f° (%s)\n", pTrimDeg,
                    pTrimDeg > 0 ? "корпус ВПЕРЁД относительно стоп"
                                 : (pTrimDeg < 0 ? "корпус НАЗАД" : "выключен"));
      poseChanged(); afterParamChange(); return;
    }

    case 'f': {
      if (!paramGuard()) return;
      if (!angularOnly("f", "форма опоры задаётся продавом 'A'")) return;
      int v = atoi(rest);
      if (v < 0 || v > 1) { LOG.println("f <0|1>: 0 дуга, 1 плоская"); return; }
      pFlatPath = (v != 0);
      LOG.printf("траектория стопы: %s\n", pFlatPath ? "ПЛОСКАЯ" : "дуга");
      afterParamChange(); return;
    }
    case 'L': {
      if (!paramGuard()) return;
      if (!angularOnly("L", "отношение не нужно, длины звеньев заданы прямо")) return;
      float v = atof(rest);
      if (v < 0.5f || v > 2.0f) { LOG.println("L <0.50..2.00>"); return; }
      linkRatio = v;
      LOG.printf("отношение звеньев голень/бедро k = %.2f%s\n", linkRatio,
                    fabsf(linkRatio - 1.0f) < 1e-3f ? "  (ДОПУЩЕНИЕ по умолчанию)" : "  (задано оператором)");
      poseChanged(); afterParamChange(); return;
    }

    // ---------------------------------------------------------------------
    // ДЕКАРТОВ ДВИЖОК
    // ---------------------------------------------------------------------
    case 'G': {
      if (!paramGuard()) return;
      int v = atoi(rest);
      if (v < 0 || v > 1) { LOG.println("G <0|1>: 0 угловой движок, 1 декартов"); return; }
      pEngine = v;
      if (pEngine == 1) {
        recalcCartesianTiming();
        LOG.println("движок: ДЕКАРТОВ (мм). Шаг 'P', высота 'H', подъём 'C',");
        LOG.println("   скорость 'V', перенос 'W', сдвиг корпуса 'X'/'Y', крен 'R'.");
      } else {
        LOG.println("движок: УГЛОВОЙ (градусы суставов), как было.");
      }
      poseChanged(); afterParamChange(); return;
    }

    case 'H': {
      if (!paramGuard()) return;
      if (!cartesianOnly("H", "присед в градусах колена, 'q'")) return;
      float v = atof(rest);
      const float lo = fabsf(L_FEMUR_MM - L_TIBIA_MM) + 5.0f;
      const float hi = L_FEMUR_MM + L_TIBIA_MM - 5.0f;
      if (v < lo || v > hi) { LOG.printf("H <%.0f..%.0f> мм\n", lo, hi); return; }
      pHeightMm = v;
      LOG.printf("высота: стопа на %.1f мм под осью хипа (нога вытянута на %.0f%%)\n",
                    pHeightMm, 100.0f * pHeightMm / (L_FEMUR_MM + L_TIBIA_MM));
      poseChanged(); afterParamChange(); return;
    }
    case 'P': {
      if (!paramGuard()) return;
      if (!cartesianOnly("P", "размах бедра в градусах, 't'")) return;
      float v = atof(rest);
      if (v < 0.0f || v > 120.0f) { LOG.println("P <0..120> мм (полуразмах; полный шаг вдвое больше)"); return; }
      pSpanMm = v; recalcCartesianTiming();
      LOG.printf("шаг: ±%.1f мм, полный %.1f мм; период стал %.0f мс, duty %.2f\n",
                    pSpanMm, 2.0f * pSpanMm, pCycleMs, pDuty);
      afterParamChange(); return;
    }
    case 'C': {
      if (!paramGuard()) return;
      if (!cartesianOnly("C", "подъём колена в градусах, 'k'")) return;
      float v = atof(rest);
      if (v < 0.0f || v > 80.0f) { LOG.println("C <0..80> мм"); return; }
      pLiftMm = v;
      LOG.printf("подъём стопы в переносе %.1f мм (фактический, не «добавка»)\n", pLiftMm);
      afterParamChange(); return;
    }
    case 'A': {
      if (!paramGuard()) return;
      if (!cartesianOnly("A", "аналога нет: у углового движка опора всегда прямая")) return;
      float v = atof(rest);
      if (v < 0.0f || v > 15.0f) { LOG.println("A <0..15> мм"); return; }
      pPenetMm = v;
      LOG.printf("продав опоры %.1f мм%s\n", pPenetMm,
                    pPenetMm < 0.01f ? " (опора прямая, как у углового движка)" : "");
      afterParamChange(); return;
    }
    case 'V': {
      if (!paramGuard()) return;
      if (!cartesianOnly("V", "скорость задаётся периодом 'T'")) return;
      float v = atof(rest);
      if (v < 5.0f || v > 600.0f) { LOG.println("V <5..600> мм/с"); return; }
      pVelMmS = v; recalcCartesianTiming();
      LOG.printf("скорость корпуса %.0f мм/с -> опора %.0f мс, период %.0f мс, duty %.2f\n",
                    pVelMmS, pDuty * pCycleMs, pCycleMs, pDuty);
      afterParamChange(); return;
    }
    case 'W': {
      if (!paramGuard()) return;
      if (!cartesianOnly("W", "перенос задаётся через duty 'd'")) return;
      float v = atof(rest);
      if (v < 50.0f || v > 3000.0f) { LOG.println("W <50..3000> мс — время переноса"); return; }
      pSwingMs = v; recalcCartesianTiming();
      LOG.printf("перенос %.0f мс -> период %.0f мс, duty %.2f\n",
                    pSwingMs, pCycleMs, pDuty);
      afterParamChange(); return;
    }
    case 'D': {
      if (!paramGuard()) return;
      if (!cartesianOnly("D", "аналога нет")) return;
      float v = atof(rest);
      if (v < -180.0f || v > 180.0f) { LOG.println("D <-180..180> градусов"); return; }
      pCrabDeg = v;
      LOG.printf("направление хода %+.0f° — %s\n", pCrabDeg,
                    fabsf(pCrabDeg) < 1.0f ? "вперёд" : "КРАБОМ, курс не меняется");
      if (fabsf(pCrabDeg) > 1.0f) {
        LOG.println("   Это НЕ разворот: корпус едет боком, нос смотрит туда же.");
        LOG.println("   Разворот — это 'u', он через хипы и от 'D' независим.");
      }
      afterParamChange(); return;
    }
    case 'X': {
      if (!paramGuard()) return;
      if (!cartesianOnly("X", "трим в градусах виртуальной ноги, 'b'")) return;
      float v = atof(rest);
      if (v < -80.0f || v > 80.0f) { LOG.println("X <-80..80> мм, + = корпус вперёд"); return; }
      pShiftXMm = v;
      LOG.printf("сдвиг корпуса %+.1f мм (%s; стопы уезжают в другую сторону)\n",
                    pShiftXMm, pShiftXMm > 0 ? "ВПЕРЁД" : (pShiftXMm < 0 ? "НАЗАД" : "выключен"));
      poseChanged(); afterParamChange(); return;
    }
    case 'Y': {
      if (!paramGuard()) return;
      if (!cartesianOnly("Y", "аналога нет")) return;
      float v = atof(rest);
      if (v < -60.0f || v > 60.0f) { LOG.println("Y <-60..60> мм, + = корпус влево"); return; }
      pShiftYMm = v;
      LOG.printf("боковой сдвиг корпуса %+.1f мм\n", pShiftYMm);
      poseChanged(); afterParamChange(); return;
    }
    /* ПЕРЕНОС КОРПУСА ПО ФАЗЕ. Амплитуду задать НЕЛЬЗЯ — она считается из
       геометрии (инцентр опорного треугольника). Оператору остаётся доля от
       неё: 0 выключить, 1 полный расчётный перенос. Меньше единицы — способ
       подойти к расчёту осторожно, больше — способ проверить, что дальше
       становится хуже, а не лучше. */
    case 'B': {
      if (!paramGuard()) return;
      if (!cartesianOnly("B", "аналога нет: угловой движок корпус не переносит")) return;
      float v = atof(rest);
      if (v < 0.0f || v > 1.5f) {
        LOG.println("B <0..1.5> доля РАСЧЁТНОЙ амплитуды. 0 = выключить.");
        return;
      }
      if (v > 0.0f && bodyShiftAmpMm() <= 0.0f) {
        LOG.println("ОТКАЗ: перенос корпуса требует ПРОДОЛЬНОЙ базы, а она НЕ ИЗМЕРЕНА.");
        LOG.println("   Амплитуда — это расстояние от центра прямоугольника стоп до");
        LOG.println("   инцентра опорного треугольника: sqrt(a^2+b^2) - a, где a —");
        LOG.println("   ПОЛУПРОДОЛЬНАЯ база. При a = 0 формула вырождается и даёт");
        LOG.printf("   %.1f мм — увезти корпус на всю полуширину. Это не осторожность,\n",
                      0.5f * BASE_LAT_MM + L_HIP_MM);
        LOG.println("   это опрокидывание.");
        LOG.println();
        LOG.println("   M4: рулетка, ось переднего хипа до оси заднего. Одна минута.");
        LOG.println("   Вписать BASE_LONG_MM и поставить SPOTTY_BASE_LONG_MEASURED 1.");
        return;
      }
      pShiftGain = v;
      if (pShiftGain <= 0.0f) {
        LOG.println("перенос корпуса по фазе ВЫКЛЮЧЕН (поведение как было)");
      } else {
        const float amp = bodyShiftAmpMm();
        LOG.printf("перенос корпуса по фазе ВКЛЮЧЁН: доля %.2f от расчётных %.1f мм = %+.1f мм\n",
                      pShiftGain, amp, pShiftGain * amp);
        LOG.printf("   расчёт: a=%.1f (полупродольная), b=%.1f (полупоперечная стоп)\n",
                      0.5f * BASE_LONG_MM, 0.5f * BASE_LAT_MM + L_HIP_MM);
        printShiftTable();
        LOG.println("   Знак взят из фазировки текущей походки, не из таблицы.");
      }
      afterParamChange(); return;   // позу это не меняет: сдвиг живёт в цикле
    }
    case 'R': {
      if (!paramGuard()) return;
      if (!cartesianOnly("R", "аналога нет")) return;
      float v = atof(rest);
      if (v < -25.0f || v > 25.0f) { LOG.println("R <-25..25> градусов, + = ЛЕВЫЙ борт вверх"); return; }
      pRollDeg = v;
      LOG.printf("крен %+.1f° (%s борт вверх); нужна только поперечная база %.1f мм\n",
                    pRollDeg, pRollDeg >= 0 ? "левый" : "правый", BASE_LAT_MM);
      poseChanged(); afterParamChange(); return;
    }

    /* Тангаж и рыскание заперты не из осторожности вообще, а по числу.
       Обоим нужна ПРОДОЛЬНАЯ база, а она по STL не определяется: детали
       допускают 135…232 мм. Тангаж 10° при 135 поднимает стопу на 11.9 мм,
       при 232 — на 20.4. Разница 8.5 мм БОЛЬШЕ остатка M9 (до 7 мм), ради
       которого всё и затевалось. Выдуманная база испортила бы ровно тот
       замер, который мы собираемся снимать. */
    case 'E':
    case 'J': {
      if (!paramGuard()) return;
      if (!cartesianOnly(cmd == 'E' ? "E" : "J", "аналога нет")) return;
#if SPOTTY_BASE_LONG_MEASURED
      float v = atof(rest);
      if (v < -25.0f || v > 25.0f) { LOG.println("<-25..25> градусов"); return; }
      if (cmd == 'E') { pPitchDeg = v; LOG.printf("тангаж %+.1f° (+ нос вверх)\n", pPitchDeg); }
      else            { pYawDeg   = v; LOG.printf("рыскание %+.1f° (+ нос влево)\n", pYawDeg); }
      poseChanged(); afterParamChange(); return;
#else
      LOG.printf("ОТКАЗ: %s требует ПРОДОЛЬНОЙ базы, а она НЕ ИЗМЕРЕНА.\n",
                    cmd == 'E' ? "тангаж" : "рыскание");
      LOG.println("   KINEMATICS_AUDIT.md §4: по STL не определяется, детали");
      LOG.println("   допускают 135…232 мм. Ни одна пара крепёжных отверстий");
      LOG.println("   плеча, боковины и крышек не совпадает.");
      LOG.println();
      LOG.println("   Цена гадания: тангаж 10° при базе 135 поднимает стопу на");
      LOG.println("   11.9 мм, при 232 — на 20.4. Разница 8.5 мм БОЛЬШЕ остатка");
      LOG.println("   M9 (до 7 мм), который мы и ловим. Выдуманная база испортит");
      LOG.println("   ровно тот замер, ради которого всё делается.");
      LOG.println();
      LOG.println("   M4: рулетка, ось переднего хипа до оси заднего. Одна минута.");
      LOG.println("   Вписать BASE_LONG_MM и поставить SPOTTY_BASE_LONG_MEASURED 1.");
      LOG.println("   Крен 'R' работает уже сейчас: ему хватает поперечной базы.");
      return;
#endif
    }

    default:
      LOG.println("неизвестная команда, 'h' — справка");
      return;
  }
}

#if SPOTTY_WEB
/*
 * Исполнение строки, пришедшей из браузера. Вызывается ИЗ loop(), на ядре 1,
 * то есть в том же потоке, что и разбор строки из USB.
 *
 * Повторяет семантику pollSerial в единственном особом случае: во время
 * пятисекундного отсчёта взвода ЛЮБАЯ команда — отмена. Иначе кнопка в
 * браузере вела бы себя не так, как клавиша в мониторе порта, а два разных
 * поведения у одной и той же команды — это заготовка для ошибки оператора.
 *
 * Эхо в лог обязательно: оператор должен видеть, ЧТО ушло, рядом с ответом.
 */
void webExecLine(char *ln) {
  if (mode == MODE_ARM) {
    mode = MODE_IDLE;
    LOG.println(">> ВЗВОД ОТМЕНЁН из браузера, ШИМ не подавался");
    return;
  }
  /*
   * ПОЧЕМУ СПРАВКА И СТАТУС ЗАПРЕЩЕНЫ НА ХОДУ ИМЕННО ИЗ БРАУЗЕРА.
   * help() печатает ~35 строк, status() и preflight() по 1.5…2 КБ. На 115200
   * HardwareSerial::write блокирует до вытеснения байтов, то есть 'h' — это
   * ~175 мс, а 'p'/'s' — ~130…170 мс СТОЯЩЕГО loop(). Робот замрёт посреди
   * шага и продолжит с того же места: раму это не ломает, но на полу выглядит
   * как спотыкание, а на подвесе даёт рывок.
   * С клавиатуры поведение НЕ меняем — там оператор жмёт осознанно и видит
   * порт. В браузере кнопка большая и нажимается мимоходом.
   */
  if (mode == MODE_WALK && (*ln == 'h' || *ln == 's' || *ln == 'p')) {
    LOG.printf("[веб] '%c' на ходу не выполняю: печать заняла бы сотни мс "
               "и робот споткнётся. Сначала 'x'.\n", *ln);
    return;
  }
  LOG.printf("[веб] %s\n", ln);
  handleLine(ln);
}

/*
 * Что делать при потере пульта. На ходу и под током — обычный СТОП. Во время
 * взвода останавливать нечего: отменяем сам взвод, и ШИМ не подаётся вовсе.
 */
/*
 * ПОТЕРЯ ПУЛЬТА — что делать, зависит от действия (ревизия 2026-09-27).
 * Заморозка посреди шага — худший вариант: робот стоит на двух-трёх ногах
 * в промежуточной позе. Поэтому движение ДОВОДИТСЯ до устойчивого конца:
 *   взвод (ШИМ ещё не подан)  -> отмена, как раньше;
 *   рампа в позу              -> доезжает в позу и держит её (она и так
 *                                кончается удержанием);
 *   прогон 'w'                -> доходит ТЕКУЩИЙ цикл до конца, затем
 *                                обычный возврат в позу. Оставшиеся циклы
 *                                не выполняются: без пульта робот не идёт;
 *   разгон 'z' (только на весу) -> немедленный стоп, как раньше.
 * Аварийные стопы (кламп, IK, IMU) работают независимо от этого.
 */
void webLostRemote() {
  if (mode == MODE_ARM) {
    mode = MODE_IDLE;
    LOG.println(">> ВЗВОД ОТМЕНЁН: пульт потерян до подачи ШИМ.");
    return;
  }
  if (mode == MODE_RAMP && trickIdx >= 0) {
    // Трюк без пульта не продолжаем: из любого кадра — в позу через точку.
    LOG.println(">> Пульт потерян: трюк прерван, возврат в позу.");
    setTargetsToPose();
    beginRamp(millis());
    return;
  }
  if (mode == MODE_RAMP) {
    LOG.println(">> Рампа доводится до позы, затем удержание.");
    return;
  }
  if (mode == MODE_WALK && !speedRamping) {
    float end = ceilf(gaitDone);
    if (end < 1.0f) end = 1.0f;
    walkStopAt = end;
    LOG.printf(">> Дохожу текущий цикл (%.2f из %.0f), затем поза и удержание.\n",
                  gaitDone, end);
    return;
  }
  doStop();
}
#endif

void pollSerial() {
  while (Serial.available()) {
    char c = Serial.read();

    // Во время отсчёта ЛЮБОЙ значащий символ — отмена. Это аварийный останов,
    // и он не должен зависеть ни от Enter, ни от разбора строки.
    if (mode == MODE_ARM) {
      if (c == '\n' || c == '\r' || c == ' ' || c == '\t') continue;
      mode = MODE_IDLE; cmdLen = 0;
      LOG.println(">> ВЗВОД ОТМЕНЁН, ШИМ не подавался");
      continue;
    }

    // Аварийные клавиши — немедленно, пока строка пуста.
    if (cmdLen == 0 && (c == 'x' || c == 'r')) {
      if (c == 'x') doStop(); else releaseAll();
      continue;
    }

    if (c == '\n' || c == '\r') {
      cmdLine[cmdLen] = 0;
      if (cmdLen) handleLine(cmdLine);
      cmdLen = 0;
      continue;
    }
    if (cmdLen < sizeof(cmdLine) - 1) cmdLine[cmdLen++] = c;
    lastRxMs = millis();
  }

  // Serial Monitor умеет слать без перевода строки. Исполняем по паузе.
  if (cmdLen && (millis() - lastRxMs) > LINE_IDLE_MS) {
    cmdLine[cmdLen] = 0;
    handleLine(cmdLine);
    cmdLen = 0;
  }
}

#if SPOTTY_WEB
/*
 * Снимок телеметрии для панели. Пишется ТОЛЬКО отсюда, то есть только ядром 1.
 *
 * 20 Гц, а не каждый тик: копия структуры дешёвая, но занимать ею тик 3 мс
 * незачем — панель опрашивает 5 раз в секунду.
 *
 * peakRateDps() прогоняет 400 точек траектории и в тик не помещается. Считать
 * его на ходу и не нужно: параметры во время походки менять запрещено
 * (paramGuard), значит требуемая скорость на ходу не меняется. Пересчитываем
 * на стоящем роботе, раз в секунду.
 */
uint32_t webPubAt = 0, webPeakAt = 0;
float    webPeak  = 0.0f;
bool     webPeakValid = false;

void webPublish(unsigned long now) {
  if (now - webPubAt < 50) return;
  webPubAt = now;

  /*
   * peakRateDps — 401 вызов gaitPose с тригонометрией внутри, порядка
   * 1.5…3 мс. Это ВЕСЬ бюджет тика. Считать его можно только когда серво не
   * движутся: MODE_IDLE, либо HOLD на обесточенном роботе. Прежнее условие
   * (mode != MODE_WALK) пускало расчёт в RAMP и в HOLD под током, и от этого
   * рос tickOverruns — тот самый счётчик, по которому оператору предложено
   * судить о цене Wi-Fi. Метрика травила сама себя.
   */
  const bool quiet = (mode == MODE_IDLE) || !engaged;
  if (quiet && (!webPeakValid || (now - webPeakAt) > 1000)) {
    webPeakAt = now; webPeak = peakRateDps(pCycleMs); webPeakValid = true;
  }

  SpotSnap s;
  s.ms = now;
  s.mode = (uint8_t)mode;
  s.gaitIdx = gaitIdx;
  s.walkCycles = walkCycles;
  s.engaged = engaged;  s.havePose = havePose;  s.tablesOk = tablesOk;
  s.speedRamping = speedRamping;
  s.flatPath = pFlatPath; s.smoothSwing = pSmoothSwing;
  s.turn = (int8_t)pTurn;
  s.cyclesDone = gaitDone;
  s.phase = gaitDone - floorf(gaitDone);
  for (uint8_t leg = 0; leg < LEG_COUNT; leg++)
    for (uint8_t j = 0; j < JOINT_PER_LEG; j++) s.cur[leg][j] = curAngle[leg][j];
  s.duty = pDuty;  s.ampThigh = pAmpThigh;  s.ampKnee = pAmpKnee;
  s.cycleMs = pCycleMs;  s.ampHip = pAmpHip;
  s.crouch = pCrouchDeg;  s.trim = pTrimDeg;  s.linkRatio = linkRatio;
  s.maxRate = pMaxRateDps;  s.peakRate = webPeak;
  s.limitHits = limitHits;  s.tickOverruns = tickOverruns;
  s.busUsLast = busUsLast;  s.busUsMax = busUsMax;
  s.freeHeap = ESP.getFreeHeap();
  // IMU пишется в spottyImuTick на этом же ядре — гонки нет.
  s.imuOk = spImuOk;
  s.imuRoll = spImuRoll - spImuRoll0;  s.imuPitch = spImuPitch - spImuPitch0;
  s.imuYaw = spImuYaw;
  s.imuA[0] = spImuA[0];  s.imuA[1] = spImuA[1];  s.imuA[2] = spImuA[2];
  s.imuStop = spImuStopDeg;
  s.engine = (uint8_t)pEngine;
  s.cH = pHeightMm;  s.cP = pSpanMm;  s.cC = pLiftMm;  s.cA = pPenetMm;
  s.cV = pVelMmS;    s.cW = pSwingMs; s.cD = pCrabDeg;
  s.cX = pShiftXMm;  s.cY = pShiftYMm; s.cR = pRollDeg; s.cB = pShiftGain;
  s.cPitch = pPitchDeg;  s.cYaw = pYawDeg;
  s.trick = trickIdx;  s.trickKey = trickKey;  s.trickHipOk = trickHipOk;
  s.prof = profIdx;
  spotSnapPublish(s);
}
#endif

// Один тик MODE_RAMP: профиль, конец сегмента, «через точку», кадры трюка.
void rampModeTick(unsigned long now) {
  rampTick(now);                         // плавно, все суставы вместе
  if (mode != MODE_RAMP) return;         // ограничитель объявил стоп
  // У трюка сегмент кончается ПО ВРЕМЕНИ: кадр-пауза (те же цели) иначе
  // закончился бы на первом же тике, потому что atTargets() уже истина.
  const bool segDone = (trickIdx >= 0)
      ? (now - rampT0) >= (unsigned long)rampDurMs
      : (atTargets() || (now - rampT0) > (unsigned long)(rampDurMs + RAMP_MS));
  if (segDone) {
    if (rampViaActive) {                 // первый этап из двух пройден
      rampViaActive = false;
      memcpy(tgtAngle, rampGoal, sizeof(rampGoal));
      beginRampSegment(now);
      return;
    }
    if (trickNext(now) || mode == MODE_HOLD) return;   // трюк: следующий кадр или конец
    havePose = !rampToRest;              // лёжа ходить нельзя
    mode = afterRamp;
    LOG.println(rampToRest ? "лёжа. 'r' — снять ШИМ, 'n' — встать" : "поза достигнута");
    rampToRest = false;
  }
}

void loop() {
  pollSerial();
#if SPOTTY_WEB
  // Рядом с pollSerial НАМЕРЕННО: как и 'x' с клавиатуры, СТОП из браузера
  // должен быть услышан между тиками, а не ждать следующего.
  spottyWebReport();                    // печатает только смену состояния сети
  spottyWebPump(webExecLine);           // одна команда за проход
  // Взвод тоже под охраной: при MODE_ARM engaged ещё false, а отсчёт идёт и
  // через 5 секунд сам подаст ШИМ — уже без пульта.
  spottyWebWatchdog(engaged || mode == MODE_ARM, webLostRemote);
#endif

  unsigned long now = millis();
  if (now - tickAt < TICK_MS) return;      // неблокирующий цикл: 'x' слышно всегда
  // Тик не уложился в бюджет. На 3 мс это уже не теория: печать в порт, разбор
  // команды или посылка на шину могут съесть больше. Считаем и показываем в 's',
  // потому что пропущенные тики — это молча срезанная скорость.
  if (now - tickAt > 2UL * TICK_MS && mode != MODE_IDLE) tickOverruns++;
  tickAt = now;

  // Генератор PCA9685: фоновое слежение, раз в 2 с. Новая K уходит на шину
  // сама со следующим кадром — такты пересчитываются каждый тик.
  if (!DRY_RUN) spottyOscTrackTick(pwm, LOG);

  // IMU: чтение раз в SPOTTY_IMU_PERIOD_MS, сводка по окончании прогона 'w'.
  spottyImuTick(mode == MODE_WALK, gaitDone, LOG);
  if (engaged && (mode == MODE_WALK || mode == MODE_RAMP)) {
    float r = 0, pt = 0;
    if (spottyImuTiltFault(&r, &pt)) {        // порог 0 = выключено (умолчание)
      char why[64];
      snprintf(why, sizeof(why), "IMU: крен %+.0f°, тангаж %+.0f°", r, pt);
      freezeAndHold(why);
    }
  }

  switch (mode) {
    case MODE_ARM: {
      int left = (int)((ARM_MS - (now - armT0) + 999) / 1000);
      if ((long)(now - armT0) >= (long)ARM_MS) {
        engaged = true;
        assumeStartPose();                 // серво мягкие были — где лежат, неизвестно
        beginRamp(now);
        /* ПЕРВЫЙ КАДР — посчитать ДО выдачи. Ниже по циклу pcaFlush() уйдёт на
           шину в этом же тике, а pendingTicks до этого места никто не трогал:
           там лежал кадр ПРОШЛОГО сеанса (поза до 'r'), и все 12 серво на
           первые 3 мс получали его. rampTick при t=0 выдаёт ровно стартовую
           позу. Найдено ревью 2026-09-27, подтверждено на стенде. */
        rampTick(now);
        LOG.println(">> ШИМ ПОДАН. RAMP -> поза");
      } else if (left != armLeftPrinted) {
        armLeftPrinted = left;
        LOG.printf("   %d...\n", left);
      }
      break;
    }

    case MODE_RAMP:
      rampModeTick(now);                     // вынесено: тот же тик зовёт стенд trace
      break;

    case MODE_WALK: {
      // ФАЗА КОПИТСЯ ПО ТИКАМ, а не считается как (сейчас - старт)/период.
      // Иначе смена периода на ходу — а этим занят режим разгона — швыряла бы
      // фазу скачком: одно и то же прошедшее время делится на новый период.
      // Накопление делает изменение периода бесшовным по построению.
      gaitDone += (float)TICK_MS / pCycleMs;

      if (speedRamping) {
        uint32_t c = (uint32_t)gaitDone;
        if (c != rampLastCycle) {              // прошёл очередной цикл
          rampLastCycle = c;
          if (c && (c % SPEEDRAMP_EVERY) == 0) speedRampStep();
        }
      } else if (gaitDone >= (float)walkCycles || gaitDone >= walkStopAt) {   // отходили своё — назад в позу
        setTargetsToPose();
        beginRamp(now);
        LOG.printf(">> %u цикл(ов) пройдено, возврат в позу\n", walkCycles);
        break;
      }

      float done  = gaitDone;
      float phase = done - floorf(done);
      float ang[JOINT_PER_LEG];
      ikFail = false;
      for (uint8_t leg = 0; leg < LEG_COUNT; leg++) {
        gaitPose(leg, GAITS[gaitIdx].phase[leg] + phase, ang);
        for (uint8_t j = 0; j < JOINT_PER_LEG; j++) setTarget(leg, j, ang[j]);
      }
      /* Отказ IK на ходу. Предполётная сканирует ТОТ ЖЕ цикл с шагом в тик и
         в норме ловит это до взвода, поэтому отказ здесь означает, что за
         время прогона изменилось что-то, чего меняться не должно было.
         Продолжать нельзя: углы в этот момент не вычислены, наверх ушли
         последние удачные, и с каждым тиком расхождение растёт. */
      if (ikFail) {
        LOG.printf("\n[!!] ОТКАЗ IK на ходу: нога %s, фаза %.3f\n",
                      LEG_NAME[ikFailLeg], ikFailPhase);
        freezeAndHold("стопа вне досягаемости");
        break;
      }
      if (mode != MODE_WALK) break;      // setTarget мог объявить аварийный стоп
      slewToTargets(pMaxRateDps);

      // Печать ~5 раз в секунду. Делитель считается от тика, иначе при
      // изменении TICK_MS частота печати менялась бы вместе с ним.
      static uint16_t div = 0;
      if (++div >= (200 / TICK_MS)) {
        div = 0;
        if (speedRamping)
          LOG.printf("%-6s РАЗГОН c%u T=%.0fмс лимит %.0f°/с ph=%.2f ",
                        GAITS[gaitIdx].name, (unsigned)(done) + 1, pCycleMs, pMaxRateDps, phase);
        else
          LOG.printf("%-6s c%u/%u ph=%.2f ", GAITS[gaitIdx].name,
                        (unsigned)(done) + 1, walkCycles, phase);
        for (uint8_t leg = 0; leg < LEG_COUNT; leg++) {
          LOG.printf("| %s T%6.1f K%6.1f", LEG_NAME[leg],
                        curAngle[leg][JOINT_THIGH], curAngle[leg][JOINT_KNEE]);
          if (pTurn) LOG.printf(" H%6.1f", curAngle[leg][JOINT_HIP]);
          LOG.print(" ");

        }
        LOG.println();
      }
      break;
    }

    case MODE_HOLD:
      slewToTargets(RAMP_RATE_DPS);         // удержание последней цели
      break;

    case MODE_IDLE:
    default:
      break;
  }

  // Кадр целиком, одним махом. Только режимы, которые действительно считали
  // новые углы: в IDLE и ARM в pendingTicks лежит прошлое, выдавать его нельзя.
  if (mode == MODE_RAMP || mode == MODE_WALK || mode == MODE_HOLD) pcaFlush();

#if SPOTTY_WEB
  webPublish(now);
#endif
}
