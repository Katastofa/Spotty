#pragma once
/* ===========================================================================
 * oq_gait.h — траектории стопы и поза корпуса. Порт из OpenQuadruped.
 * ---------------------------------------------------------------------------
 * ПРОИСХОЖДЕНИЕ И ЛИЦЕНЗИЯ
 *
 *   MIT License. Copyright (c) 2020 Adham Elarabawy.
 *   github.com/adham-elarabawy/OpenQuadruped
 *
 * Портированы ТОЛЬКО алгоритмы, из четырёх файлов:
 *   control_library/bezier.py          get_cp_from_param, sample_bezier,
 *                                      rotateAboutZ
 *   control_library/gait_planner.py    signal_sample
 *   control_library/gait_parameters.py T_stance = 2*L_span/v_d
 *   control_library/body_ik.py         transform, get_htf_vectors
 *   depracated/RPi/main_interface.py:40  контрольные точки опоры
 *
 * ЧТО ИЗ ТОГО ЖЕ ПРОЕКТА НЕ ВЗЯТО И ПОЧЕМУ
 *
 * 1. leg_ik.py / InverseKinematics.cpp — ДЕЛИТСЯ НА НОЛЬ НА НАШЕЙ ГЕОМЕТРИИ.
 *    Их формула предполагает вынос оси бедра от оси хипа с ДВУМЯ ненулевыми
 *    составляющими (off0 = 11.369, off1 = 63.763 мм). По KINEMATICS_AUDIT.md
 *    §3 у нас ось хипа ∥ Y, ось бедра ∥ X, общий перпендикуляр 10.75 мм идёт
 *    ЧИСТО ПО Z, вторая составляющая равна нулю. Тогда
 *        a2 = atan2(off0, 0)  = 90°
 *        a3 = asin(h1·sin(a2 + 90°)/h2) = asin(0) = 0
 *        r0 = h1·sin(a4)/sin(a3)        -> деление на ноль
 *    Проверено численно: при off1 -> 0 сходится к пределу, при off1 = 0
 *    отказывает. Вместо неё — своя legIK() из gait_test.ino.
 *
 * 2. Util::angleConversion — костыль под ИХ посадку серво (weird_offset = 50,
 *    angle + 135, ветвление по номеру ноги). У нас JOINT_ZERO_US / JOINT_SIGN
 *    / JOINT_MIN_US / JOINT_MAX_US, и это строго лучше.
 *
 * 3. ВСЕ ИХ ЧИСЛА. Бедро/голень у них 109.868 / 144.580 мм, отношение 1.316.
 *    У нас по STL 108.31 / 116.51, отношение 1.0757. Другая машина. Политика
 *    проекта: чужие числа не переносятся, переносится только форма формул.
 *
 * ---------------------------------------------------------------------------
 * СИСТЕМЫ КООРДИНАТ — ЧИТАТЬ ПЕРЕД ПРАВКОЙ
 *
 * ПЛОСКОСТЬ ТРАЕКТОРИИ (Bezier): x вперёд, z ВНИЗ ПОЛОЖИТЕЛЬНЫЙ.
 *   z — это глубина стопы под осью хипа, поэтому base_height положительная,
 *   а подъём стопы (clearance) её УМЕНЬШАЕТ. Так же в оригинале.
 *
 * КОРПУС (bodyTransform): x вперёд, y ВЛЕВО, z ВВЕРХ. Правая тройка.
 *   Отличается от плоскости траектории намеренно: повороты корпуса удобно
 *   писать только в правой тройке, иначе знаки крена и рыскания разъезжаются.
 *   Перевод в ножную систему делается на выходе, один раз.
 *
 * НОГА (выход bodyTransform, вход legIK): x вперёд, y НАРУЖУ, z ВНИЗ.
 *   «Наружу» — то есть у левых ног +y влево, у правых +y вправо. Зеркальность
 *   бортов уже учтена, дальше её учитывает JOINT_SIGN. Совпадает с тем, что
 *   записано в заголовке legIK().
 *
 * Файл намеренно НЕ включает Arduino.h, Wire.h и не пишет в Serial: он должен
 * собираться и обычным хостовым компилятором, чтобы офлайн-регрессия гоняла
 * ровно тот код, который поедет в железо, а не его копию.
 * ===========================================================================
 */

#include <math.h>

namespace oq {

// ---------------------------------------------------------------------------
// Точка траектории в плоскости ноги. z вниз положительный.
// ---------------------------------------------------------------------------
struct Pt { float x; float z; };

// ---------------------------------------------------------------------------
// БЕЗЬЕ. Степень фиксирована на этапе компиляции, коэффициенты — строка
// треугольника Паскаля, посчитанная заранее. В оригинале они считаются через
// factorial() при каждом построении кривой; на 12 точках это 11! = 39916800,
// то есть на грани int32, и считать это в рантайме незачем.
//
// Степени (1-t) и t набираются вперёд в два маленьких массива, без powf()
// и без деления. Деление здесь было бы ошибкой: при t = 1 множитель (1-t)
// равен нулю, и схема с бегущим делением выдаёт нулевую точку вместо
// последней контрольной — то есть стопа проваливается в момент касания.
// Так тоже нет ни одного powf, но обе границы точны по построению.
//
// БЕЗ ШАБЛОНОВ НАМЕРЕННО. Специализация статического члена шаблона в
// заголовке — нарушение ODR, если заголовок попадёт больше чем в одну
// единицу трансляции. Скетч сейчас однофайловый, но spotty_web.h тоже
// может его затянуть, и ловить это потом линкером незачем.
// ---------------------------------------------------------------------------
#define OQ_BEZIER_MAX 12
inline Pt bezierSample(const Pt *cp, const float *binom, int n, float t) {
  if (t < 0.0f) t = 0.0f;
  if (t > 1.0f) t = 1.0f;
  const float u = 1.0f - t;
  float pu[OQ_BEZIER_MAX], pt[OQ_BEZIER_MAX];
  pu[0] = 1.0f; pt[0] = 1.0f;
  for (int i = 1; i < n; i++) { pu[i] = pu[i-1] * u; pt[i] = pt[i-1] * t; }
  Pt out = { 0.0f, 0.0f };
  for (int i = 0; i < n; i++) {
    const float w = binom[i] * pu[n-1-i] * pt[i];
    out.x += w * cp[i].x;
    out.z += w * cp[i].z;
  }
  return out;
}

// Строки треугольника Паскаля. static — внутренняя связь, дубль в каждой
// единице трансляции безвреден, 60 байт.
static const float BINOM_SWING[12] = {
  1.0f, 11.0f, 55.0f, 165.0f, 330.0f, 462.0f,
  462.0f, 330.0f, 165.0f, 55.0f, 11.0f, 1.0f
};
static const float BINOM_STANCE[3] = { 1.0f, 2.0f, 1.0f };

struct SwingCurve {
  Pt cp[12];
  Pt sample(float t) const { return bezierSample(cp, BINOM_SWING, 12, t); }
};

struct StanceCurve {
  Pt cp[3];
  Pt sample(float t) const { return bezierSample(cp, BINOM_STANCE, 3, t); }
};


// ---------------------------------------------------------------------------
// КОНТРОЛЬНЫЙ МНОГОУГОЛЬНИК ПЕРЕНОСА — bezier.py::get_cp_from_param.
//
// Двенадцать точек, а не четыре, ровно затем, чтобы задать формой СКОРОСТЬ
// стопы на отрыве и на касании. Кратные точки (индексы 2-3-4, 5-6, 8-9)
// обнуляют производную в этих местах: стопа отрывается и садится без рывка,
// а не «по синусу с производной pi на краях», как у нашего углового движка.
//
// Числа 80.5 / 100 / 138.9 / 178.6 / 103.2 / 82.6 — форма кривой, а не размер
// робота: они масштабируются на L_span и base_height и потому переносимы.
// Это единственные чужие числа в файле, и это форма, а не геометрия.
//
// Кривая идёт от -L_span (конец опоры) к +L_span (начало опоры) — стыкуется
// с опорой без разрыва по положению.
// ---------------------------------------------------------------------------
inline void swingFromParam(SwingCurve &c, float Lspan, float baseHeight,
                           float clearance) {
  const float sx = Lspan / 200.0f;
  const float sy = baseHeight / 500.0f;
  const float h1 = baseHeight - 138.9f * sy - clearance;   // полка подъёма
  const float h2 = baseHeight - 178.6f * sy - clearance;   // вершина
  const float back  = -Lspan - 100.0f * sx;
  const float front =  Lspan + 103.2f * sx;
  c.cp[ 0] = { -Lspan,                    baseHeight };
  c.cp[ 1] = { -Lspan - 80.5f * sx,       baseHeight };
  c.cp[ 2] = { back,                      h1 };
  c.cp[ 3] = { back,                      h1 };
  c.cp[ 4] = { back,                      h1 };
  c.cp[ 5] = { 0.0f,                      h1 };
  c.cp[ 6] = { 0.0f,                      h1 };
  c.cp[ 7] = { 0.0f,                      h2 };
  c.cp[ 8] = { front,                     h2 };
  c.cp[ 9] = { front,                     h2 };
  c.cp[10] = {  Lspan + 82.6f * sx,       baseHeight };
  c.cp[11] = {  Lspan,                    baseHeight };
}

// ---------------------------------------------------------------------------
// ОПОРА — квадратичный безье, main_interface.py:40.
// От +L_span к -L_span: стопа уезжает НАЗАД под корпусом, корпус едет ВПЕРЁД.
//
// Средняя точка опущена на penetration («продав»): к середине опоры нога
// дожимается вниз на несколько миллиметров. Смысл — держать контакт, когда
// корпус качнуло; при penetration = 0 опора строго прямая, и это в точности
// линейная опора нашего углового движка.
// ---------------------------------------------------------------------------
inline void stanceFromParam(StanceCurve &c, float Lspan, float baseHeight,
                            float penetration) {
  c.cp[0] = {  Lspan, baseHeight };
  c.cp[1] = {  0.0f,  baseHeight + penetration };
  c.cp[2] = { -Lspan, baseHeight };
}

// ---------------------------------------------------------------------------
// ФАКТИЧЕСКИЕ ВЕЛИЧИНЫ ПРОТИВ ЗАДАННЫХ — читать обязательно.
//
// И clearance, и penetration задают положение КОНТРОЛЬНЫХ ТОЧЕК, а кривая
// безье через них НЕ ПРОХОДИТ. Разница не косметическая:
//
//   подъём. Многоугольник поднят на 178.6*base_height/500 ПЛЮС clearance.
//     При base_height 150 это 53.6 мм ещё до всякого clearance, и заданные
//     'C 10' дают фактический подъём около 54 мм, а не 10. То есть clearance
//     — это ДОБАВКА к штатному подъёму, а не сам подъём;
//   продав. Средняя точка опущена на penetration, но квадратичный безье в
//     середине даёт ровно половину: 'A 5' — это 2.5 мм под линией стоп.
//
// Обе функции возвращают ФАКТИЧЕСКОЕ значение в миллиметрах. Предполётная
// печатает именно их: оператор должен видеть, на что он смотрит.
// ---------------------------------------------------------------------------
inline float swingPeakLift(const SwingCurve &c, float baseHeight) {
  float best = 0.0f;
  for (int i = 0; i <= 200; i++) {
    const float d = baseHeight - c.sample((float)i / 200.0f).z;
    if (d > best) best = d;
  }
  return best;
}

inline float stancePeakDrop(const StanceCurve &c, float baseHeight) {
  return c.sample(0.5f).z - baseHeight;
}

// ---------------------------------------------------------------------------
// ОБРАТНАЯ ЗАДАЧА ПО ПОДЪЁМУ. Оператор задаёт подъём в МИЛЛИМЕТРАХ, а не
// «добавку к встроенному»: 'C 0' при высоте 190 в исходной параметризации
// даёт 59 мм отрыва, и это ловушка, на которую нельзя ловить дважды.
//
// Пик линеен по clearance (вклад входит в кривую с постоянным весом ~0.966),
// поэтому двух вычислений хватает, чтобы решить точно. Отрицательный
// clearance разрешён: он опускает многоугольник обратно, и без этого подъём
// меньше 47 мм при высоте 150 недостижим вовсе.
// ---------------------------------------------------------------------------
inline float clearanceForLift(float wantLiftMm, float Lspan, float baseHeight) {
  SwingCurve c;
  swingFromParam(c, Lspan, baseHeight, 0.0f);
  const float l0 = swingPeakLift(c, baseHeight);
  swingFromParam(c, Lspan, baseHeight, 100.0f);
  const float l1 = swingPeakLift(c, baseHeight);
  const float slope = (l1 - l0) / 100.0f;
  if (slope < 1e-6f) return 0.0f;
  float cl = (wantLiftMm - l0) / slope;
  // Одно уточнение по Ньютону. Линейность точна не везде: при сильно
  // отрицательном clearance вершина кривой уползает по фазе, и без этого
  // шага заказ «10 мм» даёт 11.8. С ним — доли миллиметра.
  for (int it = 0; it < 3; it++) {
    swingFromParam(c, Lspan, baseHeight, cl);
    const float err = swingPeakLift(c, baseHeight) - wantLiftMm;
    if (err > -0.01f && err < 0.01f) break;
    cl -= err / slope;
  }
  return cl;
}

// ---------------------------------------------------------------------------
// ФАЗОВАЯ МАШИНА — gait_planner.py::signal_sample.
//
// Отличие от нашего duty: у нас одно число делит цикл, здесь T_stance и
// T_swing независимы. Это и даёт скорость как физическую величину:
// T_stance = 2*L_span/v_d, то есть «стопа проходит 2*L_span со скоростью v_d»,
// а T_swing задаётся отдельно и от скорости не зависит.
//
// Вход phase — доля цикла [0,1), как у нашего gaitPose, а не время: цикл в
// скетче ведётся часами loop(), и второй источник времени тут не нужен.
// ---------------------------------------------------------------------------
struct Planner {
  float tStance;      // мс
  float tSwing;       // мс

  float stride() const { return tStance + tSwing; }
  float dutyEquiv() const { return tStance / (tStance + tSwing); }

  // Возвращает true, если нога в ОПОРЕ. t — нормированное положение [0,1]
  // внутри своей фазы.
  bool signal(float phase, float &t) const {
    phase -= floorf(phase);
    const float d = dutyEquiv();
    if (phase < d) { t = (d > 1e-6f) ? (phase / d) : 0.0f; return true; }
    const float rest = 1.0f - d;
    t = (rest > 1e-6f) ? ((phase - d) / rest) : 0.0f;
    return false;
  }
};

// ---------------------------------------------------------------------------
// ПОВОРОТ ТРАЕКТОРИИ — bezier.py::rotateAboutZ.
//
// ВНИМАНИЕ, ЧЕСТНОЕ ИМЯ. В оригинале один и тот же угол применяется ко всем
// четырём ногам. Это НЕ разворот: все стопы чертят путь в одну сторону, и
// корпус едет БОКОМ, крабом, сохраняя ориентацию. Настоящий разворот — это
// разные знаки по диагоналям, и он у нас уже есть, через хипы (pTurn,
// TURN_SIGN). Одно другого не заменяет, поэтому оставлены оба.
//
// theta = 0 — ход вперёд; +90° — ход влево.
// ---------------------------------------------------------------------------
inline void rotateStep(float fx, float thetaDeg, float &outX, float &outY) {
  const float r = thetaDeg * 0.017453292f;
  outX = fx * cosf(r);
  outY = fx * sinf(r);
}

// ---------------------------------------------------------------------------
// ПОЗА КОРПУСА — body_ik.py::transform + get_htf_vectors.
//
// ОТСТУПЛЕНИЕ ОТ ОРИГИНАЛА, НАМЕРЕННОЕ. У них body_points вращаются вокруг
// НАЧАЛА КООРДИНАТ, которое лежит на земле под центром корпуса. Тогда тангаж
// не только наклоняет корпус, но и приподнимает его — высота меняется вместе
// с углом, и подобрать одно, не сбив другое, нельзя. Здесь вращение идёт
// вокруг ЦЕНТРА КОРПУСА: наклон не меняет высоту, а высота задаётся только H.
//
// Модель: стопы стоят на земле там, где их поставила траектория; корпус
// сдвинут на (tx,ty,tz) и повёрнут на (roll,pitch,yaw). Вектор хип->стопа
// в системе корпуса:
//        v = R^T · (p0 - t) - hip
// где p0 — стопа в системе корпуса при нулевой позе, hip — точка крепления
// ноги. Знак переноса поэтому «корпус вперёд = стопа назад», что и требуется.
//
// ЗНАКИ (система x вперёд, y влево, z вверх, правая тройка):
//   roll  + = ЛЕВЫЙ борт вверх
//   pitch + = НОС ВВЕРХ
//   yaw   + = НОС ВЛЕВО   (совпадает с нашим 'u +1 = разворот влево')
//
// ЧТО ЧЕМУ ТРЕБУЕТСЯ — ворота по замерам:
//   перенос tx/ty/tz   никакой геометрии;
//   roll               только ПОПЕРЕЧНАЯ база (baseLat, по STL 78.00);
//   pitch и yaw        ПРОДОЛЬНАЯ база (baseLong), которая по STL
//                      НЕ ОПРЕДЕЛЯЕТСЯ — пункт замера M4. Вызывающий обязан
//                      не пускать сюда ненулевые pitch/yaw, пока M4 не снят;
//                      здесь этого не проверить, тут нет ни Serial, ни отказа.
// ---------------------------------------------------------------------------
struct BodyPose {
  float baseLong;                 // продольная база, мм (передний <-> задний хип)
  float baseLat;                  // поперечная база, мм (левый <-> правый хип)
  float rollDeg, pitchDeg, yawDeg;
  float tx, ty, tz;               // сдвиг корпуса, мм: x вперёд, y влево, z вверх
};

/*
 * legFwd  +1 передняя нога, -1 задняя
 * legLeft +1 левый борт,    -1 правый
 * fx      смещение стопы ВПЕРЁД от номинали, мм — общее для всех ног
 * fyLeft  смещение стопы ВЛЕВО от номинали, мм — тоже общее (краб)
 * outNom  номинальный вынос стопы НАРУЖУ, мм — зеркалится по борту
 * height  глубина стопы под осью хипа, мм (положительная)
 * out     x вперёд, y НАРУЖУ, z ВНИЗ — прямо в legIK()
 *
 * ПОЧЕМУ БОКОВЫХ ВХОДА ДВА. Краб — движение корпуса, у всех четырёх ног оно
 * в одну сторону света. Номинальный вынос — свойство ноги, у левых он влево,
 * у правых вправо. Сложить их в одно число нельзя: при зеркалировании они
 * ведут себя по-разному, и один общий 'fy' дал бы крабовый ход, у которого
 * левый борт идёт влево, а правый вправо, то есть шпагат.
 *
 * Про outNom. Стопа стоит НЕ под осью хипа, а на L_HIP наружу от неё —
 * именно при этом хип оказывается на нуле (в legIK при y = L_HIP получается
 * atan2(z,L_HIP) − atan2(z,L_HIP) = 0 тождественно). Это и есть «плоскость
 * ноги вертикальна» из M9_ПРОТОКОЛ.md. Поставить стопу под саму ось хипа
 * стоило бы 3.2° хипа на каждой ноге.
 */
inline void hipToFoot(const BodyPose &b, float legFwd, float legLeft,
                      float fx, float fyLeft, float outNom, float height,
                      float &ox, float &oy, float &oz) {
  // Точка крепления ноги в системе корпуса (z вверх, центр корпуса в нуле).
  const float hx = legFwd  * 0.5f * b.baseLong;
  const float hy = legLeft * 0.5f * b.baseLat;

  // Стопа при нулевой позе корпуса.
  const float px = hx + fx;
  const float py = hy + legLeft * outNom + fyLeft;
  const float pz = -height;

  // Сдвиг корпуса: стопа в системе сдвинутого корпуса.
  const float qx = px - b.tx;
  const float qy = py - b.ty;
  const float qz = pz - b.tz;

  // R^T = Rz(-yaw)·Ry(-pitch)·Rx(-roll) в обратном порядке применения.
  const float cr = cosf(b.rollDeg  * 0.017453292f), sr = sinf(b.rollDeg  * 0.017453292f);
  const float cp = cosf(b.pitchDeg * 0.017453292f), sp = sinf(b.pitchDeg * 0.017453292f);
  const float cy = cosf(b.yawDeg   * 0.017453292f), sy = sinf(b.yawDeg   * 0.017453292f);

  // yaw^-1
  float ax =  cy * qx + sy * qy;
  float ay = -sy * qx + cy * qy;
  float az =  qz;
  // pitch^-1
  float bx =  cp * ax - sp * az;
  float by =  ay;
  float bz =  sp * ax + cp * az;
  // roll^-1
  float vx =  bx;
  float vy =  cr * by + sr * bz;
  float vz = -sr * by + cr * bz;

  // Вектор хип->стопа в системе корпуса, затем в ножную (y наружу, z вниз).
  ox = vx - hx;
  oy = legLeft * (vy - hy);
  oz = -vz;
}

}  // namespace oq
