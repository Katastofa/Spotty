#pragma once
/*
 * spotty_config.h — единственный источник правды по калибровке.
 * Проект Spotty (OpenQuadruped). Зафиксировано 2026-08-20.
 * Ревизия 2026-08-24: нули ch4, ch5, ch9 скорректированы оператором.
 * Ревизия 2026-08-28: нули ch4, ch5, ch9, ch13, ch14 скорректированы снова.
 * См. блок «РЕВИЗИИ НУЛЕЙ» ниже. MIN/MAX не пересматривались ни разу.
 * ---------------------------------------------------------------------------
 * Всё в этом файле ИЗМЕРЕНО физически на текущем железе. Ни одного значения,
 * перенесённого из исторических прошивок, здесь нет.
 *
 * Рабочие скетчи servo_hold и servo_calib пока держат собственные копии
 * таблиц — они писались раньше этого файла. Расхождение между ними и этим
 * файлом считать ошибкой: правит́ся здесь, оттуда переносится.
 * Синхронизировано вручную 2026-08-24: все три таблицы совпадают.
 * ---------------------------------------------------------------------------
 */

#include <stdint.h>

// --------------------------- железо ----------------------------------------
static constexpr uint8_t  SPOTTY_PCA_ADDR   = 0x40;
static constexpr uint8_t  SPOTTY_I2C_SDA    = 8;
static constexpr uint8_t  SPOTTY_I2C_SCL    = 9;
static constexpr float    SPOTTY_PWM_HZ     = 330.0f;   // 50 Гц грубее мёртвой зоны
static constexpr uint32_t SPOTTY_I2C_HZ     = 400000UL; // как в servo_hold/calib/test

/*
 * SPOTTY_OSC_HZ — ЗНАЧЕНИЕ, КОТОРОЕ БИБЛИОТЕКА СЧИТАЕТ ЧАСТОТОЙ ГЕНЕРАТОРА.
 * Добавлено 2026-08-26. Источник: строка setOscillatorFrequency(27000000),
 * одинаковая в servo_hold.ino:249, servo_calib.ino:676, servo_test.ino:511.
 * Это НЕ измерение генератора. Это допущение, под которым СНЯТА ВСЯ
 * КАЛИБРОВКА, и потому оно обязательно к воспроизведению.
 *
 * Почему это не косметика. Adafruit_PWMServoDriver считает и делитель, и
 * число тиков импульса от _oscillator_freq. Погрешности не сокращаются:
 *     фактическая_длительность = заданные_мкс × (принятая_частота / реальная)
 * Скетч, забывший эту строку, берёт умолчание библиотеки 25 МГц и выдаёт
 * импульс в 25/27 = 0.926 от заданного. На нуле 1500 мкс это −111 мкс,
 * то есть −20° по суставу. Все двенадцать уезжают разом, а в какую сторону
 * по углу — зависит от JOINT_SIGN, отчего ноги выворачивает по-разному.
 *
 * Менять это число нельзя иначе как вместе с полной перекалибровкой.
 */
static constexpr uint32_t SPOTTY_OSC_HZ     = 27000000UL;

/*
 * ЗОНД ГЕНЕРАТОРА PCA9685 — добавлено 2026-09-26. Подробности: spotty_osc.h.
 *
 * Встроенный RC-генератор PCA9685 плавает от температуры и питания. Все
 * импульсы при этом масштабируются РАЗОМ, а в углы суставов это переходит
 * через JOINT_SIGN: колени и бёдра уезжают по БОРТУ, хипы — по ДИАГОНАЛИ.
 * Симптом 2026-09-26: «через неделю нули сдвинулись, и по-разному по сторонам».
 *
 * Проводка: сигнальный пин канала SPOTTY_OSC_PROBE_CH (ряд PWM, НЕ V+!) через
 * делитель R1 10k / R2 20k на землю (логика PCA на 5 В) -> SPOTTY_OSC_PROBE_GPIO.
 * Нет провода — скетчи работают как раньше, с ручной поправкой или без неё.
 *
 * Канал зонда обязан быть СВОБОДНЫМ: на него подаётся меандр. Проверяется
 * при компиляции (static_assert в spotty_osc.h).
 */
static constexpr uint8_t  SPOTTY_OSC_PROBE_CH   = 15;   // свободный канал PCA9685
static constexpr uint8_t  SPOTTY_OSC_PROBE_GPIO = 4;    // вход ESP32-S3
static constexpr float    SPOTTY_OSC_MAX_DEV    = 0.05f; // |поправка − 1| выше — не верим

/*
 * ЭТАЛОН ГЕНЕРАТОРА — частота, при которой нули spotty_config.h верны.
 * Источник: оператор, 2026-09-26. Ноги выставлены общей ручкой 'osc +'
 * до K = 1.00799 при замере генератора 26 800 016 Гц:
 *     f_ref = 26 800 016 / 1.00799 = 26 587 581 Гц.
 * То есть в день снятия нулей генератор шёл примерно на 0.8 % медленнее,
 * чем 2026-09-26, и на 1.5 % медленнее принятых в коде 27 МГц.
 * Берётся, если во флеше своего эталона нет ('osc save' пишет во флеш и
 * главнее этой строки). 0 = не задан.
 */
static constexpr double   SPOTTY_OSC_REF_HZ     = 26825627.0;

/*
 * IMU — добавлено 2026-09-26. Код: spotty_imu.h. ТОЛЬКО ИЗМЕРЕНИЕ:
 * походку IMU не меняет, кроме аварийного стопа по наклону (выключен по
 * умолчанию, 'imu stop <град>').
 *
 * Пины — заявление оператора 2026-09-26: SCL GPIO15, SDA GPIO16, INT GPIO18.
 * Отдельная шина Wire1 (второй контроллер I2C), НЕ шина PCA9685: чтение IMU
 * не отнимает время у кадра серво и не сидит на подтяжках к 5 В.
 * INT пока не используется (опрос по таймеру), пин зарезервирован.
 * Тип чипа определяется при старте по WHO_AM_I / CHIP_ID.
 */
static constexpr uint8_t  SPOTTY_IMU_SDA    = 16;
static constexpr uint8_t  SPOTTY_IMU_SCL    = 15;
static constexpr uint8_t  SPOTTY_IMU_INT    = 18;
static constexpr uint32_t SPOTTY_IMU_I2C_HZ = 400000UL;

/*
 * ОРИЕНТАЦИЯ МОДУЛЯ В КОРПУСЕ — оператор 2026-09-26, по фото сверху:
 * модуль (GY-521, MPU-6050 по виду) лежит платой вверх на плате ESP32 у
 * задних хипов; стрелка X смотрит ВЛЕВО, Y — НАЗАД. Отсюда Z вверх
 * (правая тройка: влево × назад = вверх). Код оси: 1 = X, 2 = Y, 3 = Z,
 * минус — обратное направление. Знаки ещё подтвердить ('imu mon'):
 *   нос вниз                          -> тангаж ОТРИЦАТЕЛЬНЫЙ;
 *   правый борт вниз                  -> крен ПОЛОЖИТЕЛЬНЫЙ;
 *   нос влево (сверху против часовой) -> курс РАСТЁТ.
 * Не сходится — поменять эти три числа.
 */
static constexpr int8_t   SPOTTY_IMU_AX_FWD  = -2;   // вперёд = −Y модуля
static constexpr int8_t   SPOTTY_IMU_AX_LEFT = +1;   // влево  = +X модуля
static constexpr int8_t   SPOTTY_IMU_AX_UP   = +3;   // вверх  = +Z модуля

// --------------------------- серво -----------------------------------------
// QY3240MG. Паспорт от завода отсутствует, всё ниже — измерения.
static constexpr float    SPOTTY_US_PER_DEG = 5.57f;    // пять серий, разброс 1.03 %
static constexpr uint16_t SPOTTY_ABS_MIN_US = 520;      // рабочее окно, обосновано
static constexpr uint16_t SPOTTY_ABS_MAX_US = 2380;     // подтверждённой линейностью
static constexpr uint16_t SPOTTY_SPLINE_US  = 80;       // один зуб 25T = 14.4°
// Механического упора у серво НЕТ. Программные пределы — единственная защита.

// --------------------------- суставы ---------------------------------------
enum Leg   : uint8_t { LEG_FR, LEG_FL, LEG_BR, LEG_BL, LEG_COUNT };
enum Joint : uint8_t { JOINT_HIP, JOINT_THIGH, JOINT_KNEE, JOINT_PER_LEG };

/*
 * СОГЛАШЕНИЕ О НАПРАВЛЕНИИ — система НОЖНАЯ.
 * Положительное направление определено одинаково для всех четырёх ног,
 * зеркальность бортов целиком живёт в JOINT_SIGN.
 *
 *   колено  + = СГИБАНИЕ, стопа подтягивается к корпусу (голень идёт ВПЕРЁД)
 *   бедро   + = вынос ноги ВПЕРЁД
 *   хип     + = отведение НАРУЖУ от корпуса
 *
 * JOINT_SIGN[ch] = +1, если рост импульса даёт это движение, иначе -1.
 * 0 = канал не используется.
 *
 * Импульс сустава считается так:
 *   us = JOINT_ZERO_US[ch] + JOINT_SIGN[ch] * angle_deg * SPOTTY_US_PER_DEG
 * и ОБЯЗАТЕЛЬНО клампится в [JOINT_MIN_US[ch], JOINT_MAX_US[ch]].
 */

// Канал по ноге и суставу. 0xFF = не используется.
static constexpr uint8_t SPOTTY_CH[LEG_COUNT][JOINT_PER_LEG] = {
  /* FR */ {  9, 12, 14 },
  /* FL */ {  8, 10, 13 },
  /* BR */ {  6,  4,  1 },
  /* BL */ {  5,  2,  0 },
};

// Индексом служит НОМЕР КАНАЛА PCA9685. 0 = канал не используется.
// ПРАВКА НУЛЕЙ 2026-08-31 (источник: замер оператора в нулевой позе):
//   ch4  BR бедро  1460 -> 1450  (-10 мкс = -1.8 град)
//   ch14 FR колено 1460 -> 1500 -> ОТКАЧЕНО обратно на 1460
//   ch12 FR бедро  1540 -> 1530  (-10 мкс = -1.8 град)
//   ch10 FL бедро  1470 -> 1450  (-20 мкс = -3.6 град)
static constexpr uint16_t JOINT_ZERO_US[16] = {
  1520,   // ch0  BL колено
  1440,   // ch1  BR колено
  1460,   // ch2  BL бедро
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  1470,   // ch14 FR колено
     0    // ch15 не используется
};
static constexpr uint16_t JOINT_MIN_US[16] = {
   700, 1200, 1080,    0,  960, 1350, 1130,    0,
  1140, 1350, 1010,    0, 1000,  710, 1220,    0
};
static constexpr uint16_t JOINT_MAX_US[16] = {
  1780, 2250, 1980,    0, 1820, 1780, 1550,    0,
  1560, 1780, 1990,    0, 1890, 1730, 2290,    0
};
static constexpr int8_t JOINT_SIGN[16] = {
    -1,   +1,   -1,    0,   +1,   +1,   -1,    0,
    -1,   +1,   -1,    0,   +1,   -1,   +1,    0
};

/*
 * СИММЕТРИЯ ЗНАКОВ — сходится полностью, все три типа делятся два на два.
 *
 *   колени  по БОРТУ      левые BL(0) FL(13) = -1 | правые BR(1) FR(14) = +1
 *   бёдра   по БОРТУ      левые BL(2) FL(10) = -1 | правые BR(4) FR(12) = +1
 *   хипы    по ДИАГОНАЛИ  BL(5) FR(9) = +1        | BR(6) FL(8) = -1
 *
 * Соответствует списку печати: Legs_Left и Legs_Right — общие детали колена и
 * бедра внутри борта, а плечевые кронштейны спереди и сзади разные и зеркальны
 * ещё и по оси вперёд-назад, отчего хипы становятся диагональными.
 *
 * Нуль ch12 (1540) выше трёх остальных бёдер (1460/1470/1460) примерно на один
 * зуб шлица. Это только посадка качалки, на направление не влияет: ход у ch12
 * нормальный, 890 мкс против 860 у парного ch4. Ничего исправлять не нужно.
 *
 * ---------------------------------------------------------------------------
 * ХИПЫ: НУЛИ ДИАГОНАЛЬНОЙ ПАРЫ РАЗОШЛИСЬ — ОТКРЫТЫЙ ВОПРОС
 * Замечено 2026-08-28 при разборе ревизии нулей.
 *
 * CALIBRATION.md говорит прямо: несовпадение внутри диагональной пары хипов —
 * признак ошибки сборки. Там речь про ДИАПАЗОНЫ, и с ними всё в порядке:
 *
 *   пара -1:  ch6 BR 1130..1550   ch8 FL 1140..1560     нули 1430 и 1430
 *   пара +1:  ch5 BL 1350..1780   ch9 FR 1350..1780     нули 1470 и 1420
 *
 * Диапазоны обеих пар по-прежнему совпадают, у ch5/ch9 — до микросекунды.
 * А вот НУЛИ разъехались: у пары ch6/ch8 они одинаковы до микросекунды,
 * у ch5/ch9 отличаются на 50 мкс = 9.0°. До ревизии было 25 мкс = 4.5°,
 * то есть расхождение УДВОИЛОСЬ.
 *
 * Одинаковое физическое окно при разных нулях — это и есть признак: механика
 * пары одинакова, а качалка посажена по-разному.
 *
 * СЛЕДСТВИЕ, ВИДНОЕ СРАЗУ. Ход хипа ВНУТРЬ у ch9 сократился с -16.7° до -9.5°,
 * тогда как у трёх остальных он -18.5..-20.3°. Разворот через хипы ('u' в
 * gait_test) ограничен именно внутренней стороной, и теперь предел задаёт
 * ch9: размах больше 9° предполётная проверка не пропустит. Раньше проходило
 * до 16°. Значение по умолчанию 5° по-прежнему проходит, но запас упал
 * с 11° до 4°.
 *
 * ЧТО ПРОВЕРИТЬ НА ЖЕЛЕЗЕ, прежде чем считать это нормой:
 *   1. в servo_hold выдать ch5 и ch9 ОДИН И ТОТ ЖЕ импульс ('p 5 1445',
 *      'p 9 1445') и посмотреть на ноги. Пара диагональная — при равном
 *      импульсе положения должны быть зеркальны;
 *   2. если не зеркальны — снять качалку ch9 и переставить на соседний зуб.
 *      Шаг зуба 25T = 80 мкс, расхождение 50 мкс, значит после перестановки
 *      нуль уедет в другую сторону примерно на 30 мкс;
 *   3. если зеркальны — расхождение реальное и механическое, и тогда оно
 *      должно быть заметно на самой раме.
 *
 * Пока не проверено, значения приняты как есть. Кламп защищает раму
 * независимо от того, верен нуль или нет.
 */


/*
 * РЕВИЗИЯ НУЛЕЙ — 2026-08-28. Источник: оператор, подбор по фактической позе
 * (НЕ транспортир, НЕ фото). Таблица подана целиком, MIN/MAX совпали с
 * прежними до микросекунды по всем двенадцати каналам.
 *
 *   канал  сустав       было   стало   d мкс   d град
 *   ch4    BR бедро     1445   1460     +15    +2.7
 *   ch5    BL хип       1485   1470     -15    -2.7
 *   ch9    FR хип       1460   1420     -40    -7.2
 *   ch13   FL колено    1520   1500     -20    -3.6
 *   ch14   FR колено    1490   1460     -30    -5.4   (правка внесена
 *                                                      оператором вручную)
 *
 * ch4 и ch5 вернулись примерно туда, откуда их увела ревизия 2026-08-24:
 * ch4 точно в исходные 1460, ch5 на 1470 против исходных 1480. То есть
 * правка от 24-го числа этим двум каналам скорее навредила. При подборе
 * на глаз это нормально и само по себе тревоги не вызывает.
 *
 * ЧТО ВЫЗЫВАЕТ — ch9. Его полная история: 1440 -> 1460 -> 1420. Последний шаг
 * ровно -40 мкс = -7.18°, а это с точностью до округления ПОЛОВИНА ЗУБА
 * ШЛИЦА 25T (14.4 / 2 = 7.2°). Совпадение подозрительное: ровно так выглядит
 * попытка компенсировать качалку, севшую на соседний зуб. См. блок про
 * симметрию хипов ниже.
 *
 * ---------------------------------------------------------------------------
 * РЕВИЗИЯ НУЛЕЙ — 2026-08-24. Источник: оператор, подбор по фактической позе.
 * ЧАСТИЧНО ОТМЕНЕНА ревизией 2026-08-28, оставлена как история.
 *
 * НУЛЕВАЯ ПОЗА ЗАФИКСИРОВАНА: нога ПРЯМАЯ, вертикально вниз. Колено разогнуто
 * в одну линию с бедром — по соглашению «угол к продолжению бедра» это 0°,
 * а не 180°. Плоскость ноги вертикальна, параллельна борту.
 *
 *   канал  сустав     было   стало   d мкс   отклонение при старом нуле
 *   ch4    BR бедро   1460   1445     -15    бедро вынесено вперёд   2.7°
 *   ch5    BL хип     1480   1485      +5    хип приведён внутрь     0.9°
 *   ch9    FR хип     1440   1460     +20    хип приведён внутрь     3.6°
 *
 * Все три уложились в +-7.2°, то есть в половину зуба шлица 25T. Ожидаемо.
 *
 * ВНИМАНИЕ. Неизменённый канал означает «отклонение не видно глазом», а НЕ
 * «отклонение измерено и равно нулю». Разрешение глаза около +-2..3°, у бёдер
 * хуже: излом бедра 7.33° заставляет деталь выглядеть вертикальной, когда её
 * ось таковой не является.
 * НИ ОДИН из двенадцати нулей до сих пор не снят транспортиром или по фото
 * строго сбоку — все три ревизии это подбор на глаз, что подтверждено
 * оператором 2026-08-28. M9_ПРОТОКОЛ.md остаётся НЕЗАПОЛНЕННЫМ, сколько бы
 * ревизий ни прошло, и остаточная ошибка до +-7.2° остаётся заявленной.
 *
 * MIN/MAX не пересматривались: это физическое окно, от нуля не зависит.
 *
 * ОТКРЫТЫЙ ВОПРОС — ch10. Пересчёт пределов в градусы с учётом JOINT_SIGN даёт
 * по ногам: хипы -20..+57, колени -45..+146 — сходятся отлично, знаки и карта
 * каналов подтверждаются. Бёдра: FR +62.8, BR +67.3, BL +68.2, но FL +82.6 —
 * выбивается примерно на 15°. Либо у ch10 качалка села на другой зуб, либо в
 * JOINT_MAX_US[10] ошибка замера. Проверить перед включением IK.
 */


// ===========================================================================
// ЖЁСТКИЕ ПРЕДЕЛЫ СУСТАВОВ — единственный разрешённый путь к серво
// ---------------------------------------------------------------------------
// Добавлено 2026-08-28 по решению оператора, перед началом тестов походки.
//
// ЗАЧЕМ. У QY3240MG механического упора НЕТ: ход ~355°, рама останавливает
// сустав раньше серво. Программный предел — единственная защита деталей.
// До этой ревизии кламп жил внутри каждого скетча, и каждый новый скетч
// мог его не позвать. Теперь кламп общий и живёт рядом с таблицами, которые
// он и защищает.
//
// ТРИ РУБЕЖА, все обязательны и все проходятся всегда:
//   1) кламп В ГРАДУСАХ до расчёта импульса — иначе генератор траектории
//      накапливает угол за пределом (windup), импульс упирается в границу,
//      а «текущий угол» уезжает и обратный ход начинается с задержкой;
//   2) кламп В МИКРОСЕКУНДАХ по жёсткому окну КАНАЛА;
//   3) кламп по абсолютному окну серво 520…2380.
//
// ЗАПАС. Жёсткое окно уже, чем измеренное, на SPOTTY_LIMIT_MARGIN_DEG.
// ВАЖНО: измеренные JOINT_MIN_US/JOINT_MAX_US сами получены как «подвод до
// касания, затем отступ 3° внутрь» (CALIBRATION.md). Значит суммарный отступ
// от точки касания рамы составляет 3 + 3 = 6°. Это сознательно: остаточная
// ошибка нуля у девяти каналов из двенадцати не измерена и может достигать
// половины зуба шлица 25T, то есть ±7.2° (см. «РЕВИЗИЯ НУЛЕЙ» выше).
//
// Менять SPOTTY_LIMIT_MARGIN_DEG в сторону уменьшения — только после того,
// как M9_ПРОТОКОЛ.md заполнен на все двенадцать строк.
// ===========================================================================

static constexpr float    SPOTTY_LIMIT_MARGIN_DEG = 3.0f;
static constexpr uint16_t SPOTTY_MARGIN_US =
    (uint16_t)(SPOTTY_LIMIT_MARGIN_DEG * SPOTTY_US_PER_DEG + 0.5f);   // 17 мкс

// Канал считается рабочим, только если ВСЕ четыре таблицы его признают.
// Любая одиночная дырка (нуль, предел, знак) выключает канал целиком —
// это защита от полузаполненной таблицы, а не строгость ради строгости.
constexpr bool spottyChUsed(uint8_t ch) {
  return ch < 16
      && JOINT_SIGN[ch]    != 0
      && JOINT_ZERO_US[ch] != 0
      && JOINT_MIN_US[ch]  != 0
      && JOINT_MAX_US[ch]  != 0;
}

// Нижняя жёсткая граница канала, мкс. Не уже абсолютного окна серво.
constexpr uint16_t spottyHardLoUs(uint8_t ch) {
  return !spottyChUsed(ch) ? SPOTTY_ABS_MIN_US
       : (uint16_t)((JOINT_MIN_US[ch] + SPOTTY_MARGIN_US) < SPOTTY_ABS_MIN_US
                    ? SPOTTY_ABS_MIN_US
                    : (JOINT_MIN_US[ch] + SPOTTY_MARGIN_US));
}

// Верхняя жёсткая граница канала, мкс.
constexpr uint16_t spottyHardHiUs(uint8_t ch) {
  return !spottyChUsed(ch) ? SPOTTY_ABS_MAX_US
       : (uint16_t)((int)(JOINT_MAX_US[ch] - SPOTTY_MARGIN_US) > (int)SPOTTY_ABS_MAX_US
                    ? SPOTTY_ABS_MAX_US
                    : (JOINT_MAX_US[ch] - SPOTTY_MARGIN_US));
}

// --------------------------- кламп в мкс -----------------------------------
// Возвращает значение, которое РАЗРЕШЕНО отправить в серво. hit (если задан)
// становится true, когда вход пришлось урезать: это не норма, а признак
// ошибки в вызывающем коде, и вызывающий обязан на него отреагировать.
inline uint16_t spottyClampUs(uint8_t ch, long us, bool *hit = 0) {
  if (ch >= 16) { if (hit) *hit = true; return SPOTTY_ABS_MIN_US; }
  long lo = (long)spottyHardLoUs(ch);
  long hi = (long)spottyHardHiUs(ch);
  if (lo > hi) { long t = lo; lo = hi; hi = t; }        // вывернутая строка таблицы
  long out = us < lo ? lo : (us > hi ? hi : us);
  if (out < (long)SPOTTY_ABS_MIN_US) out = SPOTTY_ABS_MIN_US;
  if (out > (long)SPOTTY_ABS_MAX_US) out = SPOTTY_ABS_MAX_US;
  if (hit && out != us) *hit = true;
  return (uint16_t)out;
}

// --------------------------- кламп в градусах -------------------------------
// Пределы сустава в градусах ножной системы, выведенные из ЖЁСТКОГО окна.
//   us = zero + sign * angle * k   =>   angle = (us - zero) / (sign * k)
inline void spottyAngleLimits(uint8_t ch, float &lo, float &hi) {
  if (!spottyChUsed(ch)) { lo = 0.0f; hi = 0.0f; return; }
  const float k = JOINT_SIGN[ch] * SPOTTY_US_PER_DEG;
  const float a = ((float)spottyHardLoUs(ch) - (float)JOINT_ZERO_US[ch]) / k;
  const float b = ((float)spottyHardHiUs(ch) - (float)JOINT_ZERO_US[ch]) / k;
  lo = a < b ? a : b;
  hi = a < b ? b : a;
}

// Кламп ЦЕЛИ ДО расчёта импульса. Это рубеж номер один: он не даёт углу
// уехать за предел и тем самым убивает windup в генераторе траектории.
// Порог 0.05° — чтобы дрожание последнего бита float не считалось выходом.
inline float spottyClampAngle(uint8_t ch, float deg, bool *hit = 0) {
  float lo, hi;
  spottyAngleLimits(ch, lo, hi);
  if (!spottyChUsed(ch)) { if (hit) *hit = true; return 0.0f; }
  if (deg < lo) { if (hit && (lo - deg) > 0.05f) *hit = true; return lo; }
  if (deg > hi) { if (hit && (deg - hi) > 0.05f) *hit = true; return hi; }
  return deg;
}

// Угол -> импульс БЕЗ клампа. Отдельно от клампа намеренно: любой вызов
// этой функции обязан пройти через spottyClampUs перед записью в драйвер.
inline float spottyAngleToUsRaw(uint8_t ch, float deg) {
  return (float)JOINT_ZERO_US[ch] + JOINT_SIGN[ch] * deg * SPOTTY_US_PER_DEG;
}

// Полный путь угол -> разрешённый импульс. Оба рубежа сразу.
inline uint16_t spottyAngleToUs(uint8_t ch, float deg, bool *hit = 0) {
  const float safe = spottyClampAngle(ch, deg, hit);
  return spottyClampUs(ch, (long)(spottyAngleToUsRaw(ch, safe) + 0.5f), hit);
}

// ===========================================================================
// ПРОВЕРКИ ТАБЛИЦ НА ЭТАПЕ КОМПИЛЯЦИИ
// Ошибка в таблице не должна доживать до серво. Скетч с вывернутой строкой
// просто не соберётся.
// ===========================================================================
#define SPOTTY_CHECK_CH(ch)                                                    \
  static_assert(!spottyChUsed(ch) || JOINT_MIN_US[ch] >= SPOTTY_ABS_MIN_US,    \
                "ch" #ch ": MIN ниже абсолютного окна серво");                 \
  static_assert(!spottyChUsed(ch) || JOINT_MAX_US[ch] <= SPOTTY_ABS_MAX_US,    \
                "ch" #ch ": MAX выше абсолютного окна серво");                 \
  static_assert(!spottyChUsed(ch) ||                                           \
                JOINT_MIN_US[ch] + 2 * SPOTTY_MARGIN_US < JOINT_MAX_US[ch],    \
                "ch" #ch ": запас съел весь ход сустава");                     \
  static_assert(!spottyChUsed(ch) ||                                           \
                (JOINT_ZERO_US[ch] > spottyHardLoUs(ch) &&                     \
                 JOINT_ZERO_US[ch] < spottyHardHiUs(ch)),                      \
                "ch" #ch ": нуль вне жёсткого окна канала");                   \
  static_assert(!spottyChUsed(ch) ||                                           \
                (JOINT_SIGN[ch] == 1 || JOINT_SIGN[ch] == -1),                 \
                "ch" #ch ": знак не +1 и не -1")

SPOTTY_CHECK_CH(0);  SPOTTY_CHECK_CH(1);  SPOTTY_CHECK_CH(2);  SPOTTY_CHECK_CH(3);
SPOTTY_CHECK_CH(4);  SPOTTY_CHECK_CH(5);  SPOTTY_CHECK_CH(6);  SPOTTY_CHECK_CH(7);
SPOTTY_CHECK_CH(8);  SPOTTY_CHECK_CH(9);  SPOTTY_CHECK_CH(10); SPOTTY_CHECK_CH(11);
SPOTTY_CHECK_CH(12); SPOTTY_CHECK_CH(13); SPOTTY_CHECK_CH(14); SPOTTY_CHECK_CH(15);

// Карта каналов не должна ссылаться на выключенный канал и не должна
// использовать один канал дважды. Проверяется в рантайме, см. ниже:
// на этапе компиляции цикл по двумерной карте в C++11 не выражается.

// -------------------- проверки целостности при компиляции -------------------
static_assert(SPOTTY_ABS_MIN_US < SPOTTY_ABS_MAX_US, "окно вывернуто");
static_assert(SPOTTY_MARGIN_US > 0, "запас обнулился");
static_assert(SPOTTY_US_PER_DEG > 0.0f, "масштаб серво неположителен");

// ===========================================================================
// РАНТАЙМНАЯ САМОПРОВЕРКА. Вызывать в setup() ДО любого взвода.
// Возвращает true, только если таблицы согласованы. Скетч обязан отказать
// в подаче ШИМ при false.
// Печать — через Serial, поэтому функция объявлена только когда доступен
// Arduino.h (в .ino он подключается неявно).
// ===========================================================================
/*
 * ПЕЧАТЬ САМОПРОВЕРКИ — через SPOTTY_LOG, а не напрямую в Serial.
 * Добавлено 2026-08-31 вместе с веб-панелью. По умолчанию SPOTTY_LOG И ЕСТЬ
 * Serial, поэтому servo_hold и servo_calib ведут себя ровно как раньше.
 * gait_test с включённым SPOTTY_WEB определяет SPOTTY_LOG как LOG (Serial
 * плюс кольцевой буфер), чтобы «ТАБЛИЦЫ НЕ ПРОШЛИ» было видно и в браузере,
 * а не только в мониторе порта. Значений калибровки это не касается вовсе.
 */
#ifndef SPOTTY_LOG
#define SPOTTY_LOG Serial
#endif

#ifdef ARDUINO
inline bool spottyLimitsSelfCheck(bool verbose = true) {
  int bad = 0;
  uint8_t seen[16];
  for (uint8_t i = 0; i < 16; i++) seen[i] = 0;

  for (uint8_t leg = 0; leg < LEG_COUNT; leg++) {
    for (uint8_t j = 0; j < JOINT_PER_LEG; j++) {
      uint8_t ch = SPOTTY_CH[leg][j];
      if (ch >= 16) { SPOTTY_LOG.printf("КАРТА: нога %u сустав %u -> канал %u вне 0..15\n", leg, j, ch); bad++; continue; }
      if (!spottyChUsed(ch)) { SPOTTY_LOG.printf("КАРТА: нога %u сустав %u -> ch%u выключен таблицами\n", leg, j, ch); bad++; continue; }
      if (seen[ch]++) { SPOTTY_LOG.printf("КАРТА: ch%u назначен более одного раза\n", ch); bad++; }
    }
  }

  for (uint8_t ch = 0; ch < 16; ch++) {
    if (!spottyChUsed(ch)) continue;
    uint16_t lo = spottyHardLoUs(ch), hi = spottyHardHiUs(ch);
    bool ok = (lo < hi) && (JOINT_ZERO_US[ch] > lo) && (JOINT_ZERO_US[ch] < hi);
    if (!ok) bad++;
    if (verbose || !ok) {
      float alo, ahi; spottyAngleLimits(ch, alo, ahi);
      SPOTTY_LOG.printf("ch%-2u  измер %4u..%4u  жёстк %4u..%4u  нуль %4u  знак %+d  углы %7.1f..%7.1f  %s\n",
                    ch, JOINT_MIN_US[ch], JOINT_MAX_US[ch], lo, hi,
                    JOINT_ZERO_US[ch], JOINT_SIGN[ch], alo, ahi, ok ? "ok" : "ОШИБКА ТАБЛИЦЫ");
    }
  }

  if (bad) SPOTTY_LOG.printf("САМОПРОВЕРКА ПРЕДЕЛОВ НЕ ПРОЙДЕНА: %d замечани(й). ШИМ запрещён.\n", bad);
  else     SPOTTY_LOG.printf("Самопроверка пределов пройдена. Запас внутрь от измеренного: %.1f° (%u мкс).\n",
                         SPOTTY_LIMIT_MARGIN_DEG, SPOTTY_MARGIN_US);
  return bad == 0;
}
#endif  // ARDUINO
